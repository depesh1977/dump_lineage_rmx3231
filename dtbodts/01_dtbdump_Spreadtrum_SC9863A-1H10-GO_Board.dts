/dts-v1/;

/ {
	compatible = "sprd,sp9863a-1h10-go", "sprd,sc9863a";
	model = "Spreadtrum SC9863A-1H10-GO Board";
	sprd,sc-id = "sp9863a 1h10 go";

	__fixups__ {
		aon_clk = "/fragment@5/__overlay__/sensor-main@20:clocks:0", "/fragment@6/__overlay__/sensor-sub@4c:clocks:0", "/fragment@7/__overlay__/pn557@28:clocks:0";
		aonapb_gate = "/fragment@7/__overlay__/pn557@28:clocks:12";
		ap_gpio = "/fragment/__overlay__/fingerprint@0:fpint-gpios:0", "/fragment/__overlay__/HardwareInfo:sdcard-gpio:0", "/fragment/__overlay__/oppo_devinfo:sub_board-gpio:0", "/fragment/__overlay__/oppo_devinfo:sdcard-gpio:0", "/fragment/__overlay__/op_rf_cable:rf,cable0-gpio:0", "/fragment/__overlay__/flash-pwm:flash-en-gpios:0", "/fragment/__overlay__/flash-pwm:flash-enm-gpios:0", "/fragment/__overlay__/flash-pwm:board_id1:0", "/fragment/__overlay__/flash-pwm:board_id2:0", "/fragment/__overlay__/flash-pwm:board_id3:0", "/fragment@3/__overlay__:avdd-gpio:0", "/fragment@3/__overlay__:avee-gpio:0", "/fragment@3/__overlay__:reset-gpio:0", "/fragment@4/__overlay__/touchscreen@0:touch,irq-gpio:0", "/fragment@4/__overlay__/touchscreen@0:touch,rst-gpio:0", "/fragment@5/__overlay__/sensor-main@20:reset-gpios:0", "/fragment@5/__overlay__/sensor-main@20:power-down-gpios:0", "/fragment@6/__overlay__/sensor-sub@4c:reset-gpios:0", "/fragment@6/__overlay__/sensor-sub@4c:power-down-gpios:0", "/fragment@7/__overlay__/pn557@28:nxp,ven-gpio:0", "/fragment@7/__overlay__/pn557@28:nxp,irq-gpio:0", "/fragment@7/__overlay__/pn557@28:nxp,firm-gpio:0", "/fragment@7/__overlay__/pn557@28:nxp,clkreq-gpio:0", "/fragment@7/__overlay__/adaptive-touchscreen@38:gpios:0", "/fragment@7/__overlay__/adaptive-touchscreen@38:gpios:12", "/fragment@14/__overlay__:tf_ldo_en:0", "/fragment@25/__overlay__:sprd,spk-ext-pa-gpio:0", "/fragment@25/__overlay__:sprd,spk-ext-pa-gpio:12", "/fragment@25/__overlay__:sprd,spk-ext-pa-det:0", "/fragment@25/__overlay__:sprd,spk-ext-pa-det1:0";
		chosen = "/fragment@0:target:0";
		csi0 = "/fragment@5/__overlay__/sensor-main@20:csi:0", "/fragment@6/__overlay__/sensor-sub@4c:csi:0";
		ddr_dfs = "/fragment@11:target:0";
		dpu = "/fragment@23:target:0";
		eic_async = "/fragment@14/__overlay__:cd-gpios:0";
		eic_debounce = "/fragment/__overlay__/gpio-keys/key-volumedown:gpios:0", "/fragment@1/__overlay__:id-gpio:0";
		ext_26m = "/fragment@5/__overlay__/sensor-main@20:clocks:40", "/fragment@6/__overlay__/sensor-sub@4c:clocks:40", "/fragment@7/__overlay__/pn557@28:clocks:8";
		extcon_gpio = "/fragment@1:target:0", "/fragment@2/__overlay__:extcon:0", "/fragment@8/__overlay__/charger@6b:extcon:0";
		hsphy = "/fragment@8/__overlay__/charger@6b:phys:0";
		i2c0 = "/fragment@5:target:0";
		i2c1 = "/fragment@6:target:0";
		i2c3 = "/fragment@7:target:0";
		i2c4 = "/fragment@8:target:0";
		i2c7 = "/fragment@9:target:0";
		ion = "/fragment@22:target:0";
		mm_gate = "/fragment@5/__overlay__/sensor-main@20:clocks:8", "/fragment@6/__overlay__/sensor-sub@4c:clocks:8";
		panel = "/fragment@3:target:0";
		pin_controller = "/fragment@13:target:0";
		pll = "/fragment@5/__overlay__/sensor-main@20:clocks:16", "/fragment@5/__overlay__/sensor-main@20:clocks:24", "/fragment@5/__overlay__/sensor-main@20:clocks:32", "/fragment@6/__overlay__/sensor-sub@4c:clocks:16", "/fragment@6/__overlay__/sensor-sub@4c:clocks:24", "/fragment@6/__overlay__/sensor-sub@4c:clocks:32";
		pmic_adc = "/fragment/__overlay__/thermal-sensor:io-channels:0", "/fragment/__overlay__/charger-manager:io-channels:0";
		pmic_eic = "/fragment/__overlay__/gpio-keys/key-volumeup:gpios:0", "/fragment/__overlay__/gpio-keys/key-power:gpios:0";
		pmic_fgu = "/fragment@10:target:0";
		pmic_typec = "/fragment/__overlay__/charger-manager/regulator@0/cable@0:extcon:0";
		pwms = "/fragment/__overlay__/flash-pwm:pwms:0";
		reserved_memory = "/fragment@21:target:0";
		sdio0 = "/fragment@14:target:0";
		sound_vbc_r1p0v3_sprd_codec = "/fragment@25:target:0";
		spi2 = "/fragment@4:target:0";
		sprd_headset = "/fragment@24:target:0";
		sprd_hwdvfs = "/fragment@12:target:0";
		thm_zone = "/fragment@15:target:0";
		usb = "/fragment@2:target:0";
		vdd18 = "/fragment@16:target:0";
		vddcama = "/fragment@5/__overlay__/sensor-main@20:vddcama-supply:0", "/fragment@6/__overlay__/sensor-sub@4c:vddcama-supply:0";
		vddcamd = "/fragment@5/__overlay__/sensor-main@20:vddcamd-supply:0", "/fragment@6/__overlay__/sensor-sub@4c:vddcamd-supply:0";
		vddcamio = "/fragment@5/__overlay__/sensor-main@20:vddio-supply:0", "/fragment@6/__overlay__/sensor-sub@4c:vddio-supply:0";
		vddcammot = "/fragment@5/__overlay__/sensor-main@20:vddcammot-supply:0";
		vddldomem = "/fragment@19:target:0";
		vddrf125 = "/fragment@18:target:0";
		vddrf18 = "/fragment@17:target:0";
		vddsim2 = "/fragment@20:target:0";
	};

	__local_fixups__ {

		fragment {

			__overlay__ {

				charger-manager {
					monitored-battery = <0x0 0x4>;
				};

				flash-pwm {
					pinctrl-0 = <0x0>;
					pinctrl-1 = <0x0>;
				};

				gpio-keys {
					pinctrl-0 = <0x0>;
				};

				lcds {

					lcd_ILI9882N_boe_mipi_hd {

						display-timings {
							native-mode = <0x0>;
						};
					};

					lcd_dummy_mipi_hd {

						display-timings {
							native-mode = <0x0>;
						};
					};

					lcd_ft8006s_boe_mipi_hd {

						display-timings {
							native-mode = <0x0>;
						};
					};

					lcd_ft8006saa_truly_mipi_hd {

						display-timings {
							native-mode = <0x0>;
						};
					};

					lcd_ft8615_inx_mipi_hd {

						display-timings {
							native-mode = <0x0>;
						};
					};

					lcd_ft8722_boe_mipi_hd {

						display-timings {
							native-mode = <0x0>;
						};
					};

					lcd_hx83112a_boe_mipi_hd {

						display-timings {
							native-mode = <0x0>;
						};
					};

					lcd_hx83112a_inx_mipi_hd {

						display-timings {
							native-mode = <0x0>;
						};
					};

					lcd_icnl9911C_truly_mipi_hd {

						display-timings {
							native-mode = <0x0>;
						};
					};

					lcd_jd9365t_ctc_mipi_hd {

						display-timings {
							native-mode = <0x0>;
						};
					};

					lcd_nt35532_truly_mipi_fhd {

						display-timings {
							native-mode = <0x0>;
						};
					};

					lcd_nt35596_boe_mipi_fhd {

						display-timings {
							native-mode = <0x0>;
						};
					};

					lcd_nt35695_truly_mipi_fhd {

						display-timings {
							native-mode = <0x0>;
						};
					};
				};
			};
		};

		fragment@10 {

			__overlay__ {
				monitored-battery = <0x0 0x4>;
			};
		};

		fragment@12 {

			__overlay__ {
				hwdvfs_dev = <0x0 0x4 0x8>;

				cluster@0 {
					dcdc-ctrl = <0x0>;
				};

				cluster@1 {
					dcdc-ctrl = <0x0>;
				};

				dsu@0 {
					dcdc-ctrl = <0x0>;
				};
			};
		};

		fragment@13 {

			__overlay__ {
				pinctrl-0 = <0x0>;
				pinctrl-1 = <0x0>;
				pinctrl-10 = <0x0>;
				pinctrl-11 = <0x0>;
				pinctrl-2 = <0x0>;
				pinctrl-3 = <0x0>;
				pinctrl-4 = <0x0>;
				pinctrl-5 = <0x0>;
				pinctrl-6 = <0x0>;
				pinctrl-7 = <0x0>;
				pinctrl-8 = <0x0>;
				pinctrl-9 = <0x0>;
			};
		};

		fragment@15 {

			__overlay__ {

				board-thmzone {
					thermal-sensors = <0x0>;
				};
			};
		};

		fragment@2 {

			__overlay__ {
				vbus-supply = <0x0>;
			};
		};

		fragment@22 {

			__overlay__ {

				heap@3 {
					memory-region = <0x0>;
				};

				heap@4 {
					memory-region = <0x0>;
				};
			};
		};

		fragment@23 {

			__overlay__ {
				sprd,logo-memory = <0x0>;
			};
		};

		fragment@8 {

			__overlay__ {

				charger@6b {
					monitored-battery = <0x0 0x4>;
				};
			};
		};
	};

	__symbols__ {
		ILI9882N_boe_timing0 = "/fragment/__overlay__/lcds/lcd_ILI9882N_boe_mipi_hd/display-timings/timing0";
		bat = "/fragment/__overlay__/battery";
		bat2 = "/fragment/__overlay__/battery2";
		bd_thmzone = "/fragment@15/__overlay__/board-thmzone";
		bq2560x_chg = "/fragment@8/__overlay__/charger@6b";
		dcdc_ctrl0 = "/fragment@12/__overlay__/dcdc-controller@0";
		dcdc_ctrl1 = "/fragment@12/__overlay__/dcdc-controller@1";
		dummy_timing0 = "/fragment/__overlay__/lcds/lcd_dummy_mipi_hd/display-timings/timing0";
		eic_dbc2 = "/fragment@13/__overlay__/extint2";
		fan53555_dcdc = "/fragment@9/__overlay__/regulator@60";
		fb_reserved = "/fragment@21/__overlay__/framebuffer@ff4ee000";
		fd_reserved = "/fragment@21/__overlay__/faceid-mem@fefee000";
		ft8006s_boe_timing0 = "/fragment/__overlay__/lcds/lcd_ft8006s_boe_mipi_hd/display-timings/timing0";
		ft8006saa_truly_timing0 = "/fragment/__overlay__/lcds/lcd_ft8006saa_truly_mipi_hd/display-timings/timing0";
		ft8615_inx_timing0 = "/fragment/__overlay__/lcds/lcd_ft8615_inx_mipi_hd/display-timings/timing0";
		ft8722_boe_timing0 = "/fragment/__overlay__/lcds/lcd_ft8722_boe_mipi_hd/display-timings/timing0";
		gpio_121 = "/fragment@13/__overlay__/keyout0";
		gpio_122 = "/fragment@13/__overlay__/keyout1";
		gpio_123 = "/fragment@13/__overlay__/keyout2";
		gpio_124 = "/fragment@13/__overlay__/keyin0";
		gpio_125 = "/fragment@13/__overlay__/keyin1";
		gpio_126 = "/fragment@13/__overlay__/keyin2";
		gpio_144 = "/fragment@13/__overlay__/extint0";
		gpio_145 = "/fragment@13/__overlay__/extint1";
		gpio_146 = "/fragment@13/__overlay__/scl3";
		gpio_147 = "/fragment@13/__overlay__/sda3";
		gpio_62 = "/fragment@13/__overlay__/keyoutnew1";
		gpio_pwm = "/fragment@13/__overlay__/keyoutnew2";
		hwdvfs_cluster0 = "/fragment@12/__overlay__/cluster@0";
		hwdvfs_cluster1 = "/fragment@12/__overlay__/cluster@1";
		hwdvfs_dsu = "/fragment@12/__overlay__/dsu@0";
		hwinfo = "/fragment/__overlay__/HardwareInfo";
		hx83112a_boe_timing0 = "/fragment/__overlay__/lcds/lcd_hx83112a_boe_mipi_hd/display-timings/timing0";
		hx83112a_inx_timing0 = "/fragment/__overlay__/lcds/lcd_hx83112a_inx_mipi_hd/display-timings/timing0";
		icnl9911C_truly_timing0 = "/fragment/__overlay__/lcds/lcd_icnl9911C_truly_mipi_hd/display-timings/timing0";
		jd9365t_ctc_timing0 = "/fragment/__overlay__/lcds/lcd_jd9365t_ctc_mipi_hd/display-timings/timing0";
		lcd_ILI9882N_boe_mipi_hd = "/fragment/__overlay__/lcds/lcd_ILI9882N_boe_mipi_hd";
		lcd_dummy_mipi_hd = "/fragment/__overlay__/lcds/lcd_dummy_mipi_hd";
		lcd_ft8006s_boe_mipi_hd = "/fragment/__overlay__/lcds/lcd_ft8006s_boe_mipi_hd";
		lcd_ft8006saa_truly_mipi_hd = "/fragment/__overlay__/lcds/lcd_ft8006saa_truly_mipi_hd";
		lcd_ft8615_inx_mipi_hd = "/fragment/__overlay__/lcds/lcd_ft8615_inx_mipi_hd";
		lcd_ft8722_boe_mipi_hd = "/fragment/__overlay__/lcds/lcd_ft8722_boe_mipi_hd";
		lcd_hx83112a_boe_mipi_hd = "/fragment/__overlay__/lcds/lcd_hx83112a_boe_mipi_hd";
		lcd_hx83112a_inx_mipi_hd = "/fragment/__overlay__/lcds/lcd_hx83112a_inx_mipi_hd";
		lcd_icnl9911C_truly_mipi_hd = "/fragment/__overlay__/lcds/lcd_icnl9911C_truly_mipi_hd";
		lcd_jd9365t_ctc_mipi_hd = "/fragment/__overlay__/lcds/lcd_jd9365t_ctc_mipi_hd";
		lcd_nt35532_truly_mipi_fhd = "/fragment/__overlay__/lcds/lcd_nt35532_truly_mipi_fhd";
		lcd_nt35596_boe_mipi_fhd = "/fragment/__overlay__/lcds/lcd_nt35596_boe_mipi_fhd";
		lcd_nt35695_truly_mipi_fhd = "/fragment/__overlay__/lcds/lcd_nt35695_truly_mipi_fhd";
		logo_reserved = "/fragment@21/__overlay__/logobuffer@fd580000";
		nt35532_truly_timing0 = "/fragment/__overlay__/lcds/lcd_nt35532_truly_mipi_fhd/display-timings/timing0";
		nt35596_boe_timing0 = "/fragment/__overlay__/lcds/lcd_nt35596_boe_mipi_fhd/display-timings/timing0";
		nt35695_truly_timing0 = "/fragment/__overlay__/lcds/lcd_nt35695_truly_mipi_fhd/display-timings/timing0";
		oppo_devinfo = "/fragment/__overlay__/oppo_devinfo";
		pn557 = "/fragment@7/__overlay__/pn557@28";
		sensor_main = "/fragment@5/__overlay__/sensor-main@20";
		sensor_sub = "/fragment@6/__overlay__/sensor-sub@4c";
		tboard_thermistor = "/fragment/__overlay__/thermal-sensor";
		vddvbus = "/fragment@8/__overlay__/charger@6b/otg-vbus";
	};

	fragment {
		target-path = [2f 00];

		__overlay__ {

			HardwareInfo {
				compatible = "huaqin,hardware_info";
				phandle = <0x34>;
				sdcard-gpio = <0xffffffff 0x9 0x0>;
				status = "okay";
			};

			battery {
				capacity-temp-table = <0x2d 0x64 0x19 0x64 0xa 0x63 0x0 0x5b 0xfffffff6 0x56 0xffffffec 0x40>;
				charge-cdp-current-microamp = <0x16e360 0x200b20>;
				charge-dcp-current-microamp = <0x200b20 0x2191c0>;
				charge-full-design-microamp-hours = <0x4ac888>;
				charge-sdp-current-microamp = <0x7a120 0x1e8480>;
				charge-term-current-microamp = <0x3a980>;
				charge-unknown-current-microamp = <0x200b20 0x200b20>;
				compatible = "simple-battery";
				constant_charge_voltage_max_microvolt = <0x43ac38>;
				factory-internal-resistance-micro-ohms = <0x1f400>;
				ocv-capacity-celsius = <0x14>;
				ocv-capacity-table-0 = <0x42d948 0x64 0x41fe88 0x5f 0x411fe0 0x5a 0x404138 0x55 0x3f6290 0x50 0x3e8fa0 0x4b 0x3dc868 0x46 0x3d0ce8 0x41 0x3c4998 0x3c 0x3b7a90 0x37 0x3afd90 0x32 0x3a9800 0x2d 0x3a45f8 0x28 0x3a0390 0x23 0x39c510 0x1e 0x397308 0x19 0x392100 0x14 0x38c340 0xf 0x3851f8 0xa 0x382318 0x5 0x33e140 0x0>;
				phandle = <0xe>;
				resistance-temp-table = <0x2d 0x64 0x19 0x64 0xa 0xe1 0x0 0x397 0xfffffff6 0x3d5 0xffffffec 0x449>;
				voltage-min-design-microvolt = <0x34a490>;
				voltage-temp-table = <0x13f45a 0x2bc 0x125e66 0x2ee 0x10b72a 0x320 0xf0bff 0x352 0xd67de 0x384 0xbd3c8 0x3b6 0xa5a3c 0x3e8 0x901a0 0x41a 0x7cb34 0x44c 0x6b75c 0x47e 0x5c5a7 0x4b0 0x4f3d1 0x4e2 0x43e3f 0x514 0x3a2b3 0x546 0x31dea 0x578 0x2ac68 0x5aa 0x24bbb 0x5dc 0x1f982 0x60e 0x1b389 0x640 0x178e4 0x672 0x13d7b 0x6a4 0x11c43 0x6d6 0xf7bf 0x708 0xd894 0x73a 0xbdd7 0x76c 0xa6ac 0x79e 0x92b0 0x7d0>;
			};

			battery2 {
				capacity-temp-table = <0x2d 0x64 0x19 0x64 0xa 0x64 0x0 0x5a 0xfffffff6 0x57 0xffffffec 0x49>;
				charge-cdp-current-microamp = <0x16e360 0x200b20>;
				charge-dcp-current-microamp = <0x200b20 0x2191c0>;
				charge-full-design-microamp-hours = <0x483460>;
				charge-sdp-current-microamp = <0x7a120 0x1e8480>;
				charge-term-current-microamp = <0x3a980>;
				charge-unknown-current-microamp = <0x200b20 0x200b20>;
				compatible = "simple-battery";
				constant_charge_voltage_max_microvolt = <0x43ac38>;
				factory-internal-resistance-micro-ohms = <0x1e078>;
				ocv-capacity-celsius = <0x14>;
				ocv-capacity-table-0 = <0x42c5c0 0x64 0x41faa0 0x5f 0x4123c8 0x5a 0x404138 0x55 0x3f6290 0x50 0x3e8fa0 0x4b 0x3dc868 0x46 0x3d14b8 0x41 0x3c45b0 0x3c 0x3b76a8 0x37 0x3af9a8 0x32 0x3a9418 0x2d 0x3a3e28 0x28 0x39fbc0 0x23 0x39ada0 0x1e 0x394040 0x19 0x38ee38 0x14 0x388c90 0xf 0x382ae8 0xa 0x37f820 0x5 0x33e140 0x0>;
				phandle = <0xf>;
				resistance-temp-table = <0x2d 0x64 0x19 0x64 0xa 0x99 0x0 0x3a5 0xfffffff6 0x3f8 0xffffffec 0x458>;
				voltage-min-design-microvolt = <0x34a490>;
				voltage-temp-table = <0x13f45a 0x2bc 0x125e66 0x2ee 0x10b72a 0x320 0xf0bff 0x352 0xd67de 0x384 0xbd3c8 0x3b6 0xa5a3c 0x3e8 0x901a0 0x41a 0x7cb34 0x44c 0x6b75c 0x47e 0x5c5a7 0x4b0 0x4f3d1 0x4e2 0x43e3f 0x514 0x3a2b3 0x546 0x31dea 0x578 0x2ac68 0x5aa 0x24bbb 0x5dc 0x1f982 0x60e 0x1b389 0x640 0x178e4 0x672 0x13d7b 0x6a4 0x11c43 0x6d6 0xf7bf 0x708 0xd894 0x73a 0xbdd7 0x76c 0xa6ac 0x79e 0x92b0 0x7d0>;
			};

			charger-manager {
				cm-battery-cold = <0xc8>;
				cm-battery-cold-in-minus;
				cm-battery-hot = <0x320>;
				cm-battery-stat = <0x2>;
				cm-battery-temp-diff = <0x64>;
				cm-cap-remap-table = <0x1 0x2 0x3 0x2 0x3 0x2 0x62 0x63 0x2 0x63 0x64 0x3>;
				cm-cdp-jeita-temp-table = <0x3e8 0x3e8 0x0 0x43ac38 0x47e 0x47e 0x155cc0 0x43ac38 0x5aa 0x5aa 0x16e360 0x43ac38 0x5fa 0x5fa 0x155cc0 0x3f04d0>;
				cm-charge-voltage-drop = <0xaae60>;
				cm-charge-voltage-max = <0x7270e0>;
				cm-chargers = "bq2560x_charger";
				cm-charging-max = <0x44aa200>;
				cm-dcp-jeita-temp-table = <0x3e8 0x3e8 0x0 0x43ac38 0x47e 0x47e 0x155cc0 0x43ac38 0x5aa 0x5aa 0x200b20 0x43ac38 0x5fa 0x5fa 0x155cc0 0x3f04d0>;
				cm-discharging-max = <0x2932e0>;
				cm-fuel-gauge = "sc27xx-fgu";
				cm-fullbatt-capacity = <0x64>;
				cm-fullbatt-current = <0x3f7a0>;
				cm-fullbatt-vchkdrop-ms = <0x7530>;
				cm-fullbatt-vchkdrop-volt = <0x124f8>;
				cm-fullbatt-voltage = <0x434a90>;
				cm-name = "battery";
				cm-num-chargers = <0x1>;
				cm-one-cap-time = <0x1e>;
				cm-poll-interval = <0x1388>;
				cm-poll-mode = <0x2>;
				cm-sdp-jeita-temp-table = <0x3e8 0x3e8 0x0 0x43ac38 0x47e 0x47e 0x83d60 0x43ac38 0x5aa 0x5aa 0x83d60 0x43ac38 0x5fa 0x5fa 0x83d60 0x3f04d0>;
				cm-shutdown-voltage = <0x331df0>;
				cm-tickle-time-out = <0x5dc>;
				cm-unknown-jeita-temp-table = <0x3e8 0x3e8 0x0 0x43ac38 0x47e 0x47e 0x155cc0 0x43ac38 0x5aa 0x5aa 0x200b20 0x43ac38 0x5fa 0x5fa 0x155cc0 0x3f04d0>;
				cm-wdt-interval = <0x3c>;
				compatible = "charger-manager";
				io-channel-names = "batt_id-channel";
				io-channels = <0xffffffff 0x3>;
				monitored-battery = <0xe 0xf>;
				status = "okay";

				regulator@0 {
					cm-regulator-name = "vddgen0";

					cable@0 {
						cm-cable-name = "USB";
						extcon = <0xffffffff>;
					};
				};
			};

			fingerprint@0 {
				compatible = "microarray,afs121";
				fpint-gpios = <0xffffffff 0x82 0x0>;
			};

			flash-pwm {
				board_id1 = <0xffffffff 0x22 0x0>;
				board_id2 = <0xffffffff 0x23 0x0>;
				board_id3 = <0xffffffff 0x27 0x0>;
				compatible = "sprd,flash-pwm-ocp8135b";
				flash-en-gpios = <0xffffffff 0x3f 0x0>;
				flash-enm-gpios = <0xffffffff 0x3e 0x0>;
				flash-ic = <0x1fc7>;
				pinctrl-0 = <0x10>;
				pinctrl-1 = <0x11>;
				pinctrl-names = "gpio_pwm", "gpio_62";
				pwms = <0xffffffff 0x2 0xc350>;
				status = "okay";
			};

			gpio-keys {
				compatible = "gpio-keys";
				pinctrl-0 = <0x12>;
				pinctrl-names = "eic_dbc2";

				key-power {
					debounce-interval = <0x2>;
					gpios = <0xffffffff 0x1 0x1>;
					label = "Power Key";
					linux,code = <0x74>;
					wakeup-source;
				};

				key-volumedown {
					debounce-interval = <0x2>;
					gpios = <0xffffffff 0x2 0x1>;
					label = "Volume Down Key";
					linux,code = <0x72>;
					wakeup-source;
				};

				key-volumeup {
					debounce-interval = <0x2>;
					gpios = <0xffffffff 0xa 0x0>;
					label = "Volume Up Key";
					linux,code = <0x73>;
					wakeup-source;
				};
			};

			lcds {

				lcd_ILI9882N_boe_mipi_hd {
					phandle = <0x2d>;
					sprd,dsi-color-format = "rgb888";
					sprd,dsi-lane-number = <0x4>;
					sprd,dsi-work-mode = <0x1>;
					sprd,esd-check-enable = <0x0>;
					sprd,esd-check-mode = <0x1>;
					sprd,esd-check-period = <0x3e8>;
					sprd,height-mm = <0x79>;
					sprd,initial-command = <0x39000004 0xff988201 0x39000002 0x443900 0x20113 0x39000002 0x2103900 0x20320 0x39000002 0x4ca3900 0x20513 0x39000002 0x6103900 0x20720 0x39000002 0x8823900 0x20909 0x39000002 0xab33900 0x20b00 0x39000002 0xc173900 0x20d17 0x39000002 0xe043900 0x20f04 0x39000002 0x100a3900 0x2110a 0x39000002 0x12093900 0x21e0a 0x39000002 0x1f0a3900 0x21682 0x39000002 0x17093900 0x21833 0x39000002 0x19003900 0x21a17 0x39000002 0x1b173900 0x21c04 0x39000002 0x1d043900 0x22009 0x39000002 0x24023900 0x2250b 0x39000002 0x26103900 0x22720 0x39000002 0x2c343900 0x23107 0x39000002 0x322a3900 0x2332a 0x39000002 0x340d3900 0x23528 0x39000002 0x36293900 0x23711 0x39000002 0x38133900 0x23915 0x39000002 0x3a173900 0x23b19 0x39000002 0x3c1b3900 0x23d09 0x39000002 0x3e073900 0x23f07 0x39000002 0x40073900 0x24107 0x39000002 0x42073900 0x24307 0x39000002 0x44073900 0x24507 0x39000002 0x46073900 0x24707 0x39000002 0x482a3900 0x2492a 0x39000002 0x4a0c3900 0x24b28 0x39000002 0x4c293900 0x24d10 0x39000002 0x4e123900 0x24f14 0x39000002 0x50163900 0x25118 0x39000002 0x521a3900 0x25308 0x39000002 0x54073900 0x25507 0x39000002 0x56073900 0x25707 0x39000002 0x58073900 0x25907 0x39000002 0x5a073900 0x25b07 0x39000002 0x5c073900 0x26107 0x39000002 0x622a3900 0x2632a 0x39000002 0x640d3900 0x26528 0x39000002 0x66293900 0x26711 0x39000002 0x68133900 0x26915 0x39000002 0x6a173900 0x26b19 0x39000002 0x6c1b3900 0x26d09 0x39000002 0x6e073900 0x26f07 0x39000002 0x70073900 0x27107 0x39000002 0x72073900 0x27307 0x39000002 0x74073900 0x27507 0x39000002 0x76073900 0x27707 0x39000002 0x782a3900 0x2792a 0x39000002 0x7a0c3900 0x27b28 0x39000002 0x7c293900 0x27d10 0x39000002 0x7e123900 0x27f14 0x39000002 0x80163900 0x28118 0x39000002 0x821a3900 0x28308 0x39000002 0x84073900 0x28507 0x39000002 0x86073900 0x28707 0x39000002 0x88073900 0x28907 0x39000002 0x8a073900 0x28b07 0x39000002 0x8c073900 0x2a001 0x39000002 0xa2003900 0x2a300 0x39000002 0xa4003900 0x2a500 0x39000002 0xa6003900 0x2a700 0x39000002 0xa8003900 0x2a904 0x39000002 0xaa043900 0x2ab00 0x39000002 0xac003900 0x2ad04 0x39000002 0xae043900 0x2b033 0x39000002 0xb1333900 0x2b200 0x39000002 0xb9403900 0x2c3ff 0x39000002 0xca443900 0x2d001 0x39000002 0xd1003900 0x2dc37 0x39000002 0xdd423900 0x2e200 0x39000002 0xe6233900 0x2e754 0x39000002 0xed003900 0x4ff98 0x82023900 0x2f11c 0x39000002 0x4b5a3900 0x250ca 0x39000002 0x51003900 0x2068e 0x39000002 0xba03900 0x20c00 0x39000002 0xd123900 0x20ef2 0x39000002 0x4e113900 0x4ff98 0x82033900 0x288d3 0x39000002 0x89e93900 0x28aec 0x39000002 0x8bef3900 0x2b3eb 0x39000002 0xacfa3900 0x2ade4 0x39000002 0x8ca53900 0x28da9 0x39000002 0x8ead3900 0x28fb3 0x39000002 0x90bb3900 0x291bc 0x39000002 0x92bd3900 0x293bf 0x39000002 0x94c13900 0x295d5 0x39000002 0xb4bf3900 0x2aeda 0x39000002 0x967a3900 0x29789 0x39000002 0x98993900 0x299a5 0x39000002 0x9aae3900 0x29baf 0x39000002 0x9cb03900 0x29db3 0x39000002 0x9eb73900 0x29fcc 0x39000002 0xb5b03900 0x4ff98 0x82053900 0x20301 0x39000002 0x4133900 0x2639c 0x39000002 0x649c3900 0x24600 0x39000002 0x470a3900 0x28577 0x39000002 0x688d3900 0x26993 0x39000002 0x6ac93900 0x26bbb 0x39000002 0xc88d3900 0x2c98d 0x39000002 0xca8d3900 0x2cb8d 0x39000002 0xd0933900 0x2d193 0x39000002 0xd2933900 0x2d393 0x39000004 0xff988206 0x39000002 0xd91f3900 0x2c040 0x39000002 0xc1163900 0x206a4 0x39000004 0xff988207 0x39000002 0xc0013900 0x2cbcf 0x39000002 0xccb03900 0x2cd9d 0x39000002 0xce7e3900 0x4ff98 0x82083900 0x1ce000 0x244c709f 0x50caed18 0x3d9577a9 0xd601aa2e 0x6589b6fe 0xdd115288 0x3ec3900 0x1ce100 0x244c709f 0x50caed18 0x3d9577a9 0xd601aa2e 0x6589b6fe 0xdd115288 0x3ec3900 0x4ff98 0x820a3900 0xaf0000 0x204070b 0xf13171b 0x1e22262a 0x2d313539 0x3d414548 0x4c4f535b 0x626a7988 0x90989fa6 0xaeb5bdc4 0xccd3dae2 0xeaebedef 0xf0c877b8 0x6c15928c 0x462be7f2 0xa000204 0x70c1014 0x181c1f23 0x272b2f33 0x363b3f43 0x464a4e51 0x555d656d 0x7c8c949c 0xa4acb4bb 0xc3cbd3db 0xe3ebf3f5 0xf7f9fac4 0x10f8c4c4 0xf2db7ea1 0x4a550901 0x104090d 0x1115181c 0x2024282c 0x3034383d 0x4145494d 0x51555961 0x69718191 0x99a1a9b1 0xb8c0c9d0 0xd8e0e8f0 0xf7fafcfd 0xff1945b5 0xfe69506a 0x5e3da60d 0x3390000 0x2800139 0x4ff 0x98820b39 0x29a 0x44390000 0x29b7a39 0x29c 0x3390000 0x29d0339 0x29e 0x70390000 0x29f7039 0x2ab 0xe0390000 0x4ff9882 0xe390000 0x2111039 0x213 0x10390000 0x200a039 0x4ff 0x98820339 0x283 0x20390000 0x2840039 0x4ff 0x98820039 0x253 0x24390000 0x2550139 0x235 0x397800 0x2110039 0x351 0xfff3900 0x25324 0x390a0002 0x55003932 0x22900>;
					sprd,phy-bit-clock = <0xa8b38>;
					sprd,phy-escape-clock = <0x4e20>;
					sprd,reset-off-sequence = <0x1 0x5>;
					sprd,reset-on-sequence = <0x1 0x1 0x0 0x1 0x1 0xa>;
					sprd,sleep-in-command = [15 5a 00 01 28 15 3c 00 01 10];
					sprd,sleep-out-command = [15 78 00 01 11 15 14 00 01 29];
					sprd,use-dcs-write;
					sprd,width-mm = <0x44>;

					display-timings {
						native-mode = <0x7>;

						timing0 {
							clock-frequency = <0x5b8d800>;
							hactive = <0x2d0>;
							hback-porch = <0x64>;
							hfront-porch = <0x64>;
							hsync-len = <0x8>;
							phandle = <0x7>;
							vactive = <0x640>;
							vback-porch = <0x10>;
							vfront-porch = <0xf2>;
							vsync-len = <0x2>;
						};
					};

					oled-backlight {
						brightness-levels = [39 00 00 03 51 00 04];
						default-brightness = <0x51a>;
						sprd,max-level = <0xfff>;
					};
				};

				lcd_dummy_mipi_hd {
					phandle = <0x33>;
					sprd,dsi-color-format = "rgb888";
					sprd,dsi-lane-number = <0x4>;
					sprd,dsi-work-mode = <0x1>;
					sprd,initial-command = [13 78 00 01 11 13 64 00 01 29];
					sprd,sleep-in-command = [13 0a 00 01 28 13 78 00 01 10];
					sprd,sleep-out-command = [13 78 00 01 11 13 64 00 01 29];

					display-timings {
						native-mode = <0xd>;

						timing0 {
							clock-frequency = <0x493e000>;
							hactive = <0x2d0>;
							hback-porch = <0x3c>;
							hfront-porch = <0x50>;
							hsync-len = <0x3c>;
							phandle = <0xd>;
							vactive = <0x500>;
							vback-porch = <0xc>;
							vfront-porch = <0x26>;
							vsync-len = <0x4>;
						};
					};
				};

				lcd_ft8006s_boe_mipi_hd {
					phandle = <0x2b>;
					sprd,dsi-color-format = "rgb888";
					sprd,dsi-lane-number = <0x4>;
					sprd,dsi-work-mode = <0x1>;
					sprd,esd-check-enable = <0x1>;
					sprd,esd-check-mode = <0x1>;
					sprd,esd-check-period = <0x7d0>;
					sprd,height-mm = <0x97>;
					sprd,initial-command = <0x39000002 0x415a3900 0x3415a 0x24390000 0x2905a39 0x341 0x5a083900 0x480c8 0x2c013900 0x3415a 0x9390000 0x11805a51 0xb52a6ce5 0x4a014062 0xf822008 0xf0b73900 0x119000 0x24420ae3 0x91a4f069 0x43552037 0xc1260039 0x11a0 0x51555500 0xa04c0611 0xd6000ff 0xff03a5e6 0x39000011 0xb0083a12 0x640b0000 0x11006000 0xffff03ff 0x34390000 0x9c00cff 0x189f0f00 0x8003900 0x3415a 0xa390000 0x1180ff83 0x7030019 0x2b405569 0x71a69dd6 0x622e3900 0x119073 0x4a473727 0x1b0e0b00 0x192b4055 0x6971a639 0xea0 0x9dd6622e 0x734a4737 0x271b0e0b 0x390000 0x3415a0b 0x39000011 0x80000020 0x44080060 0x47000010 0x220400b0 0x23390000 0x3901500 0x39000003 0x415a0c39 0x1180 0xfa686801 0x3237d007 0x601500 0x50155651 0x39000011 0x90155561 0x15006015 0x501556 0x51155561 0x95390000 0x11a0ab18 0x50005 0x5804c 0x29845201 0x9003900 0x3b000 0x390000 0x3415a0d 0x39000008 0x80f0b171 0xef4bc080 0x39000003 0x415a0e39 0x980 0xff015555 0x3288881c 0x39000003 0x415a0f39 0x1180 0xbd077060 0x11d06308 0x52518849 0x3524c4c 0x39000011 0x90686868 0x4c4c7c14 0x2006c2 0x4060c 0x390000 0x5a00092 0x3900 0x3415a 0x10390000 0x11800000 0x3e71f17 0x104880aa 0xd0183088 0x418a3900 0x109039 0x28a9c59a 0x7bf0077e 0xe0077e20 0x10003900 0x3415a 0x11390000 0x11804677 0x340caf3 0xffa32008 0xc406a1d8 0x24183900 0x119030 0xc666c180 0x5115cbe5 0xd2686c36 0x1d04c839 0x11a0 0xb0d98860 0xb081401a 0x1b486303 0xb9001c80 0x39000011 0xb0503000 0xe0e10100 0x280e0643 0x55555555 0x55390000 0x11c09588 0x88888888 0xc80884c6 0xe3810020 0x213900 0x11d042 0x88200910 0x408024 0x31044126 0x49922439 0x11e0 0x49002049 0x92040000 0x9204 0x85110c 0x39000010 0xf0000040 0x0 0x5e4a0178 0x80000 0x39000003 0x415a1239 0x1180 0x0 0x20300 0x2 0x3014137 0x39000011 0x90f1e700 0x0 0x0 0x2d23 0x5390000 0x8a0fb08 0x2d2305fb 0xc390000 0x3415a13 0x39000011 0x80fd0f00 0xc000000 0x10801 0x1c440cce 0xe7390000 0xf90620e 0x2498ac21 0x100d093 0x24490620 0x39000003 0x415a1439 0x1180 0xc1024136 0xe1eff7fb 0xfd7e0000 0x90c581 0x39000011 0x90402020 0x6040201 0x1be9f108 0x990c 0x4390000 0x11a000c8 0x64600000 0x20 0x8ba85526 0x3203900 0x11b0a2 0x49990c00 0x0 0x6432262b 0x40a139 0x11c0 0x50382302 0x3c80511c 0xe7438007 0x308ae36c 0x39000011 0xd008f000 0x46719c0b 0x11ec028 0xe77e17f 0xcf390000 0x11e019c5 0xe126fcef 0x19a338dc 0x83ff3d63 0x14873900 0x11f05b 0xf0bf678c 0xe21801bf 0xdf080000 0x39 0x341 0x5a153900 0x118000 0x0 0x0 0x8e 0xd9e0f739 0x1190 0x530020cb 0x442c9301 0x5c31 0x6af1410a 0x39000011 0xa0780000 0x0 0x0 0x0 0x90390000 0x11b0d512 0x53284ec4 0x32191200 0xf0008896 0x24213900 0x11c0ec 0x341ca34 0x9c05ad7 0xb66ddbb6 0x6d495239 0x11d0 0xfa3010a4 0x4c5330ac 0x756ddbb6 0x6ddb9624 0x39000011 0xe025ec03 0x41ca340d 0xc15adbb6 0x6ddbb66d 0x49390000 0x11f012fa 0x3010a44c 0x1320acb5 0x6ddbb66d 0x5bc03900 0x3415a 0x16390000 0x1180c343 0x41010000 0x0 0x0 0x3900 0x79000 0x50 0x21390000 0x3415a18 0x39000011 0x80efbdf7 0xde7befbd 0x708080a 0xc0c0c0c 0xc390000 0x11900c0c 0xc5c09a8 0xaaaaaaaa 0xaaaaaaaa 0xaa5a3900 0x11a059 0x59595959 0x59595959 0x59590904 0xff008039 0x10b0 0x80000420 0x10840 0x21080 0x40039 0x341 0x5a193900 0x118091 0x8d8a8a87 0x87858383 0x828180ff 0xdf4caa39 0x1190 0xf7ef28d3 0xaf8d0dff 0xafb5710e 0x6c4a6908 0x39000005 0xa0000008 0x390000 0x3415a1a 0x39000011 0x80000408 0xc001014 0x181c0020 0x28303800 0x40390000 0x11904850 0x58006067 0x6f77fc80 0x88909800 0xa0a83900 0x11a0b0 0xb840c0c8 0xd0d855e0 0xe8f0f815 0xfcfeff39 0x11b0 0x408 0xc001014 0x181c0020 0x28303800 0x39000011 0xc0404850 0x58546068 0x70785580 0x88909855 0xa0390000 0x11d0a8b0 0xb855c0c8 0xd0d801e0 0xe8f0f7c0 0xfbfd3900 0x11e0fe 0x3f000307 0xbbc0f13 0x171b161f 0x262e3639 0x11f0 0x6c3d454d 0x551b5c64 0x6c741b7b 0x838b93af 0x39000003 0x415a1b39 0x1180 0x9ba3abb3 0x55bbc3cb 0xd3e9dce4 0xedf5c8fa 0x39000005 0x90fcfe0d 0x390000 0x3415a20 0x39000008 0x807a0000 0x0 0x39000003 0x415a2239 0xe80 0x2dd30055 0x55015555 0x155559f 0x390000 0x3415a23 0x39000011 0x80010500 0x5000000 0x0 0x0 0x1390000 0xd90ff0f 0x3 0xff 0x7353900 0x3415a 0x24390000 0x11800003 0xffff20 0x0 0x0 0xda5a3900 0x11905a 0x5a5a5500 0x0 0x0 0x39 0x242 0x24390000 0x2900039 0x341 0x5a2f3900 0x3900f 0xa390000 0x2940139 0x219 0x1390000 0x24c0305 0x78000111 0x39000003 0x51000039 0x253 0x24390a00 0x2550005 0x129>;
					sprd,phy-bit-clock = <0xa1220>;
					sprd,phy-escape-clock = <0x4e20>;
					sprd,reset-off-sequence = <0x1 0x5>;
					sprd,reset-on-sequence = <0x1 0x5 0x0 0x5 0x1 0x28>;
					sprd,sleep-in-command = [15 5a 00 01 28 15 5f 00 01 10 29 00 00 02 17 5a 29 14 00 02 18 5a];
					sprd,sleep-out-command = [15 78 00 01 11 15 14 00 01 29];
					sprd,use-dcs-write;
					sprd,width-mm = <0x44>;

					display-timings {
						native-mode = <0x5>;

						timing0 {
							clock-frequency = <0x5b8d800>;
							hactive = <0x2d0>;
							hback-porch = <0x44>;
							hfront-porch = <0x37>;
							hsync-len = <0xe>;
							phandle = <0x5>;
							vactive = <0x640>;
							vback-porch = <0x6e>;
							vfront-porch = <0x8c>;
							vsync-len = <0x8>;
						};
					};

					oled-backlight {
						brightness-levels = [39 00 00 03 51 00 04];
						default-brightness = <0x51a>;
						sprd,max-level = <0xfff>;
					};
				};

				lcd_ft8006saa_truly_mipi_hd {
					phandle = <0x2e>;
					sprd,cabc-off-command = [23 00 00 02 55 00];
					sprd,cabc-still-image-command = [23 00 00 02 55 02];
					sprd,cabc-ui-command = [23 00 00 02 55 01];
					sprd,cabc-video-command = [23 00 00 02 55 03];
					sprd,dsi-color-format = "rgb888";
					sprd,dsi-lane-number = <0x4>;
					sprd,dsi-work-mode = <0x1>;
					sprd,esd-check-enable = <0x1>;
					sprd,esd-check-mode = <0x1>;
					sprd,esd-check-period = <0x7d0>;
					sprd,height-mm = <0x97>;
					sprd,initial-command = [39 00 00 02 41 5a 39 00 00 03 41 5a 24 39 00 00 02 90 5a 39 00 00 03 41 5a 08 39 00 00 04 80 c8 2c 01 39 00 00 03 41 5a 09 39 00 00 11 80 5a 51 b5 2a 6c e5 4a 01 40 62 0f 82 20 08 f0 b7 39 00 00 11 90 00 24 42 0a e3 91 a4 f0 ae b9 66 20 19 a1 26 00 39 00 00 11 a0 51 55 55 00 a0 4d 06 11 0d 60 00 ff ff 03 a5 e6 39 00 00 11 b0 08 3a 12 64 0b 00 00 11 00 60 00 ff ff 03 ff 34 39 00 00 09 c0 0c ff 18 9f 0f 00 08 00 39 00 00 03 41 5a 0b 39 00 00 11 80 00 00 20 44 08 00 60 47 00 00 10 22 04 00 b0 23 39 00 00 03 90 15 00 39 00 00 03 41 5a 0c 39 00 00 11 80 ba 68 68 01 32 74 d0 07 00 60 15 00 50 15 56 51 39 00 00 11 90 15 55 61 15 00 60 15 00 50 15 56 51 15 55 61 95 39 00 00 11 a0 ab 18 00 05 00 05 00 05 00 49 29 84 52 01 09 00 39 00 00 03 b0 00 00 39 00 00 03 41 5a 0d 39 00 00 08 80 f0 b1 71 ef 4b c0 80 39 00 00 03 41 5a 0e 39 00 00 09 80 ff 01 55 55 23 88 88 1c 39 00 00 03 41 5a 0f 39 00 00 11 80 bd 07 70 c0 12 08 64 08 52 51 58 49 03 52 4c 4c 39 00 00 11 90 68 68 68 4c 4c 7c 14 00 20 06 c2 00 04 06 0c 00 39 00 00 05 a0 00 92 00 00 39 00 00 03 41 5a 10 39 00 00 11 80 00 00 03 e7 1f 17 10 48 80 aa d0 18 30 88 41 8a 39 00 00 10 90 39 28 a9 c5 9a 7b f0 07 7e e0 07 7e 20 10 00 39 00 00 03 41 5a 11 39 00 00 11 80 46 77 03 40 ca f3 ff 83 30 08 c4 06 a1 d8 24 18 39 00 00 11 90 30 c6 66 c1 80 31 15 cb e5 d2 68 6c 36 1d 04 c8 39 00 00 11 a0 b0 d9 88 60 b0 81 40 1a 1b 48 63 03 b9 00 1c 80 39 00 00 11 b0 50 30 00 e0 e1 01 00 28 0e 06 43 55 55 55 55 55 39 00 00 11 c0 95 88 88 88 88 88 c8 08 86 c6 e3 81 00 20 00 21 39 00 00 11 d0 42 88 00 00 00 00 40 00 00 31 04 41 06 00 00 00 39 00 00 11 e0 00 92 04 00 92 04 00 00 00 00 92 04 00 85 11 0c 39 00 00 10 f0 00 00 40 00 00 00 00 5e 4a 01 78 00 08 00 00 39 00 00 03 41 5a 12 39 00 00 11 80 00 00 00 00 00 02 03 00 00 00 00 02 03 01 41 37 39 00 00 11 90 f1 e7 00 00 00 00 00 00 00 00 00 00 00 2d 23 05 39 00 00 08 a0 fb 08 2d 23 05 fb 0c 39 00 00 03 41 5a 13 39 00 00 11 80 fd 0f 00 0c 00 00 00 00 01 08 01 1c 44 0c ce e7 39 00 00 0f 90 62 0e 24 98 ac 21 01 00 d0 93 24 49 06 20 39 00 00 03 41 5a 14 39 00 00 11 80 01 02 41 36 e9 ef f7 fb fd 7e 01 00 00 90 c5 87 39 00 00 11 90 c7 3c 20 36 3c e6 01 71 e1 31 0f 88 09 8f 79 c0 39 00 00 11 a0 36 98 cd 04 36 c2 6c 26 00 f8 82 b5 e2 f7 47 00 39 00 00 11 b0 d8 89 df 1f 01 00 00 00 00 1c b2 21 2b 00 40 a1 39 00 00 11 c0 50 78 07 1e f3 80 51 1c 6f c0 63 1e 30 8a e3 05 39 00 00 11 d0 78 cc 03 46 71 bc 02 8f 79 c0 28 8e 77 e1 31 0f 39 00 00 11 e0 18 c5 f1 26 3c e6 01 a3 38 de 83 c7 3c 60 14 c7 39 00 00 11 f0 5b f0 98 07 8c e2 18 01 bf df 08 00 00 00 00 00 39 00 00 03 41 5a 15 39 00 00 11 80 00 00 00 00 00 00 00 00 00 00 00 00 52 d9 e0 f7 39 00 00 11 90 a3 00 25 5b c5 a8 c5 03 00 00 5c 31 6a f1 41 8c 39 00 00 11 a0 78 00 00 00 00 00 00 00 00 00 00 00 00 00 00 00 39 00 00 11 b0 00 00 00 00 00 00 00 00 13 00 f0 00 14 cc 34 41 39 00 00 11 c0 13 a2 54 15 41 18 06 00 08 a2 6d db b6 6d db b6 39 00 00 11 d0 6d db b6 6d db b6 6d db b6 6d db b6 6d 5b cd 34 39 00 00 11 e0 41 53 b2 54 55 51 1c 47 10 0c a3 6d db b6 6d db 39 00 00 11 f0 b6 6d db b6 6d db b6 6d db b6 6d db b6 6d 5b 92 39 00 00 03 41 5a 16 39 00 00 11 80 82 82 82 02 00 00 00 00 00 00 00 00 00 00 00 00 39 00 00 07 90 00 00 00 00 f0 20 39 00 00 03 41 5a 18 39 00 00 11 80 b0 31 97 98 a4 f1 b1 65 08 08 4a 4b 2b cb ab 35 39 00 00 11 90 47 fd 5c 7c 09 88 5a aa 39 69 69 76 07 cc 1b fb 39 00 00 11 a0 88 b8 c7 67 f6 f5 35 c7 a7 4a aa 0a 04 ff 00 80 39 00 00 10 b0 80 00 04 20 00 01 08 40 00 02 10 80 00 04 00 39 00 00 03 41 5a 19 39 00 00 11 80 c0 af a3 9b 92 8d 8a 86 84 83 82 81 00 50 f6 cf 39 00 00 11 90 fc 2f f3 ef cf bf 0f ff af b5 71 0e 6c 4a 69 08 39 00 00 05 a0 00 00 08 00 39 00 00 03 41 5a 1a 39 00 00 11 80 00 04 08 0c 00 10 14 18 1c 00 20 28 30 38 00 40 39 00 00 11 90 48 50 58 00 60 68 70 78 00 80 88 90 98 00 a0 a8 39 00 00 11 a0 b0 b8 00 c0 c8 d0 d8 00 e0 e8 f0 f8 00 fc fe ff 39 00 00 11 b0 00 00 04 08 0c 00 10 14 18 1c 00 20 28 30 38 00 39 00 00 11 c0 40 48 50 58 00 60 68 70 78 00 80 88 90 98 00 a0 39 00 00 11 d0 a8 b0 b8 00 c0 c8 d0 d8 00 e0 e8 f0 f8 00 fc fe 39 00 00 11 e0 ff 00 00 04 08 0c 00 10 14 18 1c 00 20 28 30 38 39 00 00 11 f0 00 40 48 50 58 00 60 68 70 78 00 80 88 90 98 00 39 00 00 03 41 5a 1b 39 00 00 11 80 a0 a8 b0 b8 00 c0 c8 d0 d8 00 e0 e8 f0 f8 00 fc 39 00 00 05 90 fe ff 00 00 39 00 00 03 41 5a 20 39 00 00 08 80 81 00 00 00 00 00 00 39 00 00 03 41 5a 22 39 00 00 0e 80 2d d3 00 55 55 55 55 55 55 55 55 9f 00 39 00 00 03 41 5a 23 39 00 00 11 80 01 05 00 05 00 00 00 00 00 00 00 00 00 00 00 00 39 00 00 0d 90 ff 0f 00 00 00 03 00 00 00 ff 07 35 39 00 00 03 41 5a 24 39 00 00 11 80 00 03 00 ff ff 20 00 00 00 00 00 00 00 00 16 92 39 00 00 11 90 5a 5a 5a 55 00 00 00 00 00 00 00 00 00 00 00 00 39 00 00 02 42 24 39 00 00 02 90 00 39 00 00 03 41 5a 2f 39 00 00 02 19 00 39 00 00 03 90 0f 0a 39 00 00 02 94 01 39 00 00 02 4c 03 05 78 00 01 11 39 00 00 03 51 00 00 39 00 00 02 53 24 39 0a 00 02 55 00 05 14 00 01 29];
					sprd,phy-bit-clock = <0xa8b38>;
					sprd,phy-escape-clock = <0x4e20>;
					sprd,reset-off-sequence = <0x1 0x5>;
					sprd,reset-on-sequence = <0x1 0x5 0x0 0x5 0x1 0x28>;
					sprd,sleep-in-command = [15 5a 00 01 28 15 3c 00 01 10 29 00 00 02 17 5a 29 14 00 02 18 5a];
					sprd,sleep-out-command = [15 78 00 01 11 15 14 00 01 29];
					sprd,use-dcs-write;
					sprd,width-mm = <0x44>;

					display-timings {
						native-mode = <0x8>;

						timing0 {
							clock-frequency = <0x5b8d800>;
							hactive = <0x2d0>;
							hback-porch = <0x45>;
							hfront-porch = <0x3c>;
							hsync-len = <0x10>;
							phandle = <0x8>;
							vactive = <0x640>;
							vback-porch = <0x6a>;
							vfront-porch = <0x87>;
							vsync-len = <0x8>;
						};
					};

					oled-backlight {
						brightness-levels = [39 00 00 03 51 00 04];
						default-brightness = <0x51a>;
						sprd,max-level = <0xfff>;
					};
				};

				lcd_ft8615_inx_mipi_hd {
					phandle = <0x2a>;
					sprd,cabc-off-command = [23 00 00 02 55 00];
					sprd,cabc-still-image-command = [23 00 00 02 55 02];
					sprd,cabc-ui-command = [23 00 00 02 55 01];
					sprd,cabc-video-command = [23 00 00 02 55 03];
					sprd,dsi-color-format = "rgb888";
					sprd,dsi-lane-number = <0x4>;
					sprd,dsi-work-mode = <0x1>;
					sprd,esd-check-enable = <0x1>;
					sprd,esd-check-mode = <0x1>;
					sprd,esd-check-period = <0x7d0>;
					sprd,height-mm = <0x97>;
					sprd,initial-command = [39 00 00 02 00 00 39 00 00 04 ff 87 19 01 39 00 00 02 00 80 39 00 00 03 ff 87 19 39 00 00 02 00 a1 39 00 00 07 b3 02 d0 06 40 40 f8 39 00 00 02 00 ca 39 00 00 02 c0 80 39 00 00 02 00 80 39 00 00 09 c2 81 00 01 94 85 01 01 81 39 00 00 02 00 88 39 00 00 05 c2 85 01 01 81 39 00 00 02 00 ea 39 00 00 05 c2 85 01 01 81 39 00 00 02 00 90 39 00 00 09 c2 00 00 01 81 01 00 01 91 39 00 00 02 00 a0 39 00 00 10 c2 00 05 00 01 94 01 05 00 01 94 02 05 00 01 94 39 00 00 02 00 b0 39 00 00 0b c2 03 05 00 01 94 04 05 00 01 94 39 00 00 02 00 e0 39 00 00 07 c2 44 44 40 00 00 00 39 00 00 02 00 80 39 00 00 11 cb 00 01 01 01 fd fd 00 fd 03 00 fd 01 00 00 00 03 39 00 00 02 00 90 39 00 00 11 cb 00 00 0f 00 0f 0f 00 00 ff 00 00 7f 00 00 00 ff 39 00 00 02 00 a0 39 00 00 05 cb 00 00 00 00 39 00 00 02 00 b0 39 00 00 05 cb 51 55 e5 55 39 00 00 02 00 80 39 00 00 11 cc 00 00 00 00 00 00 00 00 00 00 18 17 16 02 06 07 39 00 00 02 00 90 39 00 00 09 cc 08 09 0a 24 25 2a 2a 2a 39 00 00 02 00 80 39 00 00 11 cd 00 00 00 00 00 00 00 00 00 00 18 17 16 02 06 07 39 00 00 02 00 90 39 00 00 09 cd 08 09 0a 24 25 2a 2a 2a 39 00 00 02 00 a0 39 00 00 11 cc 00 00 00 00 00 00 00 00 00 00 18 17 16 02 0a 09 39 00 00 02 00 b0 39 00 00 09 cc 08 07 06 24 25 2a 2a 2a 39 00 00 02 00 a0 39 00 00 11 cd 00 00 00 00 00 00 00 00 00 00 18 17 16 02 0a 09 39 00 00 02 00 b0 39 00 00 09 cd 08 07 06 24 25 2a 2a 2a 39 00 00 02 00 80 39 00 00 07 c0 00 ad 00 51 00 10 39 00 00 02 00 a0 39 00 00 07 c0 01 76 00 2e 00 10 39 00 00 02 00 b0 39 00 00 06 c0 00 ad 01 a8 10 39 00 00 02 00 c1 39 00 00 09 c0 00 f6 00 c1 00 a4 01 22 39 00 00 02 00 d7 39 00 00 07 c0 00 a4 00 55 00 10 39 00 00 02 00 a5 39 00 00 05 c1 00 34 00 02 39 00 00 02 00 82 39 00 00 0e ce 01 09 00 9b 00 9b 00 67 00 67 0d 0e 09 39 00 00 02 00 90 39 00 00 09 ce 00 82 0d 5c 00 82 80 09 39 00 00 02 00 a0 39 00 00 04 ce 00 00 00 39 00 00 02 00 b0 39 00 00 04 ce 11 00 00 39 00 00 02 00 d1 39 00 00 08 ce 00 0a 01 01 00 42 01 39 00 00 02 00 e1 39 00 00 0c ce 08 02 15 02 15 02 15 00 1f 00 46 39 00 00 02 00 f1 39 00 00 0a ce 10 08 0b 00 b9 00 b9 00 e2 39 00 00 02 00 b0 39 00 00 05 cf 00 00 4d 51 39 00 00 02 00 b5 39 00 00 05 cf 03 03 54 58 39 00 00 02 00 c0 39 00 00 05 cf 06 06 27 2b 39 00 00 02 00 c5 39 00 00 05 cf 00 00 08 0c 39 00 00 02 00 90 39 00 00 07 c0 00 ad 00 51 00 10 39 00 00 02 00 83 39 00 00 02 a4 23 39 00 00 02 00 e8 39 00 00 02 c0 40 39 00 00 02 00 85 39 00 00 02 c4 1e 39 00 00 02 00 00 39 00 00 29 e1 00 03 07 0e 00 15 1b 21 27 03 30 36 3c 40 f1 44 4b 51 57 2f 5d 66 6e 77 d2 80 85 8a 91 0d 99 a3 b0 b9 5b c6 d9 eb ff 03 39 00 00 02 00 00 39 00 00 29 e2 00 04 07 10 00 1d 25 2b 32 03 3b 41 47 4b f1 4f 56 5c 63 2f 68 6c 72 77 d2 80 85 8a 91 0d 99 a3 b0 b9 5b c6 d9 eb ff 03 39 00 00 02 00 00 39 00 00 29 e3 00 03 08 0e 00 15 1b 21 29 03 30 36 3c 40 f1 44 4b 51 57 2f 5d 66 6e 77 d2 80 85 8a 91 0d 99 a3 b0 b9 5b c6 d9 eb ff 03 39 00 00 02 00 00 39 00 00 29 e4 00 04 08 10 00 1d 25 2b 34 03 3b 41 47 4b f1 4f 56 5c 62 2f 68 6c 72 77 d2 80 85 8a 91 0d 99 a3 b0 b9 5b c6 d9 eb ff 03 39 00 00 02 00 00 39 00 00 29 e5 00 03 08 0e 00 15 1b 21 29 04 31 37 3c 41 00 44 4b 51 57 ff 5e 66 6e 77 39 80 85 8a 91 0d 99 a3 b0 b9 5b c6 d9 eb ff 03 39 00 00 02 00 00 39 00 00 29 e6 00 04 09 10 01 1d 25 2c 35 04 3d 43 48 4d 00 50 57 5c 62 0c 69 6c 71 78 04 80 84 89 91 7c 99 a3 b0 b9 16 c5 d9 eb ff c5 39 00 00 02 00 82 39 00 00 03 c5 50 50 39 00 00 02 00 86 39 00 00 02 c5 60 39 00 00 02 00 84 39 00 00 03 c5 32 32 39 00 00 02 00 87 39 00 00 03 c5 60 0c 39 00 00 02 00 00 39 00 00 03 d8 37 37 39 00 00 02 00 a3 39 00 00 02 c5 23 39 00 00 02 00 a9 39 00 00 02 c5 19 39 00 00 02 00 b0 39 00 00 02 f5 00 39 00 00 02 00 e0 39 00 00 02 c5 e0 39 00 00 02 00 86 39 00 00 07 c0 01 01 01 01 29 07 39 00 00 02 00 82 39 00 00 03 a7 11 01 39 00 00 02 00 b0 39 00 00 03 f3 01 fe 39 00 00 02 00 80 39 00 00 02 a7 03 39 00 00 02 00 a0 39 00 00 0d d6 9c ae a1 8e 85 69 66 66 70 75 83 a1 39 00 00 02 00 b0 39 00 00 0d d6 7b 82 81 8e 91 89 84 7e 7a 76 72 76 39 00 00 02 00 c0 39 00 00 0d d6 8e 9b 8e 83 82 6c 6b 6f 78 7d 84 99 39 00 00 02 00 d0 39 00 00 0d d6 7e 81 81 88 8a 87 82 7f 7d 79 79 7b 39 00 00 02 00 e0 39 00 00 0d d6 94 8e 81 72 6d 5b 5f 6e 8c 9d 9d b4 39 00 00 02 00 f0 39 00 00 0d d6 83 81 81 82 89 87 81 7d 7a 78 7c 83 39 00 00 02 00 00 39 00 00 0d d7 80 89 7c 68 62 51 53 6a 77 7f 80 8d 39 00 00 02 00 10 39 00 00 0d d7 7f 82 82 7f 89 89 81 7c 7e 7f 7e 7e 39 00 00 02 91 80 39 00 00 02 00 cb 39 00 00 02 c0 50 39 00 00 02 00 b0 39 00 00 02 ca 01 39 00 00 02 00 b2 39 00 00 02 ca 0c 39 00 00 02 00 b5 39 00 00 02 ca 03 39 00 00 03 51 00 00 39 00 00 02 55 00 05 78 00 01 11 05 00 00 01 29 39 05 00 02 53 2c 39 1e 00 02 35 00];
					sprd,phy-bit-clock = <0xac1e8>;
					sprd,phy-escape-clock = <0x4e20>;
					sprd,reset-off-sequence = <0x1 0x5>;
					sprd,reset-on-sequence = <0x0 0x5 0x1 0x5 0x0 0x5 0x1 0x14>;
					sprd,sleep-in-command = [05 14 00 01 28 05 8c 00 01 10 39 00 00 02 00 00 39 00 00 05 f7 5a a5 95 27];
					sprd,sleep-out-command = [15 78 00 01 11 15 14 00 01 29];
					sprd,use-dcs-write;
					sprd,width-mm = <0x44>;

					display-timings {
						native-mode = <0x4>;

						timing0 {
							clock-frequency = <0x5b8d800>;
							hactive = <0x2d0>;
							hback-porch = <0x28>;
							hfront-porch = <0x92>;
							hsync-len = <0x6>;
							phandle = <0x4>;
							vactive = <0x640>;
							vback-porch = <0x20>;
							vfront-porch = <0x78>;
							vsync-len = <0x4>;
						};
					};

					oled-backlight {
						brightness-levels = [39 00 00 03 51 00 04];
						default-brightness = <0x51a>;
						sprd,max-level = <0xfff>;
					};
				};

				lcd_ft8722_boe_mipi_hd {
					phandle = <0x2f>;
					sprd,cabc-off-command = [23 00 00 02 55 00];
					sprd,cabc-still-image-command = [23 00 00 02 55 02];
					sprd,cabc-ui-command = [23 00 00 02 55 01];
					sprd,cabc-video-command = [23 00 00 02 55 03];
					sprd,dsi-color-format = "rgb888";
					sprd,dsi-lane-number = <0x4>;
					sprd,dsi-work-mode = <0x1>;
					sprd,esd-check-enable = <0x1>;
					sprd,esd-check-mode = <0x1>;
					sprd,esd-check-period = <0x7d0>;
					sprd,height-mm = <0x79>;
					sprd,initial-command = [39 00 00 02 00 00 39 00 00 04 ff 87 22 01 39 00 00 02 00 80 39 00 00 03 ff 87 22 39 00 00 02 00 a1 39 00 00 07 b3 02 d0 06 40 20 98 39 00 00 02 00 82 39 00 00 02 b4 06 39 00 00 02 1c 02 39 00 00 02 00 a1 39 00 00 02 c1 cc 39 00 00 02 00 f6 39 00 00 02 cf 3c 39 00 00 02 00 f1 39 00 00 02 cf 3c 39 00 00 02 00 f7 39 00 00 02 cf 11 39 00 00 02 00 71 39 00 00 06 c0 c8 00 f2 00 2c 39 00 00 02 00 a6 39 00 00 02 c1 02 39 00 00 02 00 e0 39 00 00 02 ce 00 39 00 00 02 00 80 39 00 00 02 ce 00 39 00 00 02 00 d0 39 00 00 09 ce 01 00 0a 01 01 00 e3 01 39 00 00 02 00 e8 39 00 00 05 ce 00 e3 00 e3 39 00 00 02 00 70 39 00 00 05 cf 06 06 3f 43 39 00 00 02 00 c5 39 00 00 05 cf 06 06 41 45 39 00 00 02 00 80 39 00 00 03 c1 33 33 39 00 00 02 00 90 39 00 00 02 c1 02 39 00 00 02 00 f5 39 00 00 02 cf 02 39 00 00 02 00 80 39 00 00 0d c2 83 01 00 82 82 01 00 82 8c 01 00 82 39 00 00 02 00 90 39 00 00 05 c2 00 00 00 00 39 00 00 02 00 a0 39 00 00 10 c2 8a 07 00 00 89 89 08 00 00 89 88 09 00 00 89 39 00 00 02 00 b0 39 00 00 06 c2 87 0a 00 00 89 39 00 00 02 00 e0 39 00 00 05 c2 33 33 00 00 39 00 00 02 00 d0 39 00 00 11 c3 35 30 00 30 35 30 00 30 35 30 00 30 00 00 00 00 39 00 00 02 00 e0 39 00 00 0a c3 35 00 00 00 35 00 00 00 35 39 00 00 02 00 80 39 00 00 11 cb 00 cd cd 00 cd 00 00 cd 02 ce cd 00 cf 00 00 cc 39 00 00 02 00 90 39 00 00 11 cb 00 00 0c 00 0c 00 00 00 00 0c 00 00 00 00 00 00 39 00 00 02 00 a0 39 00 00 09 cb 00 00 00 00 0c c0 30 00 39 00 00 02 00 b0 39 00 00 05 cb 14 41 a4 c0 39 00 00 02 00 c0 39 00 00 05 cb 14 41 a4 c0 39 00 00 02 00 d5 39 00 00 0c cb 83 00 83 83 00 83 83 00 83 83 00 39 00 00 02 00 e0 39 00 00 0e cb 83 83 00 83 83 00 83 83 00 83 83 00 83 39 00 00 02 00 80 39 00 00 11 cc 00 00 00 00 00 00 00 25 25 00 24 29 29 18 17 16 39 00 00 02 00 90 39 00 00 09 cc 07 09 04 26 26 22 24 03 39 00 00 02 00 a0 39 00 00 11 cc 00 00 00 00 00 00 00 25 25 00 24 29 29 18 17 16 39 00 00 02 00 b0 39 00 00 09 cc 08 06 04 26 26 24 22 02 39 00 00 02 00 80 39 00 00 11 cd 00 00 00 00 00 00 00 25 25 00 24 29 29 18 17 16 39 00 00 02 00 90 39 00 00 09 cd 06 08 04 26 26 22 24 02 39 00 00 02 00 a0 39 00 00 11 cd 00 00 00 00 00 00 00 25 25 00 24 29 29 18 17 16 39 00 00 02 00 b0 39 00 00 09 cd 09 07 04 26 26 24 22 03 39 00 00 02 00 86 39 00 00 09 c0 01 00 01 01 3a 3a 3a 04 39 00 00 02 00 96 39 00 00 09 c0 01 00 01 01 3a 3a 3a 04 39 00 00 02 00 a6 39 00 00 09 c0 01 00 01 01 3a 3a 3a 04 39 00 00 02 00 a3 39 00 00 07 ce 01 00 01 01 3a 04 39 00 00 02 00 b3 39 00 00 07 ce 01 00 01 01 3a 04 39 00 00 02 00 76 39 00 00 09 c0 01 00 01 01 3a 3a 3a 04 39 00 00 02 00 82 39 00 00 02 a7 00 39 00 00 02 00 93 39 00 00 02 c5 32 39 00 00 02 00 97 39 00 00 02 c5 32 39 00 00 02 00 9a 39 00 00 02 c5 32 39 00 00 02 00 9c 39 00 00 02 c5 32 39 00 00 02 00 b6 39 00 00 09 c5 0f 0f 0f 0f 1c 1c 00 00 39 00 00 02 00 00 39 00 00 03 d8 2b 2b 39 00 00 02 00 8f 39 00 00 02 c5 20 39 00 00 02 00 88 39 00 00 02 c4 08 39 00 00 02 00 80 39 00 00 02 a7 11 39 00 00 02 00 a0 39 00 00 11 c3 35 01 23 45 21 03 45 00 00 00 21 03 45 01 23 45 39 00 00 02 00 b1 39 00 00 02 f5 1f 39 00 00 02 00 cb 39 00 00 02 c0 51 39 00 00 02 00 94 39 00 00 02 e9 00 39 00 00 02 00 9a 39 00 00 02 c4 11 39 00 00 02 00 95 39 00 00 02 e9 10 39 00 00 02 00 80 39 00 00 02 c5 77 39 00 00 02 00 e8 39 00 00 02 c0 40 39 00 00 02 00 b1 39 00 00 02 c5 4a 39 00 00 02 00 b4 39 00 00 02 c5 4a 39 00 00 02 00 b2 39 00 00 02 c5 39 39 00 00 02 00 b5 39 00 00 02 c5 0e 39 00 00 02 00 9c 39 00 00 02 f5 00 39 00 00 02 00 9e 39 00 00 02 f5 00 39 00 00 02 00 b0 39 00 00 02 c5 d0 39 00 00 02 00 b3 39 00 00 02 c5 d0 39 00 00 02 00 99 39 00 00 02 cf 50 39 00 00 02 00 00 39 00 00 29 e1 00 03 07 0f 15 1a 22 28 33 0e 3c 43 49 4e 07 53 5c 63 6a 8b 72 79 80 89 1e 93 98 9f a6 70 ae b8 c5 cc 50 d5 e0 e7 eb 0e 39 00 00 02 00 30 39 00 00 29 e1 00 03 07 0f 15 1a 22 28 33 0e 3c 43 49 4e 07 53 5c 63 6a 8b 72 79 80 89 1e 93 98 9f a6 70 ae b8 c5 cc 50 d5 e0 e7 eb 0e 39 00 00 02 00 60 39 00 00 29 e1 00 02 07 0f 3d 1a 22 29 33 13 3c 43 49 4e 07 53 5c 63 6a 8b 72 79 80 89 0c 93 98 9e a5 1a ad b7 c4 cb f0 d4 df e6 ea 4a 39 00 00 02 00 90 39 00 00 29 e1 00 02 07 0f 3d 1a 22 29 33 13 3c 43 49 4e 07 53 5c 63 6a 8b 72 79 80 89 0c 93 98 9e a5 1a ad b7 c4 cb f0 d4 df e6 ea 4a 39 00 00 02 00 c0 39 00 00 29 e1 00 03 06 0e 0f 19 21 28 32 52 3b 42 49 4e b2 53 5b 63 6a bb 72 79 80 89 1e 93 99 9f a7 98 af ba c8 d1 e6 de ed f8 ff 78 39 00 00 02 00 f0 39 00 00 11 e1 00 03 06 0e 0f 19 21 28 32 52 3b 42 49 4e b2 53 39 00 00 02 00 00 39 00 00 19 e2 5b 63 6a bb 72 79 80 89 1e 93 99 9f a7 98 af ba c8 d1 e6 de ed f8 ff 78 39 00 00 02 00 e0 39 00 00 02 cf 34 39 00 00 02 00 85 39 00 00 02 a7 00 39 00 00 02 00 80 39 00 00 02 b3 22 39 00 00 02 00 b0 39 00 00 02 b3 00 39 00 00 02 00 83 39 00 00 02 b0 63 39 00 00 02 00 a1 39 00 00 02 b0 02 39 00 00 02 00 a0 39 00 00 0d d6 9b 91 b4 c0 bf ba b6 b4 b2 b4 bb bf 39 00 00 02 00 b0 39 00 00 0d d6 7d 81 83 82 80 80 80 80 7e 7d 7e 7e 39 00 00 02 00 c0 39 00 00 0d d6 a0 8a b7 b7 b6 b2 ab a8 a5 a9 ad b1 39 00 00 02 00 d0 39 00 00 0d d6 7d 80 82 80 80 80 81 80 7f 7f 7e 80 39 00 00 02 00 e0 39 00 00 0d d6 9c 96 8d 92 9a 9b 86 88 8a 98 a0 9d 39 00 00 02 00 f0 39 00 00 0d d6 7f 81 81 7f 7d 80 81 7f 7e 7d 7f 81 39 00 00 02 00 00 39 00 00 0d d7 80 80 7f 80 80 80 76 74 76 80 80 80 39 00 00 02 00 10 39 00 00 0d d7 7f 82 81 7e 80 82 80 7d 7d 80 80 7f 39 00 00 02 91 80 39 00 00 02 00 b0 39 00 00 04 ca 00 02 0c 39 00 00 02 00 00 39 00 00 04 ff ff ff ff 39 00 00 02 35 00 05 78 00 01 11 39 00 00 03 51 00 00 39 00 00 02 53 24 39 0a 00 02 55 00 05 14 00 01 29];
					sprd,phy-bit-clock = <0xa8b38>;
					sprd,phy-escape-clock = <0x4e20>;
					sprd,reset-off-sequence = <0x1 0x5>;
					sprd,reset-on-sequence = <0x0 0x5 0x1 0x5 0x0 0x5 0x1 0x14>;
					sprd,sleep-in-command = [05 14 00 01 28 05 8c 00 01 10 39 00 00 02 00 00 39 00 00 05 f7 5a a5 95 27];
					sprd,sleep-out-command = [15 78 00 01 11 15 14 00 01 29];
					sprd,use-dcs-write;
					sprd,width-mm = <0x44>;

					display-timings {
						native-mode = <0x9>;

						timing0 {
							clock-frequency = <0x5b8d800>;
							hactive = <0x2d0>;
							hback-porch = <0x32>;
							hfront-porch = <0x40>;
							hsync-len = <0xe>;
							phandle = <0x9>;
							vactive = <0x640>;
							vback-porch = <0x24>;
							vfront-porch = <0xf3>;
							vsync-len = <0x8>;
						};
					};

					oled-backlight {
						brightness-levels = [39 00 00 03 51 00 04];
						default-brightness = <0x51a>;
						sprd,max-level = <0xfff>;
					};
				};

				lcd_hx83112a_boe_mipi_hd {
					phandle = <0x28>;
					sprd,dsi-color-format = "rgb888";
					sprd,dsi-lane-number = <0x4>;
					sprd,dsi-work-mode = <0x1>;
					sprd,esd-check-enable = <0x1>;
					sprd,esd-check-mode = <0x1>;
					sprd,esd-check-period = <0x7d0>;
					sprd,height-mm = <0x97>;
					sprd,initial-command = <0x39000004 0xb983112a 0x39000009 0xb1082727 0x80804a4f 0xaa390000 0x10b20002 0x624000 0xf341211 0x40115a3 0x87390000 0x1cb404df 0x4df0000 0x8df0000 0x8df00ff 0xff0000 0xc0f0036 0x80d0f00 0x36390000 0x11ba7323 0x64333333 0x33111000 0x10083d 0x2763900 0x3c022 0x22390000 0x2c10139 0x7c7 0x4e0 0x33003900 0x2e9c3 0x39000003 0xcbd22439 0x2e9 0x3f390000 0x2cc0839 0x3d2 0x2b2b3900 0x30d3c0 0x0 0x1001414 0x3011108 0x8080808 0x32100500 0x32100f 0xf3210 0xf000000 0x0 0x0 0x0 0xea1c3900 0x31d518 0x18181818 0x18181818 0x18181818 0x18c0c0c0 0xc0181840 0x40181818 0x18313130 0x302f2f01 0x30220 0x20c0c0c0 0xc0191940 0x40252439 0x31d6 0x18181818 0x18181818 0x18181818 0x18184040 0x40401818 0x40401818 0x18183131 0x30302f2f 0x2030001 0x20204040 0x40404040 0x19192425 0x3900000d 0xd8aaaaaa 0xaaffeaaa 0xaaaaaaff 0xea390000 0x1ae70f0f 0x1e761e74 0x502014 0x202 0x2051414 0x32b923b9 0x8136939 0x2bd 0x1390000 0x5bf1abf 0x10a3900 0x4b164 0x1093900 0x4cb25 0x11013900 0x3ac1ff 0xf9f5f3ec 0xe7e2d7d1 0xcbc5c0bb 0xb5afa9a3 0x9e988e84 0x7a716860 0x58504943 0x3d362f29 0x231e1913 0xe0a0603 0x2010100 0x2cfe57 0xed3e1546 0xa0b01c40 0x3900000d 0xd8aaaaaf 0xffffffaa 0xaaafffff 0xff390000 0x9e70200 0x6c016e0e 0x480f3900 0x2bd02 0x3900000a 0xb4008912 0x11881212 0x533900 0x3ac1ff 0xfbf7f1ec 0xe7e2d7d2 0xccc6c1bb 0xb5afa9a3 0x9d988d83 0x7a71675f 0x574f4942 0x3c352f29 0x231e1913 0xe0a0603 0x2010100 0x33fbbd96 0xf693bced 0x50b46c40 0x3900000d 0xd8aaaaaf 0xffffffaa 0xaaafffff 0xff390000 0x1ee70000 0x8400100 0x0 0x0 0x0 0x0 0x4007001 0x70020039 0x2bd 0x3390000 0x19d8aaaa 0xaebfaabe 0xaaaaaebf 0xaabeaaaa 0xafffffff 0xaaaaafff 0xffff3900 0x3ac1ff 0xfaf6f0eb 0xe6e1d6d1 0xcbc5bfb9 0xb3ada8a2 0x9c968c82 0x7970675f 0x574f4842 0x3c352f29 0x231e1913 0xe0a0603 0x2010100 0x33e502e8 0x1e956bdd 0x60b46d00 0x39000002 0xbd003900 0x5cf00 0x1400c039 0x1be4 0x2d012c00 0x8001008 0x4040080 0x40e83470 0x98c8ffa5 0xffef1038 0x10003900 0x2bd01 0x39000004 0xcb251101 0x39000002 0xbd003900 0x3ce05 0x10390000 0x3de65588 0x5511aa00 0xee3300a6 0x11 0xaa336633 0xaa3366 0x3300aa33 0x663300aa 0x33663300 0xaa336633 0xaa3366 0x3300aa33 0x663300aa 0x33663300 0xaa336633 0xaa3900 0x6e506 0xe800fd 0x5780001 0x11390000 0x2350039 0x35e 0x43900 0x5c904 0x7290139 0xa000255 0x390000 0x2532405 0x32000129>;
					sprd,phy-bit-clock = <0xa1220>;
					sprd,phy-escape-clock = <0x4e20>;
					sprd,reset-off-sequence = <0x0 0x5>;
					sprd,reset-on-sequence = <0x1 0x5 0x0 0x5 0x1 0x14>;
					sprd,sleep-in-command = [15 32 00 01 28 15 96 00 01 10 29 00 00 02 b0 00 29 14 00 02 b1 01];
					sprd,sleep-out-command = [15 78 00 01 11 15 32 00 01 29 15 01 00 02 b0 00 15 01 00 02 b1 01];
					sprd,use-dcs-write;
					sprd,width-mm = <0x44>;

					display-timings {
						native-mode = <0x2>;

						timing0 {
							clock-frequency = <0x5b8d800>;
							hactive = <0x2d0>;
							hback-porch = <0x48>;
							hfront-porch = <0x64>;
							hsync-len = <0x3c>;
							phandle = <0x2>;
							vactive = <0x640>;
							vback-porch = <0xf>;
							vfront-porch = <0x36>;
							vsync-len = <0x2>;
						};
					};

					oled-backlight {
						brightness-levels = [39 00 00 03 51 00 04];
						default-brightness = <0x51a>;
						sprd,max-level = <0xfff>;
					};
				};

				lcd_hx83112a_inx_mipi_hd {
					phandle = <0x29>;
					sprd,cabc-off-command = [23 00 00 02 55 00];
					sprd,cabc-still-image-command = [23 00 00 02 55 02];
					sprd,cabc-ui-command = [23 00 00 02 55 01];
					sprd,cabc-video-command = [23 00 00 02 55 03];
					sprd,dsi-color-format = "rgb888";
					sprd,dsi-lane-number = <0x4>;
					sprd,dsi-work-mode = <0x1>;
					sprd,esd-check-enable = <0x1>;
					sprd,esd-check-mode = <0x1>;
					sprd,esd-check-period = <0x7d0>;
					sprd,height-mm = <0x97>;
					sprd,initial-command = [39 00 00 04 b9 83 11 2a 39 00 00 05 cf 00 14 00 c0 39 00 00 05 c4 06 04 04 81 39 00 00 02 cc 08 39 00 00 05 c9 04 0a 8c 01 39 00 00 09 b1 08 29 29 80 80 4f 4a aa 39 00 00 10 b2 00 02 00 62 40 00 08 30 14 11 15 00 10 a3 87 39 00 00 03 d2 2c 2c 39 00 00 1c b4 0b c8 0b c8 00 00 0b cd 00 00 0b cd 00 ff 00 ff 00 00 0c 0f 00 30 08 0d 0f 00 30 39 00 00 09 c7 00 00 04 e0 33 00 20 40 39 00 00 2b d3 c0 00 00 00 00 00 00 05 05 04 04 00 1f 0b 0b 0b 0b 32 10 0a 00 0a 32 16 23 06 23 32 10 06 00 06 00 00 00 00 00 00 00 0a 06 4b 39 00 00 02 bd 01 39 00 00 04 cb 25 11 01 39 00 00 02 bd 00 39 00 00 31 d5 18 18 18 18 18 18 18 18 18 18 18 18 18 18 18 18 18 18 18 18 31 31 30 30 2f 2f 20 20 00 00 01 01 02 02 03 03 04 04 40 40 19 19 18 18 18 18 18 18 39 00 00 31 d6 18 18 18 18 18 18 18 18 18 18 18 18 18 18 18 18 18 18 18 18 31 31 30 30 2f 2f 20 20 04 04 03 03 02 02 01 01 00 00 40 40 19 19 18 18 18 18 18 18 39 00 00 19 d8 aa aa aa af fe ea aa aa aa af fe ea aa aa aa aa aa ea aa aa aa aa aa ea 39 00 00 02 bd 01 39 00 00 19 d8 aa aa af ef ff aa aa aa af ef ff aa aa aa af ef ff aa aa aa af ef ff aa 39 00 00 02 bd 02 39 00 00 0d d8 aa aa af ef ff aa aa aa af ef ff aa 39 00 00 02 bd 03 39 00 00 19 d8 aa aa aa af fe ea aa aa aa af fe ea aa aa af ff ff aa aa aa af ff ff aa 39 00 00 02 bd 00 39 00 00 18 e7 0f 0f 1e 72 1e 72 00 50 02 02 00 00 02 02 02 05 14 14 32 b9 23 b9 08 39 00 00 02 bd 01 39 00 00 09 e7 02 00 64 01 6e 0e 4b 0f 39 00 00 02 bd 02 39 00 00 1e e7 00 00 08 00 01 00 00 00 00 00 00 00 00 00 00 00 00 00 00 00 00 00 04 00 00 00 00 02 00 39 00 00 02 bd 00 39 00 00 02 e9 c3 39 00 00 03 cb d2 28 39 00 00 02 e9 3f 39 00 00 02 c1 01 39 00 00 02 bd 01 39 00 00 02 e9 c8 39 00 00 02 d3 81 39 00 00 02 e9 3f 39 00 00 02 bd 00 39 00 00 03 c1 01 00 39 00 00 02 bd 01 39 00 00 3a c1 ff f9 f5 f0 eb e6 e1 d8 d3 cf c9 c4 bf bb b6 b0 ac a7 a2 99 90 87 7f 77 6f 67 60 59 51 4a 44 3e 37 30 29 22 1c 16 0f 09 06 05 02 01 00 34 bd 8a d3 18 7a f8 d8 0b 5a 4e 40 39 00 00 02 bd 02 39 00 00 3a c1 ff f9 f5 f0 eb e6 e1 d8 d3 cf c9 c4 bf bb b6 b0 ac a7 a2 99 90 87 7f 77 6f 67 60 59 51 4a 44 3e 37 30 29 22 1c 16 0f 09 06 05 02 01 00 34 bd 8a d3 18 7a f8 d8 0b 5a 4e 40 39 00 00 02 bd 03 39 00 00 3a c1 ff f9 f5 f0 eb e6 e1 d8 d3 cf c9 c4 bf bb b6 b0 ac a7 a2 99 90 87 7f 77 6f 67 60 59 51 4a 44 3e 37 30 29 22 1c 16 0f 09 06 05 02 01 00 34 bd 8a d3 18 7a f8 d8 0b 5a 4e 40 39 00 00 02 bd 00 39 00 00 03 ce 05 10 39 00 00 3d e6 22 55 22 00 aa 11 22 11 00 aa c0 00 80 c0 6b 33 66 33 00 aa 33 66 33 00 aa 33 66 33 00 aa 33 66 33 00 aa 33 66 33 00 aa 33 66 33 00 aa 33 66 33 00 aa 33 66 33 00 aa 33 66 33 00 aa 39 00 00 0c e5 06 00 05 05 fe 00 00 00 00 00 00 05 78 00 01 11 39 00 00 02 35 00 39 00 00 03 5e 00 04 39 00 00 03 51 00 00 39 00 00 05 c9 04 07 29 01 39 0a 00 02 55 00 39 00 00 02 53 24 05 32 00 01 29];
					sprd,phy-bit-clock = <0xa8b38>;
					sprd,phy-escape-clock = <0x4e20>;
					sprd,reset-off-sequence = <0x0 0x5>;
					sprd,reset-on-sequence = <0x1 0x5 0x0 0x5 0x1 0x14>;
					sprd,sleep-in-command = [15 32 00 01 28 15 96 00 01 10];
					sprd,sleep-out-command = [15 78 00 01 11 15 32 00 01 29];
					sprd,use-dcs-write;
					sprd,width-mm = <0x44>;

					display-timings {
						native-mode = <0x3>;

						timing0 {
							clock-frequency = <0x5b8d800>;
							hactive = <0x2d0>;
							hback-porch = <0x50>;
							hfront-porch = <0x64>;
							hsync-len = <0x31>;
							phandle = <0x3>;
							vactive = <0x640>;
							vback-porch = <0x1e>;
							vfront-porch = <0x32>;
							vsync-len = <0x5>;
						};
					};

					oled-backlight {
						brightness-levels = [39 00 00 03 51 00 04];
						default-brightness = <0x51a>;
						sprd,max-level = <0xfff>;
					};
				};

				lcd_icnl9911C_truly_mipi_hd {
					phandle = <0x2c>;
					sprd,cabc-off-command = [23 00 00 02 55 00];
					sprd,cabc-still-image-command = [23 00 00 02 55 02];
					sprd,cabc-ui-command = [23 00 00 02 55 01];
					sprd,cabc-video-command = [23 00 00 02 55 03];
					sprd,dsi-color-format = "rgb888";
					sprd,dsi-lane-number = <0x4>;
					sprd,dsi-work-mode = <0x1>;
					sprd,esd-check-enable = <0x1>;
					sprd,esd-check-mode = <0x1>;
					sprd,esd-check-period = <0x7d0>;
					sprd,height-mm = <0x97>;
					sprd,initial-command = <0x39000003 0xf05a5939 0x3f1 0xa5a63900 0x1fb087 0x86858488 0x89000033 0x33333300 0x5058005 0xf0504 0x3020102 0x3040000 0x390000 0x1eb15343 0x85000005 0x5800500 0x4085400 0x4440 0x2014002 0x1400201 0x40020139 0x1db5 0x80000c0 0x406c1 0xc10c0c0e 0xe101012 0x12030303 0x303ffff 0xfc000000 0x3900001d 0xb4090000 0xc0000507 0xc1c10d0d 0xf0f1111 0x13130303 0x30303ff 0xfffc0000 0x390000 0x19b80000 0x0 0x0 0x0 0x0 0x0 0x3900 0xebb01 0x509110d 0x191d5525 0x69002125 0x3900000f 0xbc000000 0x220ff 0x31301 0x73330039 0xbbd 0xe9024fcf 0x72a40844 0xae153900 0xbbe73 0x7350320c 0x7743070e 0xe390000 0x9bf0725 0x7257f00 0x11043900 0xac010 0xffffffff 0xff00ff00 0x39000014 0xc1c02020 0x7c045a5a 0x42a4036 0x7cfff 0xffc000c0 0x15000002 0xc2003900 0xbc306 0xff00ff 0x8101 0x390000 0xbc48401 0x2b41003c 0x3032e 0x3900000c 0xc5031cc0 0xc0401042 0x440a0914 0x3900000b 0xc6881620 0x28293364 0x34080415 0x2cb 0x390000 0x6d0800d 0xff0f6315 0x2d2 0x42390000 0x18e1effe 0xfefefeee 0xf02033ff 0x6a90 0xc00d6af0 0x3eff0007 0xd0390000 0x1be03000 0x8088113f 0x2262dfa0 0x4cc01ff 0xf6fff0fd 0xfffdf8f5 0xfcfcfdff 0x3900001c 0xec008080 0x80808080 0x80808080 0x80808080 0x80808080 0x80808080 0x80ffffff 0x3900001c 0xe9113000 0x2232323 0x23232323 0x23232323 0x23232315 0xb0223081 0x0 0x39000003 0xf15a5939 0x3f0 0xa5a61500 0x23500 0x15000002 0x532c1500 0x25500 0x5780001 0x11051400 0x1291500 0x22601>;
					sprd,phy-bit-clock = <0xa1220>;
					sprd,phy-escape-clock = <0x4e20>;
					sprd,reset-off-sequence = <0x1 0x5>;
					sprd,reset-on-sequence = <0x1 0x5 0x0 0x2 0x1 0x14>;
					sprd,sleep-in-command = <0x15000002 0x26080514 0x12805 0x78000110>;
					sprd,sleep-out-command = <0x5780001 0x11051400 0x1291500 0x22601>;
					sprd,use-dcs-write;
					sprd,width-mm = <0x44>;

					display-timings {
						native-mode = <0x6>;

						timing0 {
							clock-frequency = <0x5b8d800>;
							hactive = <0x2d0>;
							hback-porch = <0x5a>;
							hfront-porch = <0x5a>;
							hsync-len = <0x4>;
							phandle = <0x6>;
							vactive = <0x640>;
							vback-porch = <0x20>;
							vfront-porch = <0x7c>;
							vsync-len = <0x4>;
						};
					};

					oled-backlight {
						brightness-levels = [39 00 00 03 51 00 04];
						default-brightness = <0x51a>;
						sprd,max-level = <0xfff>;
					};
				};

				lcd_jd9365t_ctc_mipi_hd {
					phandle = <0x27>;
					sprd,cabc-off-command = [23 00 00 02 55 00];
					sprd,cabc-still-image-command = [23 00 00 02 55 02];
					sprd,cabc-ui-command = [23 00 00 02 55 01];
					sprd,cabc-video-command = [23 00 00 02 55 03];
					sprd,dsi-color-format = "rgb888";
					sprd,dsi-lane-number = <0x4>;
					sprd,dsi-work-mode = <0x1>;
					sprd,esd-check-enable = <0x1>;
					sprd,esd-check-mode = <0x1>;
					sprd,esd-check-period = <0x7d0>;
					sprd,height-mm = <0x97>;
					sprd,initial-command = [39 00 00 04 df 93 83 16 39 00 00 02 de 00 39 00 00 13 b3 10 80 85 00 65 1e 00 00 00 00 64 64 3c 3c 33 11 5a 5a 39 00 00 06 b2 01 23 60 88 24 39 00 00 04 b6 0c 99 ae 39 00 00 04 b9 3c 33 35 39 00 00 08 bb 0c 31 43 64 3c 20 20 39 00 00 03 bd 00 b1 39 00 00 06 c0 00 d5 10 d5 10 39 00 00 2b cb 5e 55 4c 3e 32 2e 20 25 0f 28 27 26 40 2b 31 21 22 15 0b 04 02 5e 55 4c 3e 32 2e 20 25 0f 28 27 26 40 2b 31 21 22 15 0b 04 02 39 00 00 03 cd 10 10 39 00 00 05 bf 5a 3c 33 c3 39 00 00 0e c3 13 00 06 16 99 00 9e 08 16 04 18 08 16 39 00 00 0b c5 30 20 87 00 00 00 00 38 00 11 39 00 00 05 c6 00 b6 d2 14 39 00 00 13 ce 01 3c 00 00 00 3c 00 3c 3f 3f 00 3c 3c 3c 3c 00 3c 3c 39 00 00 11 cf 00 00 00 00 00 00 c0 c0 c0 c0 c0 c0 c0 c0 c0 c0 39 00 00 1e d0 00 1f 1f 1f 1f 1f 1f 15 15 16 1f 05 07 09 0b 1f 01 03 1f 1f 1f 1f 1f 00 00 00 00 00 00 39 00 00 1e d1 00 1f 1f 1f 1f 1f 1f 15 15 16 1f 04 06 08 0a 1f 00 02 1f 1f 1f 1f 1f 00 00 00 00 00 00 39 00 00 1e d2 00 1f 1f 1f 1f 15 1f 1f 15 16 1f 0a 08 06 04 1f 02 00 1f 1f 1f 1f 1f 00 00 00 03 00 00 39 00 00 1e d3 00 1f 1f 1f 1f 15 1f 1f 15 16 1f 0b 09 07 05 1f 03 01 1f 1f 1f 1f 1f 00 00 00 03 00 00 39 00 00 3f d4 30 00 00 07 00 09 00 00 00 00 00 06 06 00 10 26 54 00 04 03 03 00 01 00 04 01 01 11 60 03 00 05 01 01 00 00 06 04 07 06 55 06 53 00 00 00 00 00 00 00 00 00 00 00 00 00 00 00 00 81 03 d4 39 00 00 1c d5 03 10 03 00 01 00 00 00 00 43 00 00 00 07 32 5a 00 48 77 00 02 1e 02 73 00 0e 08 39 00 00 14 d7 00 7c 7c 7c 7c 7c 7c 7c 7c 7c 7c 7c 7c 7c 7c 7c 7c 7c 7c 39 00 00 02 de 01 39 00 00 02 b5 6f 39 00 00 03 c5 22 12 39 00 00 08 c6 3f 0c 00 00 01 80 60 39 00 00 02 de 02 39 00 00 06 b3 20 a0 ea 5f 4b 39 00 00 09 b7 44 00 88 00 03 00 6e 10 39 00 00 02 bd 14 39 00 00 09 c1 00 40 20 00 14 14 14 14 39 00 00 08 c2 42 70 01 01 e0 73 f8 39 00 00 07 c3 20 fb 00 a0 20 62 39 00 00 0b e5 00 e6 e5 02 27 42 27 42 09 00 39 00 00 04 e6 10 20 a9 39 00 00 04 ec 01 7f 22 39 00 00 02 de 03 39 00 00 02 d1 00 39 00 00 02 de 00 39 00 00 02 35 00 39 00 00 03 51 0f ff 39 00 00 02 53 2c 39 00 00 02 de 00 39 32 00 02 55 90 05 96 00 02 11 00 39 00 00 02 de 01 39 00 00 02 b3 06 39 00 00 21 b4 03 45 31 00 28 75 50 1e 1f 21 21 21 1e 1c 1a 1c 1e 21 22 22 22 22 22 22 22 22 21 21 21 21 1f 88 39 32 00 02 de 00 05 14 00 02 29 00];
					sprd,phy-bit-clock = <0xa8b38>;
					sprd,phy-escape-clock = <0x4e20>;
					sprd,reset-off-sequence = <0x0 0x5>;
					sprd,reset-on-sequence = <0x1 0x5 0x0 0xa 0x1 0x78>;
					sprd,sleep-in-command = [15 40 00 01 28 15 78 00 01 10];
					sprd,sleep-out-command = [15 78 00 01 11 15 14 00 01 29];
					sprd,use-dcs-write;
					sprd,width-mm = <0x44>;

					display-timings {
						native-mode = <0x1>;

						timing0 {
							clock-frequency = <0x5b8d800>;
							hactive = <0x2d0>;
							hback-porch = <0x28>;
							hfront-porch = <0x3c>;
							hsync-len = <0x28>;
							phandle = <0x1>;
							vactive = <0x640>;
							vback-porch = <0x20>;
							vfront-porch = <0xd2>;
							vsync-len = <0x2>;
						};
					};

					oled-backlight {
						brightness-levels = [39 00 00 03 51 00 04];
						default-brightness = <0x51a>;
						sprd,max-level = <0xfff>;
					};
				};

				lcd_nt35532_truly_mipi_fhd {
					phandle = <0x31>;
					sprd,dsi-color-format = "rgb888";
					sprd,dsi-lane-number = <0x4>;
					sprd,dsi-work-mode = <0x1>;
					sprd,esd-check-enable = <0x1>;
					sprd,esd-check-mode = <0x1>;
					sprd,height-mm = <0x79>;
					sprd,initial-command = <0x23000002 0xff012300 0x2fb01 0x23000002 0x12300 0x20144 0x23000002 0x2592300 0x2040c 0x23000002 0x52b2300 0x20664 0x23000002 0x7c62300 0x20d89 0x23000002 0xe892300 0x20fe0 0x23000002 0x10032300 0x2115a 0x23000002 0x125a2300 0x2137e 0x23000002 0x147e2300 0x21560 0x23000002 0x16132300 0x21713 0x23000002 0x1ca32300 0x26e80 0x23000002 0x60772300 0x26813 0x23000002 0x75002300 0x27677 0x23000002 0x77002300 0x27878 0x23000002 0x79002300 0x27ab0 0x23000002 0x7b002300 0x27ccc 0x23000002 0x7d002300 0x27ee3 0x23000002 0x7f002300 0x280f6 0x23000002 0x81012300 0x28206 0x23000002 0x83012300 0x28415 0x23000002 0x85012300 0x28622 0x23000002 0x87012300 0x2884e 0x23000002 0x89012300 0x28a71 0x23000002 0x8b012300 0x28ca7 0x23000002 0x8d012300 0x28ed2 0x23000002 0x8f022300 0x29014 0x23000002 0x91022300 0x29249 0x23000002 0x93022300 0x2944b 0x23000002 0x95022300 0x2967d 0x23000002 0x97022300 0x298b6 0x23000002 0x99022300 0x29ad9 0x23000002 0x9b032300 0x29c0d 0x23000002 0x9d032300 0x29e2a 0x23000002 0x9f032300 0x2a051 0x23000002 0xa2032300 0x2a35d 0x23000002 0xa4032300 0x2a56a 0x23000002 0xa6032300 0x2a778 0x23000002 0xa9032300 0x2aa89 0x23000002 0xab032300 0x2ac9e 0x23000002 0xad032300 0x2aeb7 0x23000002 0xaf032300 0x2b0ce 0x23000002 0xb1032300 0x2b2d1 0x23000002 0xb3002300 0x2b418 0x23000002 0xb5002300 0x2b66a 0x23000002 0xb7002300 0x2b8b0 0x23000002 0xb9002300 0x2bacc 0x23000002 0xbb002300 0x2bce3 0x23000002 0xbd002300 0x2bef6 0x23000002 0xbf012300 0x2c006 0x23000002 0xc1012300 0x2c215 0x23000002 0xc3012300 0x2c422 0x23000002 0xc5012300 0x2c64e 0x23000002 0xc7012300 0x2c871 0x23000002 0xc9012300 0x2caa7 0x23000002 0xcb012300 0x2ccd2 0x23000002 0xcd022300 0x2ce14 0x23000002 0xcf022300 0x2d049 0x23000002 0xd1022300 0x2d24b 0x23000002 0xd3022300 0x2d47d 0x23000002 0xd5022300 0x2d6b6 0x23000002 0xd7022300 0x2d8d9 0x23000002 0xd9032300 0x2da0d 0x23000002 0xdb032300 0x2dc2a 0x23000002 0xdd032300 0x2de51 0x23000002 0xdf032300 0x2e05d 0x23000002 0xe1032300 0x2e26a 0x23000002 0xe3032300 0x2e478 0x23000002 0xe5032300 0x2e689 0x23000002 0xe7032300 0x2e89e 0x23000002 0xe9032300 0x2eab7 0x23000002 0xeb032300 0x2ecce 0x23000002 0xed032300 0x2eed1 0x23000002 0xef002300 0x2f077 0x23000002 0xf1002300 0x2f278 0x23000002 0xf3002300 0x2f4b0 0x23000002 0xf5002300 0x2f6cc 0x23000002 0xf7002300 0x2f8e3 0x23000002 0xf9002300 0x2faf6 0x23000002 0xff022300 0x2fb01 0x23000002 0x12300 0x20106 0x23000002 0x2012300 0x20315 0x23000002 0x4012300 0x20522 0x23000002 0x6012300 0x2074e 0x23000002 0x8012300 0x20971 0x23000002 0xa012300 0x20ba7 0x23000002 0xc012300 0x20dd2 0x23000002 0xe022300 0x20f14 0x23000002 0x10022300 0x21149 0x23000002 0x12022300 0x2134b 0x23000002 0x14022300 0x2157d 0x23000002 0x16022300 0x217b6 0x23000002 0x18022300 0x219d9 0x23000002 0x1a032300 0x21b0d 0x23000002 0x1c032300 0x21d2a 0x23000002 0x1e032300 0x21f51 0x23000002 0x20032300 0x2215d 0x23000002 0x22032300 0x2236a 0x23000002 0x24032300 0x22578 0x23000002 0x26032300 0x22789 0x23000002 0x28032300 0x2299e 0x23000002 0x2a032300 0x22bb7 0x23000002 0x2d032300 0x22fce 0x23000002 0x30032300 0x231d1 0x23000002 0x32002300 0x23318 0x23000002 0x34002300 0x2356a 0x23000002 0x36002300 0x237b0 0x23000002 0x38002300 0x239cc 0x23000002 0x3a002300 0x23be3 0x23000002 0x3d002300 0x23ff6 0x23000002 0x40012300 0x24106 0x23000002 0x42012300 0x24315 0x23000002 0x44012300 0x24522 0x23000002 0x46012300 0x2474e 0x23000002 0x48012300 0x24971 0x23000002 0x4a012300 0x24ba7 0x23000002 0x4c012300 0x24dd2 0x23000002 0x4e022300 0x24f14 0x23000002 0x50022300 0x25149 0x23000002 0x52022300 0x2534b 0x23000002 0x54022300 0x2557d 0x23000002 0x56022300 0x258b6 0x23000002 0x59022300 0x25ad9 0x23000002 0x5b032300 0x25c0d 0x23000002 0x5d032300 0x25e2a 0x23000002 0x5f032300 0x26051 0x23000002 0x61032300 0x2625d 0x23000002 0x63032300 0x2646a 0x23000002 0x65032300 0x26678 0x23000002 0x67032300 0x26889 0x23000002 0x69032300 0x26a9e 0x23000002 0x6b032300 0x26cb7 0x23000002 0x6d032300 0x26ece 0x23000002 0x6f032300 0x270d1 0x23000002 0x71002300 0x27277 0x23000002 0x73002300 0x27478 0x23000002 0x75002300 0x276b0 0x23000002 0x77002300 0x278cc 0x23000002 0x79002300 0x27ae3 0x23000002 0x7b002300 0x27cf6 0x23000002 0x7d012300 0x27e06 0x23000002 0x7f012300 0x28015 0x23000002 0x81012300 0x28222 0x23000002 0x83012300 0x2844e 0x23000002 0x85012300 0x28671 0x23000002 0x87012300 0x288a7 0x23000002 0x89012300 0x28ad2 0x23000002 0x8b022300 0x28c14 0x23000002 0x8d022300 0x28e49 0x23000002 0x8f022300 0x2904b 0x23000002 0x91022300 0x2927d 0x23000002 0x93022300 0x294b6 0x23000002 0x95022300 0x296d9 0x23000002 0x97032300 0x2980d 0x23000002 0x99032300 0x29a2a 0x23000002 0x9b032300 0x29c51 0x23000002 0x9d032300 0x29e5d 0x23000002 0x9f032300 0x2a06a 0x23000002 0xa2032300 0x2a378 0x23000002 0xa4032300 0x2a589 0x23000002 0xa6032300 0x2a79e 0x23000002 0xa9032300 0x2aab7 0x23000002 0xab032300 0x2acce 0x23000002 0xad032300 0x2aed1 0x23000002 0xaf002300 0x2b018 0x23000002 0xb1002300 0x2b26a 0x23000002 0xb3002300 0x2b4b0 0x23000002 0xb5002300 0x2b6cc 0x23000002 0xb7002300 0x2b8e3 0x23000002 0xb9002300 0x2baf6 0x23000002 0xbb012300 0x2bc06 0x23000002 0xbd012300 0x2be15 0x23000002 0xbf012300 0x2c022 0x23000002 0xc1012300 0x2c24e 0x23000002 0xc3012300 0x2c471 0x23000002 0xc5012300 0x2c6a7 0x23000002 0xc7012300 0x2c8d2 0x23000002 0xc9022300 0x2ca14 0x23000002 0xcb022300 0x2cc49 0x23000002 0xcd022300 0x2ce4b 0x23000002 0xcf022300 0x2d07d 0x23000002 0xd1022300 0x2d2b6 0x23000002 0xd3022300 0x2d4d9 0x23000002 0xd5032300 0x2d60d 0x23000002 0xd7032300 0x2d82a 0x23000002 0xd9032300 0x2da51 0x23000002 0xdb032300 0x2dc5d 0x23000002 0xdd032300 0x2de6a 0x23000002 0xdf032300 0x2e078 0x23000002 0xe1032300 0x2e289 0x23000002 0xe3032300 0x2e49e 0x23000002 0xe5032300 0x2e6b7 0x23000002 0xe7032300 0x2e8ce 0x23000002 0xe9032300 0x2ead1 0x23000002 0xff052300 0x2fb01 0x23000002 0x382300 0x20138 0x23000002 0x2072300 0x20340 0x23000002 0x4402300 0x20525 0x23000002 0x61d2300 0x20723 0x23000002 0x81b2300 0x20921 0x23000002 0xa192300 0x20b1f 0x23000002 0xc172300 0x20d05 0x23000002 0xe042300 0x20f0f 0x23000002 0x10382300 0x21138 0x23000002 0x12382300 0x21338 0x23000002 0x14382300 0x21538 0x23000002 0x16062300 0x21740 0x23000002 0x18402300 0x21924 0x23000002 0x1a1c2300 0x21b22 0x23000002 0x1c1a2300 0x21d20 0x23000002 0x1e182300 0x21f1e 0x23000002 0x20162300 0x22105 0x23000002 0x22042300 0x2230e 0x23000002 0x24382300 0x22538 0x23000002 0x26382300 0x22738 0x23000002 0x28382300 0x22938 0x23000002 0x2a0e2300 0x22b40 0x23000002 0x2d402300 0x22f16 0x23000002 0x301e2300 0x23118 0x23000002 0x32202300 0x2331a 0x23000002 0x34222300 0x2351c 0x23000002 0x36242300 0x23705 0x23000002 0x38042300 0x23906 0x23000002 0x3a382300 0x23b38 0x23000002 0x3d382300 0x23f38 0x23000002 0x40382300 0x24138 0x23000002 0x420f2300 0x24340 0x23000002 0x44402300 0x24517 0x23000002 0x461f2300 0x24719 0x23000002 0x48212300 0x2491b 0x23000002 0x4a232300 0x24b1d 0x23000002 0x4c252300 0x24d05 0x23000002 0x4e042300 0x24f07 0x23000002 0x50382300 0x25138 0x23000002 0x52382300 0x25338 0x23000002 0x5b0a2300 0x25c0a 0x23000002 0x630a2300 0x26415 0x23000002 0x68242300 0x26924 0x23000002 0x907b2300 0x29110 0x23000002 0x92152300 0x27e10 0x23000002 0x7f102300 0x28000 0x23000002 0x98002300 0x29900 0x23000002 0x542e2300 0x25938 0x23000002 0x5d012300 0x25e27 0x23000002 0x62392300 0x26688 0x23000002 0x67112300 0x26a0e 0x23000002 0x6b202300 0x26c08 0x23000002 0x6d002300 0x27d01 0x23000002 0xb7012300 0x2b80a 0x23000002 0xba132300 0x2bc01 0x23000002 0xbd552300 0x2be38 0x23000002 0xbf442300 0x2cf88 0x23000002 0xc8002300 0x2c955 0x23000002 0xca002300 0x2cb55 0x23000002 0xcca22300 0x2ce88 0x23000002 0xcf882300 0x2d000 0x23000002 0xd1002300 0x2d300 0x23000002 0xd5002300 0x2d622 0x23000002 0xd7312300 0x2d87e 0x23000002 0xff002300 0x2fb01 0x23000002 0xd3242300 0x2d420 0x23000002 0xd55a2300 0x2d650 0x23000002 0xd7002300 0x23500 0x23000002 0xff002300 0x2fb01 0x23000002 0x51ff2300 0x2532c 0x23000002 0x36001378 0x11113 0xa000129>;
					sprd,phy-bit-clock = <0xeb7f8>;
					sprd,phy-escape-clock = <0x4e20>;
					sprd,reset-off-sequence = <0x1 0x5>;
					sprd,reset-on-sequence = <0x1 0x5 0x0 0x5 0x1 0x14>;
					sprd,sleep-in-command = [13 01 00 01 00 13 0a 00 01 28 13 78 00 01 10 23 0a 00 02 4f 01];
					sprd,sleep-out-command = [13 78 00 01 11 13 32 00 01 29];
					sprd,width-mm = <0x44>;

					display-timings {
						native-mode = <0xb>;

						timing0 {
							clock-frequency = <0x927c000>;
							hactive = <0x438>;
							hback-porch = <0x10>;
							hfront-porch = <0xb0>;
							hsync-len = <0xa>;
							phandle = <0xb>;
							vactive = <0x780>;
							vback-porch = <0x20>;
							vfront-porch = <0x20>;
							vsync-len = <0x4>;
						};
					};
				};

				lcd_nt35596_boe_mipi_fhd {
					phandle = <0x32>;
					sprd,dsi-color-format = "rgb888";
					sprd,dsi-lane-number = <0x4>;
					sprd,dsi-work-mode = <0x1>;
					sprd,esd-check-enable = <0x1>;
					sprd,esd-check-mode = <0x1>;
					sprd,esd-check-period = <0x3e8>;
					sprd,height-mm = <0x79>;
					sprd,initial-command = [23 00 00 02 ff ee 23 0a 00 02 18 40 23 14 00 02 18 00 23 00 00 02 ff 01 23 00 00 02 fb 01 23 00 00 02 00 01 23 00 00 02 01 55 23 00 00 02 02 40 23 00 00 02 05 40 23 00 00 02 06 94 23 00 00 02 07 94 23 00 00 02 08 0c 23 00 00 02 11 19 23 00 00 02 12 19 23 00 00 02 13 03 23 00 00 02 14 94 23 00 00 02 15 15 23 00 00 02 16 15 23 00 00 02 6d 22 23 00 00 02 0b af 23 00 00 02 0c af 23 00 00 02 0e ab 23 00 00 02 0f a4 23 00 00 02 58 82 23 00 00 02 59 02 23 00 00 02 5a 02 23 00 00 02 5b 02 23 00 00 02 5c 82 23 00 00 02 5d 82 23 00 00 02 5e 02 23 00 00 02 5f 02 23 00 00 02 75 00 23 00 00 02 76 00 23 00 00 02 77 00 23 00 00 02 78 11 23 00 00 02 79 00 23 00 00 02 7a 30 23 00 00 02 7b 00 23 00 00 02 7c 4a 23 00 00 02 7d 00 23 00 00 02 7e 62 23 00 00 02 7f 00 23 00 00 02 80 78 23 00 00 02 81 00 23 00 00 02 82 8c 23 00 00 02 83 00 23 00 00 02 84 9e 23 00 00 02 85 00 23 00 00 02 86 ae 23 00 00 02 87 00 23 00 00 02 88 e4 23 00 00 02 89 01 23 00 00 02 8a 0e 23 00 00 02 8b 01 23 00 00 02 8c 4c 23 00 00 02 8d 01 23 00 00 02 8e 7b 23 00 00 02 8f 01 23 00 00 02 90 c2 23 00 00 02 91 01 23 00 00 02 92 fb 23 00 00 02 93 01 23 00 00 02 94 fc 23 00 00 02 95 02 23 00 00 02 96 34 23 00 00 02 97 02 23 00 00 02 98 79 23 00 00 02 99 02 23 00 00 02 9a a4 23 00 00 02 9b 02 23 00 00 02 9c dd 23 00 00 02 9d 03 23 00 00 02 9e 05 23 00 00 02 9f 03 23 00 00 02 a0 39 23 00 00 02 a2 03 23 00 00 02 a3 48 23 00 00 02 a4 03 23 00 00 02 a5 58 23 00 00 02 a6 03 23 00 00 02 a7 6a 23 00 00 02 a9 03 23 00 00 02 aa 7f 23 00 00 02 ab 03 23 00 00 02 ac 98 23 00 00 02 ad 03 23 00 00 02 ae b7 23 00 00 02 af 03 23 00 00 02 b0 d7 23 00 00 02 b1 03 23 00 00 02 b2 ff 23 00 00 02 b3 00 23 00 00 02 b4 00 23 00 00 02 b5 00 23 00 00 02 b6 11 23 00 00 02 b7 00 23 00 00 02 b8 30 23 00 00 02 b9 00 23 00 00 02 ba 4a 23 00 00 02 bb 00 23 00 00 02 bc 62 23 00 00 02 bd 00 23 00 00 02 be 78 23 00 00 02 bf 00 23 00 00 02 c0 8c 23 00 00 02 c1 00 23 00 00 02 c2 9e 23 00 00 02 c3 00 23 00 00 02 c4 ae 23 00 00 02 c5 00 23 00 00 02 c6 e4 23 00 00 02 c7 01 23 00 00 02 c8 0e 23 00 00 02 c9 01 23 00 00 02 ca 4c 23 00 00 02 cb 01 23 00 00 02 cc 7b 23 00 00 02 cd 01 23 00 00 02 ce c2 23 00 00 02 cf 01 23 00 00 02 d0 fb 23 00 00 02 d1 01 23 00 00 02 d2 fc 23 00 00 02 d3 02 23 00 00 02 d4 34 23 00 00 02 d5 02 23 00 00 02 d6 79 23 00 00 02 d7 02 23 00 00 02 d8 a4 23 00 00 02 d9 02 23 00 00 02 da dd 23 00 00 02 db 03 23 00 00 02 dc 05 23 00 00 02 dd 03 23 00 00 02 de 39 23 00 00 02 df 03 23 00 00 02 e0 48 23 00 00 02 e1 03 23 00 00 02 e2 58 23 00 00 02 e3 03 23 00 00 02 e4 6a 23 00 00 02 e5 03 23 00 00 02 e6 7f 23 00 00 02 e7 03 23 00 00 02 e8 98 23 00 00 02 e9 03 23 00 00 02 ea b7 23 00 00 02 eb 03 23 00 00 02 ec d7 23 00 00 02 ed 03 23 00 00 02 ee ff 23 00 00 02 ef 00 23 00 00 02 f0 00 23 00 00 02 f1 00 23 00 00 02 f2 11 23 00 00 02 f3 00 23 00 00 02 f4 30 23 00 00 02 f5 00 23 00 00 02 f6 4a 23 00 00 02 f7 00 23 00 00 02 f8 62 23 00 00 02 f9 00 23 00 00 02 fa 78 23 00 00 02 ff 02 23 00 00 02 fb 01 23 00 00 02 00 00 23 00 00 02 01 8c 23 00 00 02 02 00 23 00 00 02 03 9e 23 00 00 02 04 00 23 00 00 02 05 ae 23 00 00 02 06 00 23 00 00 02 07 e4 23 00 00 02 08 01 23 00 00 02 09 0e 23 00 00 02 0a 01 23 00 00 02 0b 4c 23 00 00 02 0c 01 23 00 00 02 0d 7b 23 00 00 02 0e 01 23 00 00 02 0f c2 23 00 00 02 10 01 23 00 00 02 11 fb 23 00 00 02 12 01 23 00 00 02 13 fc 23 00 00 02 14 02 23 00 00 02 15 34 23 00 00 02 16 02 23 00 00 02 17 79 23 00 00 02 18 02 23 00 00 02 19 a4 23 00 00 02 1a 02 23 00 00 02 1b dd 23 00 00 02 1c 03 23 00 00 02 1d 05 23 00 00 02 1e 03 23 00 00 02 1f 39 23 00 00 02 20 03 23 00 00 02 21 48 23 00 00 02 22 03 23 00 00 02 23 58 23 00 00 02 24 03 23 00 00 02 25 6a 23 00 00 02 26 03 23 00 00 02 27 7f 23 00 00 02 28 03 23 00 00 02 29 98 23 00 00 02 2a 03 23 00 00 02 2b b7 23 00 00 02 2d 03 23 00 00 02 2f d7 23 00 00 02 30 03 23 00 00 02 31 ff 23 00 00 02 32 00 23 00 00 02 33 00 23 00 00 02 34 00 23 00 00 02 35 11 23 00 00 02 36 00 23 00 00 02 37 30 23 00 00 02 38 00 23 00 00 02 39 4a 23 00 00 02 3a 00 23 00 00 02 3b 62 23 00 00 02 3d 00 23 00 00 02 3f 78 23 00 00 02 40 00 23 00 00 02 41 8c 23 00 00 02 42 00 23 00 00 02 43 9e 23 00 00 02 44 00 23 00 00 02 45 ae 23 00 00 02 46 00 23 00 00 02 47 e4 23 00 00 02 48 01 23 00 00 02 49 0e 23 00 00 02 4a 01 23 00 00 02 4b 4c 23 00 00 02 4c 01 23 00 00 02 4d 7b 23 00 00 02 4e 01 23 00 00 02 4f c2 23 00 00 02 50 01 23 00 00 02 51 fb 23 00 00 02 52 01 23 00 00 02 53 fc 23 00 00 02 54 02 23 00 00 02 55 34 23 00 00 02 56 02 23 00 00 02 58 79 23 00 00 02 59 02 23 00 00 02 5a a4 23 00 00 02 5b 02 23 00 00 02 5c dd 23 00 00 02 5d 03 23 00 00 02 5e 05 23 00 00 02 5f 03 23 00 00 02 60 39 23 00 00 02 61 03 23 00 00 02 62 48 23 00 00 02 63 03 23 00 00 02 64 58 23 00 00 02 65 03 23 00 00 02 66 6a 23 00 00 02 67 03 23 00 00 02 68 7f 23 00 00 02 69 03 23 00 00 02 6a 98 23 00 00 02 6b 03 23 00 00 02 6c b7 23 00 00 02 6d 03 23 00 00 02 6e d7 23 00 00 02 6f 03 23 00 00 02 70 ff 23 00 00 02 71 00 23 00 00 02 72 00 23 00 00 02 73 00 23 00 00 02 74 11 23 00 00 02 75 00 23 00 00 02 76 30 23 00 00 02 77 00 23 00 00 02 78 4a 23 00 00 02 79 00 23 00 00 02 7a 62 23 00 00 02 7b 00 23 00 00 02 7c 78 23 00 00 02 7d 00 23 00 00 02 7e 8c 23 00 00 02 7f 00 23 00 00 02 80 9e 23 00 00 02 81 00 23 00 00 02 82 ae 23 00 00 02 83 00 23 00 00 02 84 e4 23 00 00 02 85 01 23 00 00 02 86 0e 23 00 00 02 87 01 23 00 00 02 88 4c 23 00 00 02 89 01 23 00 00 02 8a 7b 23 00 00 02 8b 01 23 00 00 02 8c c2 23 00 00 02 8d 01 23 00 00 02 8e fb 23 00 00 02 8f 01 23 00 00 02 90 fc 23 00 00 02 91 02 23 00 00 02 92 34 23 00 00 02 93 02 23 00 00 02 94 79 23 00 00 02 95 02 23 00 00 02 96 a4 23 00 00 02 97 02 23 00 00 02 98 dd 23 00 00 02 99 03 23 00 00 02 9a 05 23 00 00 02 9b 03 23 00 00 02 9c 39 23 00 00 02 9d 03 23 00 00 02 9e 48 23 00 00 02 9f 03 23 00 00 02 a0 58 23 00 00 02 a2 03 23 00 00 02 a3 6a 23 00 00 02 a4 03 23 00 00 02 a5 7f 23 00 00 02 a6 03 23 00 00 02 a7 98 23 00 00 02 a9 03 23 00 00 02 aa b7 23 00 00 02 ab 03 23 00 00 02 ac d7 23 00 00 02 ad 03 23 00 00 02 ae ff 23 00 00 02 af 00 23 00 00 02 b0 00 23 00 00 02 b1 00 23 00 00 02 b2 11 23 00 00 02 b3 00 23 00 00 02 b4 30 23 00 00 02 b5 00 23 00 00 02 b6 4a 23 00 00 02 b7 00 23 00 00 02 b8 62 23 00 00 02 b9 00 23 00 00 02 ba 78 23 00 00 02 bb 00 23 00 00 02 bc 8c 23 00 00 02 bd 00 23 00 00 02 be 9e 23 00 00 02 bf 00 23 00 00 02 c0 ae 23 00 00 02 c1 00 23 00 00 02 c2 e4 23 00 00 02 c3 01 23 00 00 02 c4 0e 23 00 00 02 c5 01 23 00 00 02 c6 4c 23 00 00 02 c7 01 23 00 00 02 c8 7b 23 00 00 02 c9 01 23 00 00 02 ca c2 23 00 00 02 cb 01 23 00 00 02 cc fb 23 00 00 02 cd 01 23 00 00 02 ce fc 23 00 00 02 cf 02 23 00 00 02 d0 34 23 00 00 02 d1 02 23 00 00 02 d2 79 23 00 00 02 d3 02 23 00 00 02 d4 a4 23 00 00 02 d5 02 23 00 00 02 d6 dd 23 00 00 02 d7 03 23 00 00 02 d8 05 23 00 00 02 d9 03 23 00 00 02 da 39 23 00 00 02 db 03 23 00 00 02 dc 48 23 00 00 02 dd 03 23 00 00 02 de 58 23 00 00 02 df 03 23 00 00 02 e0 6a 23 00 00 02 e1 03 23 00 00 02 e2 7f 23 00 00 02 e3 03 23 00 00 02 e4 98 23 00 00 02 e5 03 23 00 00 02 e6 b7 23 00 00 02 e7 03 23 00 00 02 e8 d7 23 00 00 02 e9 03 23 00 00 02 ea ff 23 00 00 02 ff 05 23 00 00 02 fb 01 23 00 00 02 00 00 23 00 00 02 01 01 23 00 00 02 02 0b 23 00 00 02 03 0c 23 00 00 02 04 00 23 00 00 02 05 03 23 00 00 02 06 00 23 00 00 02 07 04 23 00 00 02 08 00 23 00 00 02 09 00 23 00 00 02 0a 00 23 00 00 02 0b 00 23 00 00 02 0c 00 23 00 00 02 0d 17 23 00 00 02 0e 15 23 00 00 02 0f 13 23 00 00 02 10 00 23 00 00 02 11 01 23 00 00 02 12 0b 23 00 00 02 13 0c 23 00 00 02 14 00 23 00 00 02 15 03 23 00 00 02 16 00 23 00 00 02 17 04 23 00 00 02 18 00 23 00 00 02 19 00 23 00 00 02 1a 00 23 00 00 02 1b 00 23 00 00 02 1c 00 23 00 00 02 1d 17 23 00 00 02 1e 15 23 00 00 02 1f 13 23 00 00 02 20 09 23 00 00 02 21 02 23 00 00 02 22 00 23 00 00 02 23 00 23 00 00 02 24 00 23 00 00 02 25 3d 23 00 00 02 29 38 23 00 00 02 2a 2b 23 00 00 02 2f 02 23 00 00 02 30 01 23 00 00 02 31 49 23 00 00 02 32 23 23 00 00 02 33 01 23 00 00 02 34 05 23 00 00 02 35 74 23 00 00 02 36 00 23 00 00 02 37 2d 23 00 00 02 38 08 23 00 00 02 92 94 23 00 00 02 5b 00 23 00 00 02 5f 1d 23 00 00 02 63 00 23 00 00 02 67 04 23 00 00 02 6c 55 23 00 00 02 7a 00 23 00 00 02 7b a2 23 00 00 02 7c d8 23 00 00 02 7d 50 23 00 00 02 7e 0a 23 00 00 02 7f 1c 23 00 00 02 81 06 23 00 00 02 82 02 23 00 00 02 84 03 23 00 00 02 85 05 23 00 00 02 c5 20 23 00 00 02 80 00 23 00 00 02 83 00 23 00 00 02 93 08 23 00 00 02 94 0a 23 00 00 02 8a 33 23 00 00 02 a4 0f 23 00 00 02 9b 0f 23 00 00 02 9d b0 23 00 00 02 e7 83 23 00 00 02 e3 02 23 00 00 02 ff 00 23 00 00 02 d2 03 23 00 00 02 d3 24 23 00 00 02 d4 20 23 00 00 02 35 00 23 00 00 02 ba 03 13 78 00 01 11 13 64 00 01 29];
					sprd,phy-bit-clock = <0xf4240>;
					sprd,phy-escape-clock = <0x4e20>;
					sprd,reset-off-sequence = <0x0 0x14>;
					sprd,reset-on-sequence = <0x1 0x5 0x0 0x5 0x1 0x5 0x0 0x5 0x1 0x14>;
					sprd,sleep-in-command = <0x130a0001 0x28137800 0x110230a 0x24f01>;
					sprd,sleep-out-command = [13 78 00 01 11 13 64 00 01 29];
					sprd,width-mm = <0x44>;

					display-timings {
						native-mode = <0xc>;

						timing0 {
							clock-frequency = <0x927c000>;
							hactive = <0x438>;
							hback-porch = <0x10>;
							hfront-porch = <0xb0>;
							hsync-len = <0xa>;
							phandle = <0xc>;
							vactive = <0x780>;
							vback-porch = <0x20>;
							vfront-porch = <0x20>;
							vsync-len = <0x4>;
						};
					};
				};

				lcd_nt35695_truly_mipi_fhd {
					phandle = <0x30>;
					sprd,dsi-color-format = "rgb888";
					sprd,dsi-lane-number = <0x4>;
					sprd,dsi-work-mode = <0x1>;
					sprd,esd-check-enable = <0x1>;
					sprd,esd-check-mode = <0x1>;
					sprd,esd-check-period = <0x7d0>;
					sprd,height-mm = <0x79>;
					sprd,initial-command = [23 00 00 02 ff 20 23 00 00 02 00 01 23 00 00 02 01 55 23 00 00 02 02 45 23 00 00 02 03 55 23 00 00 02 05 50 23 00 00 02 06 4a 23 00 00 02 07 24 23 00 00 02 08 0c 23 00 00 02 0b 87 23 00 00 02 0c 87 23 00 00 02 0e b0 23 00 00 02 0f b3 23 00 00 02 11 25 23 00 00 02 12 10 23 00 00 02 13 03 23 00 00 02 14 4a 23 00 00 02 15 12 23 00 00 02 16 12 23 00 00 02 30 01 23 00 00 02 58 82 23 00 00 02 59 00 23 00 00 02 5a 02 23 00 00 02 5b 00 23 00 00 02 5c 82 23 00 00 02 5d 82 23 00 00 02 5e 02 23 00 00 02 5f 02 23 00 00 02 72 31 23 00 00 02 fb 01 23 00 00 02 75 00 23 00 00 02 76 00 23 00 00 02 77 00 23 00 00 02 78 06 23 00 00 02 79 00 23 00 00 02 7a 1a 23 00 00 02 7b 00 23 00 00 02 7c 37 23 00 00 02 7d 00 23 00 00 02 7e 5a 23 00 00 02 7f 00 23 00 00 02 80 75 23 00 00 02 81 00 23 00 00 02 82 8d 23 00 00 02 83 00 23 00 00 02 84 a0 23 00 00 02 85 00 23 00 00 02 86 b1 23 00 00 02 87 00 23 00 00 02 88 e4 23 00 00 02 89 01 23 00 00 02 8a 07 23 00 00 02 8b 01 23 00 00 02 8c 36 23 00 00 02 8d 01 23 00 00 02 8e 5d 23 00 00 02 8f 01 23 00 00 02 90 a9 23 00 00 02 91 01 23 00 00 02 92 e1 23 00 00 02 93 01 23 00 00 02 94 e3 23 00 00 02 95 02 23 00 00 02 96 11 23 00 00 02 97 02 23 00 00 02 98 54 23 00 00 02 99 02 23 00 00 02 9a 7f 23 00 00 02 9b 02 23 00 00 02 9c bd 23 00 00 02 9d 02 23 00 00 02 9e e5 23 00 00 02 9f 03 23 00 00 02 a0 1b 23 00 00 02 a2 03 23 00 00 02 a3 25 23 00 00 02 a4 03 23 00 00 02 a5 28 23 00 00 02 a6 03 23 00 00 02 a7 3a 23 00 00 02 a9 03 23 00 00 02 aa 5d 23 00 00 02 ab 03 23 00 00 02 ac a4 23 00 00 02 ad 03 23 00 00 02 ae c1 23 00 00 02 af 03 23 00 00 02 b0 d3 23 00 00 02 b1 03 23 00 00 02 b2 d8 23 00 00 02 b3 00 23 00 00 02 b4 00 23 00 00 02 b5 00 23 00 00 02 b6 06 23 00 00 02 b7 00 23 00 00 02 b8 1a 23 00 00 02 b9 00 23 00 00 02 ba 37 23 00 00 02 bb 00 23 00 00 02 bc 5a 23 00 00 02 bd 00 23 00 00 02 be 75 23 00 00 02 bf 00 23 00 00 02 c0 8d 23 00 00 02 c1 00 23 00 00 02 c2 a0 23 00 00 02 c3 00 23 00 00 02 c4 b1 23 00 00 02 c5 00 23 00 00 02 c6 e4 23 00 00 02 c7 01 23 00 00 02 c8 07 23 00 00 02 c9 01 23 00 00 02 ca 36 23 00 00 02 cb 01 23 00 00 02 cc 5d 23 00 00 02 cd 01 23 00 00 02 ce a9 23 00 00 02 cf 01 23 00 00 02 d0 e1 23 00 00 02 d1 01 23 00 00 02 d2 e3 23 00 00 02 d3 02 23 00 00 02 d4 11 23 00 00 02 d5 02 23 00 00 02 d6 54 23 00 00 02 d7 02 23 00 00 02 d8 7f 23 00 00 02 d9 02 23 00 00 02 da bd 23 00 00 02 db 02 23 00 00 02 dc e5 23 00 00 02 dd 03 23 00 00 02 de 1b 23 00 00 02 df 03 23 00 00 02 e0 25 23 00 00 02 e1 03 23 00 00 02 e2 28 23 00 00 02 e3 03 23 00 00 02 e4 3a 23 00 00 02 e5 03 23 00 00 02 e6 5d 23 00 00 02 e7 03 23 00 00 02 e8 a4 23 00 00 02 e9 03 23 00 00 02 ea c1 23 00 00 02 eb 03 23 00 00 02 ec d3 23 00 00 02 ed 03 23 00 00 02 ee d8 23 00 00 02 ef 00 23 00 00 02 f0 ba 23 00 00 02 f1 00 23 00 00 02 f2 c1 23 00 00 02 f3 00 23 00 00 02 f4 d1 23 00 00 02 f5 00 23 00 00 02 f6 de 23 00 00 02 f7 00 23 00 00 02 f8 e7 23 00 00 02 f9 00 23 00 00 02 fa f0 23 00 00 02 ff 21 23 00 00 02 00 00 23 00 00 02 01 fa 23 00 00 02 02 01 23 00 00 02 03 03 23 00 00 02 04 01 23 00 00 02 05 0e 23 00 00 02 06 01 23 00 00 02 07 33 23 00 00 02 08 01 23 00 00 02 09 4c 23 00 00 02 0a 01 23 00 00 02 0b 6d 23 00 00 02 0c 01 23 00 00 02 0d 8a 23 00 00 02 0e 01 23 00 00 02 0f c0 23 00 00 02 10 01 23 00 00 02 11 ef 23 00 00 02 12 01 23 00 00 02 13 f1 23 00 00 02 14 02 23 00 00 02 15 20 23 00 00 02 16 02 23 00 00 02 17 63 23 00 00 02 18 02 23 00 00 02 19 91 23 00 00 02 1a 02 23 00 00 02 1b cf 23 00 00 02 1c 02 23 00 00 02 1d f9 23 00 00 02 1e 03 23 00 00 02 1f 31 23 00 00 02 20 03 23 00 00 02 21 3d 23 00 00 02 22 03 23 00 00 02 23 40 23 00 00 02 24 03 23 00 00 02 25 51 23 00 00 02 26 03 23 00 00 02 27 71 23 00 00 02 28 03 23 00 00 02 29 85 23 00 00 02 2a 03 23 00 00 02 2b ab 23 00 00 02 2d 03 23 00 00 02 2f d6 23 00 00 02 30 03 23 00 00 02 31 d8 23 00 00 02 32 00 23 00 00 02 33 ba 23 00 00 02 34 00 23 00 00 02 35 c1 23 00 00 02 36 00 23 00 00 02 37 d1 23 00 00 02 38 00 23 00 00 02 39 de 23 00 00 02 3a 00 23 00 00 02 3b e7 23 00 00 02 3d 00 23 00 00 02 3f f0 23 00 00 02 40 00 23 00 00 02 41 fa 23 00 00 02 42 01 23 00 00 02 43 03 23 00 00 02 44 01 23 00 00 02 45 0e 23 00 00 02 46 01 23 00 00 02 47 33 23 00 00 02 48 01 23 00 00 02 49 4c 23 00 00 02 4a 01 23 00 00 02 4b 6d 23 00 00 02 4c 01 23 00 00 02 4d 8a 23 00 00 02 4e 01 23 00 00 02 4f c0 23 00 00 02 50 01 23 00 00 02 51 ef 23 00 00 02 52 01 23 00 00 02 53 f1 23 00 00 02 54 02 23 00 00 02 55 20 23 00 00 02 56 02 23 00 00 02 58 63 23 00 00 02 59 02 23 00 00 02 5a 91 23 00 00 02 5b 02 23 00 00 02 5c cf 23 00 00 02 5d 02 23 00 00 02 5e f9 23 00 00 02 5f 03 23 00 00 02 60 31 23 00 00 02 61 03 23 00 00 02 62 3d 23 00 00 02 63 03 23 00 00 02 64 40 23 00 00 02 65 03 23 00 00 02 66 51 23 00 00 02 67 03 23 00 00 02 68 71 23 00 00 02 69 03 23 00 00 02 6a 85 23 00 00 02 6b 03 23 00 00 02 6c ab 23 00 00 02 6d 03 23 00 00 02 6e d6 23 00 00 02 6f 03 23 00 00 02 70 d8 23 00 00 02 71 00 23 00 00 02 72 a7 23 00 00 02 73 00 23 00 00 02 74 ae 23 00 00 02 75 00 23 00 00 02 76 bd 23 00 00 02 77 00 23 00 00 02 78 ca 23 00 00 02 79 00 23 00 00 02 7a d4 23 00 00 02 7b 00 23 00 00 02 7c dd 23 00 00 02 7d 00 23 00 00 02 7e e6 23 00 00 02 7f 00 23 00 00 02 80 ef 23 00 00 02 81 00 23 00 00 02 82 f9 23 00 00 02 83 01 23 00 00 02 84 1d 23 00 00 02 85 01 23 00 00 02 86 36 23 00 00 02 87 01 23 00 00 02 88 5b 23 00 00 02 89 01 23 00 00 02 8a 79 23 00 00 02 8b 01 23 00 00 02 8c ba 23 00 00 02 8d 01 23 00 00 02 8e ea 23 00 00 02 8f 01 23 00 00 02 90 ed 23 00 00 02 91 02 23 00 00 02 92 1b 23 00 00 02 93 02 23 00 00 02 94 5f 23 00 00 02 95 02 23 00 00 02 96 8a 23 00 00 02 97 02 23 00 00 02 98 cc 23 00 00 02 99 02 23 00 00 02 9a fb 23 00 00 02 9b 03 23 00 00 02 9c 61 23 00 00 02 9d 03 23 00 00 02 9e af 23 00 00 02 9f 03 23 00 00 02 a0 c6 23 00 00 02 a2 03 23 00 00 02 a3 cc 23 00 00 02 a4 03 23 00 00 02 a5 ce 23 00 00 02 a6 03 23 00 00 02 a7 d2 23 00 00 02 a9 03 23 00 00 02 aa d4 23 00 00 02 ab 03 23 00 00 02 ac d7 23 00 00 02 ad 03 23 00 00 02 ae d8 23 00 00 02 af 00 23 00 00 02 b0 a7 23 00 00 02 b1 00 23 00 00 02 b2 ae 23 00 00 02 b3 00 23 00 00 02 b4 bd 23 00 00 02 b5 00 23 00 00 02 b6 ca 23 00 00 02 b7 00 23 00 00 02 b8 d4 23 00 00 02 b9 00 23 00 00 02 ba dd 23 00 00 02 bb 00 23 00 00 02 bc e6 23 00 00 02 bd 00 23 00 00 02 be ef 23 00 00 02 bf 00 23 00 00 02 c0 f9 23 00 00 02 c1 01 23 00 00 02 c2 1d 23 00 00 02 c3 01 23 00 00 02 c4 36 23 00 00 02 c5 01 23 00 00 02 c6 5b 23 00 00 02 c7 01 23 00 00 02 c8 79 23 00 00 02 c9 01 23 00 00 02 ca ba 23 00 00 02 cb 01 23 00 00 02 cc ea 23 00 00 02 cd 01 23 00 00 02 ce ed 23 00 00 02 cf 02 23 00 00 02 d0 1b 23 00 00 02 d1 02 23 00 00 02 d2 5f 23 00 00 02 d3 02 23 00 00 02 d4 8a 23 00 00 02 d5 02 23 00 00 02 d6 cc 23 00 00 02 d7 02 23 00 00 02 d8 fb 23 00 00 02 d9 03 23 00 00 02 da 61 23 00 00 02 db 03 23 00 00 02 dc af 23 00 00 02 dd 03 23 00 00 02 de c6 23 00 00 02 df 03 23 00 00 02 e0 cc 23 00 00 02 e1 03 23 00 00 02 e2 ce 23 00 00 02 e3 03 23 00 00 02 e4 d2 23 00 00 02 e5 03 23 00 00 02 e6 d4 23 00 00 02 e7 03 23 00 00 02 e8 d7 23 00 00 02 e9 03 23 00 00 02 ea d8 23 00 00 02 ff 24 23 00 00 02 00 01 23 00 00 02 01 0b 23 00 00 02 02 0c 23 00 00 02 03 09 23 00 00 02 04 0a 23 00 00 02 05 1c 23 00 00 02 06 10 23 00 00 02 07 00 23 00 00 02 08 1c 23 00 00 02 09 00 23 00 00 02 0a 00 23 00 00 02 0b 00 23 00 00 02 0c 00 23 00 00 02 0d 13 23 00 00 02 0e 15 23 00 00 02 0f 17 23 00 00 02 10 01 23 00 00 02 11 0b 23 00 00 02 12 0c 23 00 00 02 13 09 23 00 00 02 14 0a 23 00 00 02 15 1c 23 00 00 02 16 10 23 00 00 02 17 10 23 00 00 02 18 1c 23 00 00 02 19 00 23 00 00 02 1a 00 23 00 00 02 1b 00 23 00 00 02 1c 00 23 00 00 02 1d 13 23 00 00 02 1e 15 23 00 00 02 1f 17 23 00 00 02 20 00 23 00 00 02 21 03 23 00 00 02 22 01 23 00 00 02 23 4a 23 00 00 02 24 4a 23 00 00 02 25 6d 23 00 00 02 26 40 23 00 00 02 27 40 23 00 00 02 bd 20 23 00 00 02 b6 22 23 00 00 02 b7 24 23 00 00 02 b8 07 23 00 00 02 b9 07 23 00 00 02 c1 6d 23 00 00 02 be 07 23 00 00 02 bf 07 23 00 00 02 29 d8 23 00 00 02 2a 2a 23 00 00 02 4b 04 23 00 00 02 4c 12 23 00 00 02 4d 00 23 00 00 02 4e 22 23 00 00 02 4f 22 23 00 00 02 50 00 23 00 00 02 51 61 23 00 00 02 52 01 23 00 00 02 53 08 23 00 00 02 56 08 23 00 00 02 54 8a 23 00 00 02 58 8a 23 00 00 02 55 6d 23 00 00 02 5b 43 23 00 00 02 5c 00 23 00 00 02 5f 73 23 00 00 02 60 73 23 00 00 02 63 22 23 00 00 02 64 00 23 00 00 02 67 08 23 00 00 02 68 04 23 00 00 02 7a 80 23 00 00 02 7b 91 23 00 00 02 7c d8 23 00 00 02 7d 60 23 00 00 02 75 20 23 00 00 02 7f 20 23 00 00 02 74 10 23 00 00 02 7e 10 23 00 00 02 93 06 23 00 00 02 94 06 23 00 00 02 b3 00 23 00 00 02 b4 00 23 00 00 02 b5 00 23 00 00 02 78 00 23 00 00 02 79 00 23 00 00 02 80 00 23 00 00 02 83 00 23 00 00 02 84 04 23 00 00 02 8a 33 23 00 00 02 9b 0f 23 00 00 02 8b f0 23 00 00 02 e3 00 23 00 00 02 fb 01 23 00 00 02 ec 00 23 00 00 02 ff 10 29 00 00 04 3b 03 24 20 23 00 00 02 35 00 23 00 00 02 bb 03 29 00 00 03 51 ff 00 23 00 00 02 53 2c 23 00 00 02 55 00 13 50 00 01 11 13 14 00 01 29];
					sprd,phy-bit-clock = <0xf4240>;
					sprd,phy-escape-clock = <0x4e20>;
					sprd,reset-off-sequence = <0x1 0x5>;
					sprd,reset-on-sequence = <0x1 0x5 0x0 0x5 0x1 0x14>;
					sprd,sleep-in-command = [13 01 00 01 00 13 0a 00 01 28 13 78 00 01 10 23 0a 00 02 4f 01];
					sprd,sleep-out-command = [13 50 00 01 11 13 14 00 01 29];
					sprd,width-mm = <0x44>;

					display-timings {
						native-mode = <0xa>;

						timing0 {
							clock-frequency = <0x927c000>;
							hactive = <0x438>;
							hback-porch = <0x10>;
							hfront-porch = <0xb0>;
							hsync-len = <0xa>;
							phandle = <0xa>;
							vactive = <0x780>;
							vback-porch = <0x20>;
							vfront-porch = <0x20>;
							vsync-len = <0x4>;
						};
					};
				};
			};

			op_rf_cable {
				compatible = "op,rf_cable";
				rf,cable0-gpio = <0xffffffff 0x1b 0x0>;
				status = "okay";
			};

			oppo_devinfo {
				compatible = "oppo, device_info";
				phandle = <0x35>;
				sdcard-gpio = <0xffffffff 0x9 0x0>;
				status = "okay";
				sub_board-gpio = <0xffffffff 0x60 0x0>;
			};

			thermal-sensor {
				#thermal-sensor-cells = <0x0>;
				compatible = "generic-adc-thermal";
				io-channel-names = "sensor-channel";
				io-channels = <0xffffffff 0x1>;
				phandle = <0x23>;
				temperature-lookup-table = <0xffff64c2 0x46b 0xffff8baf 0x456 0xffffb3e8 0x432 0xffffedb9 0x3d7 0x277e 0x346 0x60e5 0x28e 0xaf7a 0x19d 0xd677 0x13c 0xfd7f 0xee 0x12484 0xb2 0x14b93 0x85 0x172a3 0x64 0x199b0 0x4b 0x1c0c9 0x39 0x1e7c8 0x2b>;
			};
		};
	};

	fragment@0 {
		target = <0xffffffff>;

		__overlay__ {
			bootargs_ext = "androidboot.hardware=RMX3231 androidboot.dtbo_idx=0";
		};
	};

	fragment@1 {
		target = <0xffffffff>;

		__overlay__ {
			id-gpio = <0xffffffff 0x4 0x0>;
		};
	};

	fragment@10 {
		target = <0xffffffff>;

		__overlay__ {
			first-calib-capacity = <0x28>;
			first-calib-voltage = <0x36ee80>;
			monitored-battery = <0xe 0xf>;
			sprd,calib-resistance-real = <0x2710>;
			sprd,calib-resistance-spec = <0x4e20>;
			sprd,comp-resistance-mohm = <0xf>;
		};
	};

	fragment@11 {
		target = <0xffffffff>;

		__overlay__ {
			sprd-freq = <0x3a5 0x190 0xe9 0x190 0x26e 0x3a5>;
			sprd-scene = "boost", "lcdon", "lcdoff", "camlow", "camhigh", "camveryhigh";
		};
	};

	fragment@12 {
		target = <0xffffffff>;

		__overlay__ {
			hwdvfs_dev = <0x14 0x15 0x16>;

			cluster@0 {
				dcdc-ctrl = <0x17>;
				phandle = <0x14>;
				reg = <0x0>;
			};

			cluster@1 {
				dcdc-ctrl = <0x18>;
				phandle = <0x15>;
				reg = <0x1>;
			};

			dcdc-controller@0 {
				phandle = <0x18>;
				reg = <0x0 0x0>;
				volt-hold-us = <0x32>;
				volt-max-step-microvolt = <0x61a8>;
				volt-pause-us = <0x5>;
				volt-stable-us = <0x5>;
				volt-timeout-us = <0x320>;
				volt-via-adi;
			};

			dcdc-controller@1 {
				phandle = <0x17>;
				reg = <0x1 0x2>;
				volt-hold-us = <0x19>;
				volt-max-step-microvolt = <0x124f84>;
				volt-pause-us = <0x14>;
				volt-stable-us = <0x19>;
				volt-timeout-us = <0x320>;
				volt-via-i2c;
			};

			dsu@0 {
				dcdc-ctrl = <0x18>;
				phandle = <0x16>;
				reg = <0x0>;
			};
		};
	};

	fragment@13 {
		target = <0xffffffff>;

		__overlay__ {
			pinctrl-0 = <0x19>;
			pinctrl-1 = <0x1a>;
			pinctrl-10 = <0x11>;
			pinctrl-11 = <0x10>;
			pinctrl-2 = <0x1b>;
			pinctrl-3 = <0x1c>;
			pinctrl-4 = <0x1d>;
			pinctrl-5 = <0x1e>;
			pinctrl-6 = <0x1f>;
			pinctrl-7 = <0x20>;
			pinctrl-8 = <0x21>;
			pinctrl-9 = <0x22>;
			pinctrl-names = "gpio_121", "gpio_122", "gpio_123", "gpio_124", "gpio_125", "gpio_126", "gpio_144", "gpio_145", "gpio_146", "gpio_147", "gpio_62", "gpio_pwm";

			extint0 {
				function = "func4";
				phandle = <0x1f>;
				pins = "SHARKL3_EXTINT0";
			};

			extint1 {
				function = "func4";
				phandle = <0x20>;
				pins = "SHARKL3_EXTINT1";
			};

			extint2 {
				function = "func2";
				phandle = <0x12>;
				pins = "SHARKL3_KEYIN0";
			};

			keyin0 {
				function = "func4";
				phandle = <0x1c>;
				pins = "SHARKL3_KEYIN0";
			};

			keyin1 {
				function = "func4";
				phandle = <0x1d>;
				pins = "SHARKL3_KEYIN1";
			};

			keyin2 {
				function = "func4";
				phandle = <0x1e>;
				pins = "SHARKL3_KEYIN2";
			};

			keyout0 {
				function = "func4";
				phandle = <0x19>;
				pins = "SHARKL3_KEYOUT0";
			};

			keyout1 {
				function = "func4";
				phandle = <0x1a>;
				pins = "SHARKL3_KEYOUT1";
			};

			keyout2 {
				function = "func4";
				phandle = <0x1b>;
				pins = "SHARKL3_KEYOUT2";
			};

			keyoutnew1 {
				function = "func4";
				phandle = <0x11>;
				pins = "SHARKL3_U0CTS";
			};

			keyoutnew2 {
				function = "func2";
				phandle = <0x10>;
				pins = "SHARKL3_U0CTS";
			};

			scl3 {
				function = "func4";
				phandle = <0x21>;
				pins = "SHARKL3_SCL3";
			};

			sda3 {
				function = "func4";
				phandle = <0x22>;
				pins = "SHARKL3_SDA3";
			};
		};
	};

	fragment@14 {
		target = <0xffffffff>;

		__overlay__ {
			cd-gpios = <0xffffffff 0x9 0x0>;
			tf_ldo_en = <0xffffffff 0x1d 0x0>;
		};
	};

	fragment@15 {
		target = <0xffffffff>;

		__overlay__ {

			board-thmzone {
				phandle = <0x3b>;
				polling-delay = <0x0>;
				polling-delay-passive = <0x0>;
				thermal-sensors = <0x23>;
			};
		};
	};

	fragment@16 {
		target = <0xffffffff>;

		__overlay__ {
			regulator-always-on;
		};
	};

	fragment@17 {
		target = <0xffffffff>;

		__overlay__ {
			regulator-always-on;
		};
	};

	fragment@18 {
		target = <0xffffffff>;

		__overlay__ {
			regulator-always-on;
		};
	};

	fragment@19 {
		target = <0xffffffff>;

		__overlay__ {
			regulator-always-on;
		};
	};

	fragment@2 {
		target = <0xffffffff>;

		__overlay__ {
			extcon = <0xffffffff>;
			vbus-supply = <0x13>;
		};
	};

	fragment@20 {
		target = <0xffffffff>;

		__overlay__ {
			status = "disabled";
		};
	};

	fragment@21 {
		target = <0xffffffff>;

		__overlay__ {

			faceid-mem@fefee000 {
				phandle = <0x25>;
				reg = <0x0 0xfefee000 0x0 0x500000>;
			};

			framebuffer@ff4ee000 {
				phandle = <0x24>;
				reg = <0x0 0xff4ee000 0x0 0xa92000>;
			};

			logobuffer@fd580000 {
				phandle = <0x26>;
				reg = <0x0 0xfd580000 0x0 0x7e9000>;
			};
		};
	};

	fragment@22 {
		target = <0xffffffff>;

		__overlay__ {

			heap@3 {
				label = "carveout_fb";
				memory-region = <0x24>;
				reg = <0x3>;
				type = <0x2>;
			};

			heap@4 {
				label = "carveout_fd";
				memory-region = <0x25>;
				reg = <0x4>;
				type = <0x2>;
			};
		};
	};

	fragment@23 {
		target = <0xffffffff>;

		__overlay__ {
			sprd,logo-memory = <0x26>;
		};
	};

	fragment@24 {
		target = <0xffffffff>;

		__overlay__ {
			sprd,spk-route-hp;
			status = "okay";
		};
	};

	fragment@25 {
		target = <0xffffffff>;

		__overlay__ {
			sprd,spk-ext-pa-det = <0xffffffff 0x20 0x0>;
			sprd,spk-ext-pa-det1 = <0xffffffff 0x5e 0x0>;
			sprd,spk-ext-pa-gpio = <0xffffffff 0x85 0x0 0xffffffff 0x38 0x0>;
			sprd,spk-ext-pa-info = <0x0 0x0 0x1 0x0 0x3 0x0 0x1 0x0>;
			status = "okay";
		};
	};

	fragment@3 {
		target = <0xffffffff>;

		__overlay__ {
			avdd-gpio = <0xffffffff 0x4 0x0>;
			avee-gpio = <0xffffffff 0x5 0x0>;
			reset-gpio = <0xffffffff 0x32 0x0>;
		};
	};

	fragment@4 {
		target = <0xffffffff>;

		__overlay__ {
			status = "okay";

			touchscreen@0 {
				compatible = "oppo,touchscreen";
				focaltech,display-coords = <0x0 0x0 0x2d0 0x640>;
				focaltech,max-touch-number = <0xa>;
				himax,display-coords = <0x0 0x2d0 0x0 0x640>;
				jadard,int-is-edge = <0x1>;
				jadard,panel-coords = <0x0 0x2d0 0x0 0x640>;
				jadard,panel-max-points = <0xa>;
				jadard,panel-sense-nums = <0x12 0x20>;
				reg = <0x0>;
				spi-max-frequency = <0x5b8d80>;
				status = "okay";
				touch,irq-gpio = <0xffffffff 0x48 0x0>;
				touch,panel-coords = <0x0 0x2d0 0x0 0x640>;
				touch,rst-gpio = <0xffffffff 0x91 0x0>;
			};
		};
	};

	fragment@5 {
		target = <0xffffffff>;

		__overlay__ {
			clock-frequency = <0x61a80>;
			status = "okay";

			sensor-main@20 {
				clock-names = "clk_src", "sensor_eb", "clk_96m", "clk_76m8", "clk_48m", "clk_26m";
				clocks = <0xffffffff 0x30 0xffffffff 0xb 0xffffffff 0x4 0xffffffff 0x10 0xffffffff 0x5 0xffffffff>;
				compatible = "sprd,sensor-main";
				csi = <0xffffffff>;
				phandle = <0x36>;
				power-down-gpios = <0xffffffff 0x2e 0x0>;
				reg = <0x20>;
				reset-gpios = <0xffffffff 0x2c 0x0>;
				sprd,phyid = <0x1>;
				vddcama-supply = <0xffffffff>;
				vddcamd-supply = <0xffffffff>;
				vddcammot-supply = <0xffffffff>;
				vddio-supply = <0xffffffff>;
			};
		};
	};

	fragment@6 {
		target = <0xffffffff>;

		__overlay__ {
			clock-frequency = <0x61a80>;
			status = "okay";

			sensor-sub@4c {
				clock-names = "clk_src", "sensor_eb", "clk_96m", "clk_76m8", "clk_48m", "clk_26m";
				clocks = <0xffffffff 0x30 0xffffffff 0xb 0xffffffff 0x4 0xffffffff 0x10 0xffffffff 0x5 0xffffffff>;
				compatible = "sprd,sensor-sub";
				csi = <0xffffffff>;
				phandle = <0x37>;
				power-down-gpios = <0xffffffff 0x28 0x0>;
				reg = <0x4c>;
				reset-gpios = <0xffffffff 0x2d 0x0>;
				sprd,phyid = <0x2>;
				vddcama-supply = <0xffffffff>;
				vddcamd-supply = <0xffffffff>;
				vddio-supply = <0xffffffff>;
			};
		};
	};

	fragment@7 {
		target = <0xffffffff>;

		__overlay__ {
			status = "okay";

			adaptive-touchscreen@38 {
				compatible = "adaptive-touchscreen";
				controller = "focaltech,FT5436";
				gpios = <0xffffffff 0x91 0x0 0xffffffff 0x90 0x0>;
				reg = <0x38>;
				surface-height = <0x500>;
				surface-width = <0x2d0>;
				virtualkeys = <0x244 0x3c 0x528 0x3c 0x2d 0xac 0x168 0x528 0x3c 0x2d 0x9e 0x258 0x528 0x3c 0x2d>;

				private-data {
					a8 = [5a];
				};
			};

			pn557@28 {
				clock-names = "pn557_clk", "source", "enable";
				clocks = <0xffffffff 0xb 0xffffffff 0xffffffff 0x21>;
				compatible = "nxp,pn557";
				nxp,clkreq-gpio = <0xffffffff 0x42 0x0>;
				nxp,firm-gpio = <0xffffffff 0x41 0x0>;
				nxp,irq-gpio = <0xffffffff 0x79 0x0>;
				nxp,ven-gpio = <0xffffffff 0x84 0x0>;
				phandle = <0x38>;
				reg = <0x28>;
			};
		};
	};

	fragment@8 {
		target = <0xffffffff>;

		__overlay__ {
			clock-frequency = <0x61a80>;
			status = "okay";

			charger@6b {
				compatible = "ti,bq2560x_chg";
				extcon = <0xffffffff>;
				monitored-battery = <0xe 0xf>;
				phandle = <0x39>;
				phys = <0xffffffff>;
				reg = <0x6b>;

				otg-vbus {
					phandle = <0x13>;
					regulator-name = "vddvbus";
				};
			};
		};
	};

	fragment@9 {
		target = <0xffffffff>;

		__overlay__ {
			clock-frequency = <0x61a80>;
			status = "okay";

			regulator@60 {
				compatible = "fcs,fan53555";
				fcs,suspend-voltage-selector = <0x1>;
				phandle = <0x3a>;
				reg = <0x60>;
				regulator-always-on;
				regulator-max-microvolt = <0x1587b8>;
				regulator-min-microvolt = <0x93378>;
				regulator-name = "fan53555";
				regulator-ramp-delay = <0xfa00>;
			};
		};
	};
};
