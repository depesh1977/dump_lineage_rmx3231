/dts-v1/;

/ {
	compatible = "sprd,sp9863a-1c10", "sprd,sc9863a";
	model = "Spreadtrum SC9863A-1C10 Board";
	sprd,sc-id = "sp9863a 1c10 1000";

	__fixups__ {
		aon_clk = "/fragment@8/__overlay__/sensor-main@20:clocks:0", "/fragment@8/__overlay__/sensor-sub2@30:clocks:0", "/fragment@9/__overlay__/sensor-sub@20:clocks:0", "/fragment@9/__overlay__/sensor-main2@6C:clocks:0", "/fragment@9/__overlay__/sensor-main3@2a:clocks:0";
		ap_gpio = "/fragment/__overlay__/sunwave@0:sunwave,reset-gpio:0", "/fragment/__overlay__/sunwave@0:sunwave,irq-gpio:0", "/fragment/__overlay__/chipone@0:fpreset-gpios:0", "/fragment/__overlay__/chipone@0:fpint-gpios:0", "/fragment/__overlay__/flash-gpios:flash-torch-en-gpios:0", "/fragment/__overlay__/flash-gpios:flash-en-gpios:0", "/fragment/__overlay__/gpio-keys/key-volumedown:gpios:0", "/fragment@2/__overlay__:avdd-gpio:0", "/fragment@2/__overlay__:reset-gpio:0", "/fragment@8/__overlay__/sensor-main@20:avdd-gpios:0", "/fragment@8/__overlay__/sensor-main@20:mipi-switch-mode-gpios:0", "/fragment@8/__overlay__/sensor-main@20:mipi-switch-en-gpios:0", "/fragment@8/__overlay__/sensor-main@20:reset-gpios:0", "/fragment@8/__overlay__/sensor-main@20:power-down-gpios:0", "/fragment@8/__overlay__/sensor-sub2@30:iovdd-gpios:0", "/fragment@8/__overlay__/sensor-sub2@30:dvdd-gpios:0", "/fragment@8/__overlay__/sensor-sub2@30:reset-gpios:0", "/fragment@8/__overlay__/sensor-sub2@30:power-down-gpios:0", "/fragment@9/__overlay__/sensor-sub@20:avdd-gpios:0", "/fragment@9/__overlay__/sensor-sub@20:mipi-switch-mode-gpios:0", "/fragment@9/__overlay__/sensor-sub@20:mipi-switch-en-gpios:0", "/fragment@9/__overlay__/sensor-sub@20:reset-gpios:0", "/fragment@9/__overlay__/sensor-sub@20:power-down-gpios:0", "/fragment@9/__overlay__/sensor-main2@6C:iovdd-gpios:0", "/fragment@9/__overlay__/sensor-main2@6C:dvdd-gpios:0", "/fragment@9/__overlay__/sensor-main2@6C:reset-gpios:0", "/fragment@9/__overlay__/sensor-main2@6C:power-down-gpios:0", "/fragment@9/__overlay__/sensor-main3@2a:dvdd-gpios:0", "/fragment@9/__overlay__/sensor-main3@2a:reset-gpios:0", "/fragment@9/__overlay__/sensor-main3@2a:power-down-gpios:0", "/fragment@10/__overlay__/focaltech_ts@38:gpios:0", "/fragment@10/__overlay__/focaltech_ts@38:gpios:12", "/fragment@10/__overlay__/chipone_tddi@48:gpios:0", "/fragment@10/__overlay__/chipone_tddi@48:gpios:12", "/fragment@10/__overlay__/goodix_ts@5d:gpios:0", "/fragment@10/__overlay__/goodix_ts@5d:gpios:12", "/fragment@11/__overlay__/charger@6a:chg-enable-gpios:0", "/fragment@11/__overlay__/bias_lcm@3e:fv-en-gpios:0", "/fragment@24/__overlay__:sprd,spk-ext-pa-gpio:0";
		chosen = "/fragment@0:target:0";
		csi0 = "/fragment@8/__overlay__/sensor-main@20:csi:0", "/fragment@9/__overlay__/sensor-sub@20:csi:0";
		csi1 = "/fragment@8/__overlay__/sensor-sub2@30:csi:0", "/fragment@9/__overlay__/sensor-main2@6C:csi:0", "/fragment@9/__overlay__/sensor-main3@2a:csi:0";
		dcam = "/fragment@14:target:0";
		ddr_dfs = "/fragment@3:target:0";
		dpu = "/fragment@26:target:0";
		eic_async = "/fragment@7/__overlay__:cd-gpios:0", "/fragment@13/__overlay__:cd-gpios:0";
		eic_debounce = "/fragment@4/__overlay__:id-gpio:0";
		ext_26m = "/fragment@8/__overlay__/sensor-main@20:clocks:40", "/fragment@8/__overlay__/sensor-sub2@30:clocks:40", "/fragment@9/__overlay__/sensor-sub@20:clocks:40", "/fragment@9/__overlay__/sensor-main2@6C:clocks:40", "/fragment@9/__overlay__/sensor-main3@2a:clocks:40";
		extcon_gpio = "/fragment@4:target:0", "/fragment@5/__overlay__:extcon:0", "/fragment@11/__overlay__/charger@6a:extcon:0";
		hsphy = "/fragment@11/__overlay__/charger@6a:phys:0";
		i2c0 = "/fragment@8:target:0";
		i2c1 = "/fragment@9:target:0";
		i2c3 = "/fragment@10:target:0";
		i2c4 = "/fragment@11:target:0";
		i2c7 = "/fragment@12:target:0";
		ion = "/fragment@25:target:0";
		mm_gate = "/fragment@8/__overlay__/sensor-main@20:clocks:8", "/fragment@8/__overlay__/sensor-sub2@30:clocks:8", "/fragment@9/__overlay__/sensor-sub@20:clocks:8", "/fragment@9/__overlay__/sensor-main2@6C:clocks:8", "/fragment@9/__overlay__/sensor-main3@2a:clocks:8";
		panel = "/fragment@2:target:0";
		pin_controller = "/fragment@22:target:0";
		pll = "/fragment@8/__overlay__/sensor-main@20:clocks:16", "/fragment@8/__overlay__/sensor-main@20:clocks:24", "/fragment@8/__overlay__/sensor-main@20:clocks:32", "/fragment@8/__overlay__/sensor-sub2@30:clocks:16", "/fragment@8/__overlay__/sensor-sub2@30:clocks:24", "/fragment@8/__overlay__/sensor-sub2@30:clocks:32", "/fragment@9/__overlay__/sensor-sub@20:clocks:16", "/fragment@9/__overlay__/sensor-sub@20:clocks:24", "/fragment@9/__overlay__/sensor-sub@20:clocks:32", "/fragment@9/__overlay__/sensor-main2@6C:clocks:16", "/fragment@9/__overlay__/sensor-main2@6C:clocks:24", "/fragment@9/__overlay__/sensor-main2@6C:clocks:32", "/fragment@9/__overlay__/sensor-main3@2a:clocks:16", "/fragment@9/__overlay__/sensor-main3@2a:clocks:24", "/fragment@9/__overlay__/sensor-main3@2a:clocks:32";
		pmic_adc = "/fragment/__overlay__/thermal-sensor:io-channels:0";
		pmic_eic = "/fragment/__overlay__/gpio-keys/key-volumeup:gpios:0", "/fragment/__overlay__/gpio-keys/key-power:gpios:0";
		pmic_fgu = "/fragment@6:target:0";
		pmic_typec = "/fragment/__overlay__/charger-manager/regulator@0/cable@0:extcon:0";
		pwms = "/fragment/__overlay__/sprd_backlight:pwms:0";
		reserved_memory = "/fragment@1:target:0";
		sdio0 = "/fragment@7:target:0", "/fragment@13:target:0";
		sound_vbc_r1p0v3_sprd_codec = "/fragment@24:target:0";
		sprd_headset = "/fragment@23:target:0";
		sprd_hwdvfs = "/fragment@15:target:0";
		thm_zone = "/fragment@16:target:0";
		usb = "/fragment@5:target:0";
		vdd18 = "/fragment@17:target:0";
		vddcama = "/fragment@8/__overlay__/sensor-main@20:vddcama-supply:0", "/fragment@8/__overlay__/sensor-sub2@30:vddcama-supply:0", "/fragment@9/__overlay__/sensor-sub@20:vddcama-supply:0", "/fragment@9/__overlay__/sensor-main2@6C:vddcama-supply:0", "/fragment@9/__overlay__/sensor-main3@2a:vddcama-supply:0";
		vddcamd = "/fragment@8/__overlay__/sensor-main@20:vddcamd-supply:0", "/fragment@8/__overlay__/sensor-sub2@30:vddcamd-supply:0", "/fragment@9/__overlay__/sensor-sub@20:vddcamd-supply:0", "/fragment@9/__overlay__/sensor-main2@6C:vddcamd-supply:0", "/fragment@9/__overlay__/sensor-main3@2a:vddcamd-supply:0";
		vddcamio = "/fragment@8/__overlay__/sensor-main@20:vddio-supply:0", "/fragment@8/__overlay__/sensor-sub2@30:vddio-supply:0", "/fragment@9/__overlay__/sensor-sub@20:vddio-supply:0", "/fragment@9/__overlay__/sensor-main2@6C:vddio-supply:0", "/fragment@9/__overlay__/sensor-main3@2a:vddio-supply:0";
		vddcammot = "/fragment@8/__overlay__/sensor-main@20:vddcammot-supply:0", "/fragment@8/__overlay__/sensor-sub2@30:vddcammot-supply:0", "/fragment@9/__overlay__/sensor-sub@20:vddcammot-supply:0", "/fragment@9/__overlay__/sensor-main2@6C:vddcammot-supply:0", "/fragment@9/__overlay__/sensor-main3@2a:vddcammot-supply:0";
		vddldomem = "/fragment@20:target:0";
		vddrf125 = "/fragment@19:target:0";
		vddrf18 = "/fragment@18:target:0";
		vddsim2 = "/fragment@21:target:0";
	};

	__local_fixups__ {

		fragment {

			__overlay__ {

				charger-manager {
					monitored-battery = <0x0>;
				};

				lcds {

					lcd_dummy_mipi_hd {

						display-timings {
							native-mode = <0x0>;
						};
					};

					lcd_ft8006p_easyquick_mipi_hdp {

						display-timings {
							native-mode = <0x0>;
						};
					};

					lcd_icnl9911_hlt_mipi_hdp {

						display-timings {
							native-mode = <0x0>;
						};
					};
				};
			};
		};

		fragment@11 {

			__overlay__ {

				charger@6a {
					monitored-battery = <0x0>;
				};
			};
		};

		fragment@15 {

			__overlay__ {
				hwdvfs_dev = <0x0 0x4 0x8>;

				cluster@0 {
					dcdc-ctrl = <0x0>;
				};

				cluster@1 {
					dcdc-ctrl = <0x0>;
				};

				dsu@0 {
					dcdc-ctrl = <0x0>;
				};
			};
		};

		fragment@16 {

			__overlay__ {

				board-thmzone {
					thermal-sensors = <0x0>;
				};
			};
		};

		fragment@2 {

			__overlay__ {
				sprd,backlight = <0x0>;
			};
		};

		fragment@22 {

			__overlay__ {
				pinctrl-0 = <0x0>;
				pinctrl-1 = <0x0>;
				pinctrl-10 = <0x0 0x4 0x8 0xc 0x10 0x14>;
				pinctrl-2 = <0x0>;
				pinctrl-3 = <0x0>;
				pinctrl-4 = <0x0>;
				pinctrl-5 = <0x0>;
				pinctrl-6 = <0x0>;
				pinctrl-7 = <0x0>;
				pinctrl-8 = <0x0>;
				pinctrl-9 = <0x0>;
			};
		};

		fragment@25 {

			__overlay__ {

				heap@3 {
					memory-region = <0x0>;
				};

				heap@4 {
					memory-region = <0x0>;
				};
			};
		};

		fragment@26 {

			__overlay__ {
				sprd,logo-memory = <0x0>;
			};
		};

		fragment@5 {

			__overlay__ {
				vbus-supply = <0x0>;
			};
		};

		fragment@6 {

			__overlay__ {
				monitored-battery = <0x0>;
			};
		};
	};

	__symbols__ {
		bat = "/fragment/__overlay__/battery";
		bd_thmzone = "/fragment@16/__overlay__/board-thmzone";
		camera_reserved = "/fragment@1/__overlay__/camera@fdd69000";
		dcdc_ctrl0 = "/fragment@15/__overlay__/dcdc-controller@0";
		dcdc_ctrl1 = "/fragment@15/__overlay__/dcdc-controller@1";
		dummy_timing0 = "/fragment/__overlay__/lcds/lcd_dummy_mipi_hd/display-timings/timing0";
		eta6937_chg = "/fragment@11/__overlay__/charger@6a";
		fan53555_dcdc = "/fragment@12/__overlay__/regulator@60";
		fb_reserved = "/fragment@1/__overlay__/framebuffer@fe769000";
		ft8006p_easyquick_timing0 = "/fragment/__overlay__/lcds/lcd_ft8006p_easyquick_mipi_hdp/display-timings/timing0";
		gpio_121 = "/fragment@22/__overlay__/keyout0";
		gpio_122 = "/fragment@22/__overlay__/keyout1";
		gpio_123 = "/fragment@22/__overlay__/keyout2";
		gpio_124 = "/fragment@22/__overlay__/keyin0";
		gpio_125 = "/fragment@22/__overlay__/keyin1";
		gpio_126 = "/fragment@22/__overlay__/keyin2";
		gpio_144 = "/fragment@22/__overlay__/extint0";
		gpio_145 = "/fragment@22/__overlay__/extint1";
		gpio_146 = "/fragment@22/__overlay__/scl3";
		gpio_147 = "/fragment@22/__overlay__/sda3";
		hwdvfs_cluster0 = "/fragment@15/__overlay__/cluster@0";
		hwdvfs_cluster1 = "/fragment@15/__overlay__/cluster@1";
		hwdvfs_dsu = "/fragment@15/__overlay__/dsu@0";
		icnl9911_hlt_timing0 = "/fragment/__overlay__/lcds/lcd_icnl9911_hlt_mipi_hdp/display-timings/timing0";
		lcd_dummy_mipi_hd = "/fragment/__overlay__/lcds/lcd_dummy_mipi_hd";
		lcd_ft8006p_easyquick_mipi_hdp = "/fragment/__overlay__/lcds/lcd_ft8006p_easyquick_mipi_hdp";
		lcd_icnl9911_hlt_mipi_hdp = "/fragment/__overlay__/lcds/lcd_icnl9911_hlt_mipi_hdp";
		logo_reserved = "/fragment@1/__overlay__/logobuffer@fd580000";
		pwm_backlight = "/fragment/__overlay__/sprd_backlight";
		sensor_main = "/fragment@8/__overlay__/sensor-main@20";
		sensor_main2 = "/fragment@9/__overlay__/sensor-main2@6C";
		sensor_main3 = "/fragment@9/__overlay__/sensor-main3@2a";
		sensor_sub = "/fragment@9/__overlay__/sensor-sub@20";
		sensor_sub2 = "/fragment@8/__overlay__/sensor-sub2@30";
		shutdown0 = "/fragment@22/__overlay__/rfsen0";
		shutdown1 = "/fragment@22/__overlay__/rfsck0";
		shutdown2 = "/fragment@22/__overlay__/rfsda0";
		shutdown3 = "/fragment@22/__overlay__/rfsen1";
		shutdown4 = "/fragment@22/__overlay__/rfsck1";
		shutdown5 = "/fragment@22/__overlay__/rfsda1";
		tboard_thermistor = "/fragment/__overlay__/thermal-sensor";
		tps65132 = "/fragment@11/__overlay__/bias_lcm@3e";
		vddvbus = "/fragment@11/__overlay__/charger@6a/otg-vbus";
	};

	fragment {
		target-path = [2f 00];

		__overlay__ {

			battery {
				capacity-temp-table = <0x2d 0x64 0x19 0x64 0xa 0x62 0x0 0x5b 0xfffffff6 0x52 0xffffffec 0x35>;
				charge-cdp-current-microamp = <0x118c30 0x118c30>;
				charge-dcp-current-microamp = <0x2625a0 0x2dc6c0>;
				charge-full-design-microamp-hours = <0x3e35c8>;
				charge-sdp-current-microamp = <0x6ddd0 0x7a120>;
				charge-term-current-microamp = <0x1d4c0>;
				charge-unknown-current-microamp = <0x6ddd0 0x7a120>;
				compatible = "simple-battery";
				constant_charge_voltage_max_microvolt = <0x432380>;
				factory-internal-resistance-micro-ohms = <0x2ee00>;
				ocv-capacity-celsius = <0x14>;
				ocv-capacity-table-0 = <0x42dd30 0x64 0x41eb00 0x5f 0x410488 0x5a 0x4021f8 0x55 0x3f4b20 0x50 0x3e7830 0x4b 0x3dc868 0x46 0x3ce5d8 0x41 0x3c4d80 0x3c 0x3b7a90 0x37 0x3ae238 0x32 0x3a78c0 0x2d 0x3a22d0 0x28 0x39e068 0x23 0x39a9b8 0x1e 0x397308 0x19 0x392cb8 0x14 0x38d2e0 0xf 0x3859c8 0xa 0x382ae8 0x5 0x33e140 0x0>;
				phandle = <0x4>;
				resistance-temp-table = <0x2d 0x46 0x19 0x64 0xa 0x113 0x0 0x23b 0xfffffff6 0x277 0xffffffec 0x2dc>;
				voltage-min-design-microvolt = <0x34a490>;
				voltage-temp-table = <0x13d620 0x2bc 0x123810 0x2ee 0x108a60 0x320 0xee480 0x352 0xd3ea0 0x384 0xbac48 0x3b6 0xa1220 0x3e8 0x8d9a0 0x41a 0x7a508 0x44c 0x69398 0x47e 0x5a168 0x4b0 0x4d260 0x4e2 0x41eb0 0x514 0x38658 0x546 0x30570 0x578 0x29428 0x5aa 0x23668 0x5dc 0x1e848 0x60e 0x1a5e0 0x640 0x16f30 0x672 0x13c68 0x6a4>;
			};

			charger-manager {
				cm-battery-cold = <0xc8>;
				cm-battery-cold-in-minus;
				cm-battery-hot = <0x320>;
				cm-battery-stat = <0x2>;
				cm-battery-temp-diff = <0x64>;
				cm-cap-remap-table = <0x1 0x2 0x3 0x2 0x3 0x2 0x62 0x63 0x2 0x63 0x64 0x3>;
				cm-capacity-track;
				cm-cdp-jeita-temp-table = <0x3e8 0x406 0x0 0x432380 0x47e 0x49c 0xaae60 0x432380 0x5aa 0x58c 0x118c30 0x432380 0x640 0x622 0xaae60 0x3e8fa0>;
				cm-charge-voltage-drop = <0xaae60>;
				cm-charge-voltage-max = <0x632ea0>;
				cm-chargers = "eta6937_charger";
				cm-charging-max = <0x1499700>;
				cm-dcp-jeita-temp-table = <0x3e8 0x3fc 0x0 0x432380 0x47e 0x492 0xc3500 0x432380 0x5aa 0x596 0x1e8480 0x432380 0x60e 0x5fa 0x7a120 0x3e8fa0>;
				cm-discharging-max = <0xa4cb80>;
				cm-fuel-gauge = "sc27xx-fgu";
				cm-fullbatt-capacity = <0x64>;
				cm-fullbatt-current = <0x1d4c0>;
				cm-fullbatt-vchkdrop-ms = <0x7530>;
				cm-fullbatt-vchkdrop-volt = <0xea60>;
				cm-fullbatt-voltage = <0x426030>;
				cm-name = "battery";
				cm-num-chargers = <0x1>;
				cm-one-cap-time = <0x1e>;
				cm-poll-interval = <0x3a98>;
				cm-poll-mode = <0x2>;
				cm-sdp-jeita-temp-table = <0x3e8 0x406 0x0 0x432380 0x47e 0x49c 0x7a120 0x432380 0x5aa 0x58c 0x7a120 0x432380 0x640 0x622 0x7a120 0x3e8fa0>;
				cm-shutdown-voltage = <0x2f4d60>;
				cm-thermal-zone = "board-thmzone";
				cm-tickle-time-out = <0x5dc>;
				cm-unknown-jeita-temp-table = <0x3e8 0x406 0x0 0x432380 0x47e 0x49c 0x7a120 0x432380 0x5aa 0x58c 0x7a120 0x432380 0x640 0x622 0x7a120 0x3e8fa0>;
				cm-wdt-interval = <0x3c>;
				compatible = "charger-manager";
				monitored-battery = <0x4>;

				regulator@0 {
					cm-regulator-name = "vddgen0";

					cable@0 {
						cm-cable-name = "USB";
						extcon = <0xffffffff>;
					};
				};
			};

			chipone@0 {
				compatible = "chipone,fingerprint";
				fpint-gpios = <0xffffffff 0x82 0x0>;
				fpreset-gpios = <0xffffffff 0x83 0x0>;
			};

			flash-gpios {
				compatible = "sprd,flash-aw3641";
				flash-en-gpios = <0xffffffff 0x85 0x0>;
				flash-ic = <0xe39>;
				flash-torch-en-gpios = <0xffffffff 0x84 0x0>;
			};

			gpio-keys {
				compatible = "gpio-keys";

				key-power {
					debounce-interval = <0x2>;
					gpios = <0xffffffff 0x1 0x1>;
					label = "Power Key";
					linux,code = <0x74>;
					wakeup-source;
				};

				key-volumedown {
					debounce-interval = <0x2>;
					gpios = <0xffffffff 0x7c 0x1>;
					label = "Volume Down Key";
					linux,code = <0x72>;
					wakeup-source;
				};

				key-volumeup {
					debounce-interval = <0x2>;
					gpios = <0xffffffff 0xa 0x0>;
					label = "Volume Up Key";
					linux,code = <0x73>;
					wakeup-source;
				};
			};

			lcds {

				lcd_dummy_mipi_hd {
					phandle = <0x22>;
					sprd,dsi-color-format = "rgb888";
					sprd,dsi-lane-number = <0x4>;
					sprd,dsi-work-mode = <0x1>;
					sprd,initial-command = [13 78 00 01 11 13 64 00 01 29];
					sprd,sleep-in-command = [13 0a 00 01 28 13 78 00 01 10];
					sprd,sleep-out-command = [13 78 00 01 11 13 64 00 01 29];

					display-timings {
						native-mode = <0x3>;

						timing0 {
							clock-frequency = <0x493e000>;
							hactive = <0x2d0>;
							hback-porch = <0x3c>;
							hfront-porch = <0x50>;
							hsync-len = <0x3c>;
							phandle = <0x3>;
							vactive = <0x500>;
							vback-porch = <0xc>;
							vfront-porch = <0x26>;
							vsync-len = <0x4>;
						};
					};
				};

				lcd_ft8006p_easyquick_mipi_hdp {
					phandle = <0x20>;
					sprd,dsi-color-format = "rgb888";
					sprd,dsi-lane-number = <0x4>;
					sprd,dsi-work-mode = <0x1>;
					sprd,height-mm = <0x97>;
					sprd,initial-command = [23 00 00 02 41 5a 39 00 00 03 41 5a 24 23 00 00 02 90 5a 39 00 00 03 41 5a 03 39 00 00 03 80 c0 00 39 00 00 03 41 5a 08 39 00 00 04 80 c8 2c 01 39 00 00 03 41 5a 09 39 00 00 11 80 5a 51 b5 2a 6c e5 4a 01 40 62 0f 82 20 08 f0 b7 39 00 00 11 90 00 24 42 0a e3 91 a4 f0 af cd 66 20 41 a1 26 00 39 00 00 11 a0 51 55 55 00 a0 4c 06 11 0d 60 5a ff ff 03 a5 e6 39 00 00 11 b0 08 c9 16 64 0b 00 00 11 07 60 00 ff ff 03 ff 34 39 00 00 09 c0 0c 3f 1f 9f 0f 00 08 00 39 00 00 03 41 5a 0a 39 00 00 11 80 ff 51 a3 02 00 0d 1a 2a 3b 4e 53 86 5e 97 a1 6f 39 00 00 11 90 90 68 63 52 40 30 1d 0b 00 0d 1a 2a 3b 4e 53 86 39 00 00 0e a0 5e 97 a1 6f 90 68 63 52 40 30 1d 0b 00 39 00 00 03 41 5a 0b 39 00 00 11 80 00 00 20 44 08 00 60 47 00 00 10 22 04 00 b0 23 39 00 00 03 90 15 00 39 00 00 03 41 5a 0c 39 00 00 11 80 fa 68 68 01 32 64 20 08 00 60 15 00 50 15 56 51 39 00 00 11 90 15 55 61 15 00 60 15 00 50 15 56 51 15 55 61 95 39 00 00 11 a0 ab 18 00 05 00 05 00 05 80 4c 29 84 52 01 09 00 39 00 00 03 b0 00 00 39 00 00 03 41 5a 0d 39 00 00 08 80 f0 b1 71 ef 4b c0 80 39 00 00 03 41 5a 0e 39 00 00 09 80 ff 01 55 55 23 88 88 1c 39 00 00 03 41 5a 0f 39 00 00 11 80 d1 07 6e c0 12 08 64 08 52 51 58 49 03 52 4c 4c 39 00 00 11 90 68 68 68 4c 4c 7c 14 00 20 06 c2 00 04 06 0c 00 39 00 00 05 a0 00 92 00 00 39 00 00 03 41 5a 10 39 00 00 11 80 00 00 03 e7 1f 17 10 48 80 aa d0 18 30 88 41 8a 39 00 00 10 90 39 28 a9 c5 9a 7b f0 07 7e e0 07 7e 20 10 00 39 00 00 03 41 5a 11 39 00 00 11 80 46 77 03 40 ca f3 ff 83 30 08 c4 06 a1 d8 24 18 39 00 00 11 90 30 c6 66 c1 80 31 15 cb e5 d2 68 6c 36 1d 04 c8 39 00 00 11 a0 b0 d9 88 60 b0 81 40 1a 1b 48 63 03 b9 00 1c 80 39 00 00 11 b0 50 30 00 e0 e1 01 00 28 0e 06 43 55 55 55 55 55 39 00 00 11 c0 95 88 88 88 88 88 c8 08 86 c6 e3 81 00 20 00 21 39 00 00 11 d0 42 88 00 00 00 00 40 00 00 31 04 41 06 00 00 00 39 00 00 11 e0 00 92 04 00 92 04 00 00 00 00 92 04 00 85 11 0c 39 00 00 10 f0 00 00 40 00 00 00 00 5e 4a 01 78 00 08 00 00 39 00 00 03 41 5a 12 39 00 00 11 80 00 00 00 00 00 02 03 00 00 00 00 02 03 01 41 37 39 00 00 11 90 f1 e7 00 00 00 00 00 00 00 00 00 00 00 2d 23 05 39 00 00 08 a0 fb 08 2d 23 05 fb 0c 39 00 00 03 41 5a 13 39 00 00 11 80 fd 0f 00 0c 00 00 00 00 01 08 01 1c 44 0c ce e7 39 00 00 0f 90 62 0e 24 98 ac 21 01 00 d0 93 24 49 06 20 39 00 00 03 41 5a 14 39 00 00 11 80 01 02 41 36 e9 ef f7 fb fd 7e 01 00 00 90 c5 86 39 00 00 11 90 3b 7d 60 0b 3c 12 02 9b e0 91 10 80 95 11 7c 00 39 00 00 11 a0 00 fc 7e 00 00 e0 f7 03 00 20 83 b5 e2 f7 47 00 39 00 00 11 b0 d8 89 df 1f 01 00 00 00 00 44 32 24 2b 00 40 a1 39 00 00 11 c0 50 78 03 ee b4 9c 51 1c 2f c0 9d 96 33 8a e3 15 39 00 00 11 d0 b8 d3 72 46 71 bc 04 77 5a ce 28 8e d7 e0 4e cb 39 00 00 11 e0 19 c5 f1 22 dc 69 39 a3 38 5e 85 3b 2d 67 14 c7 39 00 00 11 f0 cb 70 a7 e5 8c e2 18 01 bf df 08 00 00 00 00 00 39 00 00 03 41 5a 15 39 00 00 11 80 00 00 00 00 00 00 00 00 00 00 00 00 02 d9 e0 f7 39 00 00 11 90 53 00 20 63 c5 a8 c5 07 c9 90 5d 31 6a f1 41 8c 39 00 00 11 a0 78 00 00 00 00 00 00 00 00 00 00 00 00 00 00 00 39 00 00 11 b0 00 00 00 00 00 00 00 00 13 00 f0 00 14 aa 55 4d 39 00 00 11 c0 b3 6d db d6 51 da d6 10 a2 b6 6d db b6 85 5a 53 39 00 00 11 d0 35 db b6 6d 01 a2 6d 11 46 6a db b6 6d 5b a9 55 39 00 00 11 e0 4d b3 6d db 96 41 da 96 00 a0 b6 6d db b6 8d 5a 39 00 00 11 f0 53 35 db b6 6d 05 a3 6d 15 87 6a db b6 6d 5b c0 39 00 00 03 41 5a 16 39 00 00 11 80 c3 43 41 01 00 00 00 00 00 00 00 00 00 00 00 00 39 00 00 07 90 00 00 00 00 f0 20 39 00 00 03 41 5a 18 39 00 00 11 80 ef bd f7 de 7b ef bd 07 08 08 0a 0c 0c 0c 0c 0c 39 00 00 11 90 0c 0c 0c 5c 09 a8 aa aa aa aa aa aa aa aa aa 5a 39 00 00 11 a0 59 59 59 59 59 59 59 59 59 59 59 09 04 ff 00 80 39 00 00 10 b0 80 00 04 20 00 01 08 40 00 02 10 80 00 04 00 39 00 00 03 41 5a 19 39 00 00 11 80 c0 af a3 9b 92 8d 8a 86 84 83 82 81 00 50 f6 cf 39 00 00 11 90 fc 2f f3 ef cf bf 0f ff af b5 71 0e 6c 4a 69 08 39 00 00 05 a0 00 00 08 00 39 00 00 03 41 5a 1a 39 00 00 11 80 00 04 08 0c 00 10 14 18 1c 00 20 28 30 38 00 40 39 00 00 11 90 48 50 58 00 60 68 70 78 00 80 88 90 98 00 a0 a8 39 00 00 11 a0 b0 b8 00 c0 c8 d0 d8 00 e0 e8 f0 f8 00 fc fe ff 39 00 00 11 b0 00 00 04 08 0c 00 10 14 18 1c 00 20 28 30 38 00 39 00 00 11 c0 40 48 50 58 00 60 68 70 78 00 80 88 90 98 00 a0 39 00 00 11 d0 a8 b0 b8 00 c0 c8 d0 d8 00 e0 e8 f0 f8 00 fc fe 39 00 00 11 e0 ff 00 00 04 08 0c 00 10 14 18 1c 00 20 28 30 38 39 00 00 11 f0 00 40 48 50 58 00 60 68 70 78 00 80 88 90 98 00 39 00 00 03 41 5a 1b 39 00 00 11 80 a0 a8 b0 b8 00 c0 c8 d0 d8 00 e0 e8 f0 f8 00 fc 39 00 00 05 90 fe ff 00 00 39 00 00 03 41 5a 20 39 00 00 08 80 81 00 00 00 00 00 00 39 00 00 03 41 5a 22 39 00 00 0e 80 2d d3 00 55 55 55 55 55 55 55 55 9f 00 39 00 00 03 41 5a 23 39 00 00 11 80 01 05 00 05 00 00 00 00 00 00 00 00 00 00 00 00 39 00 00 0d 90 ff 0f 00 00 00 03 00 00 00 ff 07 35 39 00 00 03 41 5a 24 39 00 00 11 80 00 03 00 ff ff 20 00 00 00 00 00 00 00 00 8c 34 39 00 00 11 90 5a 5a 5a 55 00 00 00 00 00 00 00 00 00 00 00 00 23 00 00 02 42 24 23 00 00 02 90 00 39 00 00 03 41 5a 2f 23 00 00 02 19 00 23 00 00 02 4c 03 23 78 00 02 11 00 23 14 00 02 29 00 39 00 00 03 51 ff 0f 23 00 00 02 53 24 23 00 00 02 55 00];
					sprd,phy-bit-clock = <0xa6040>;
					sprd,phy-escape-clock = <0x4e20>;
					sprd,reset-off-sequence = <0x0 0x5>;
					sprd,reset-on-sequence = <0x1 0x32 0x0 0x32 0x1 0x96>;
					sprd,sleep-in-command = <0x23140002 0x28002378 0x21000>;
					sprd,sleep-out-command = <0x23780023 0x11002314 0x232900>;
					sprd,use-dcs-write;
					sprd,width-mm = <0x44>;

					display-timings {
						native-mode = <0x1>;

						timing0 {
							clock-frequency = <0x5b8d800>;
							hactive = <0x2d0>;
							hback-porch = <0x48>;
							hfront-porch = <0x48>;
							hsync-len = <0x10>;
							phandle = <0x1>;
							vactive = <0x640>;
							vback-porch = <0x6c>;
							vfront-porch = <0x84>;
							vsync-len = <0x4>;
						};
					};
				};

				lcd_icnl9911_hlt_mipi_hdp {
					phandle = <0x21>;
					sprd,dsi-color-format = "rgb888";
					sprd,dsi-lane-number = <0x4>;
					sprd,dsi-work-mode = <0x1>;
					sprd,height-mm = <0x97>;
					sprd,initial-command = [39 00 00 03 f0 5a 59 39 00 00 03 f1 a5 a6 39 00 00 1f b0 82 81 05 04 87 86 84 85 66 66 33 33 20 01 01 78 01 01 0f 05 04 03 02 01 02 03 04 00 00 00 39 00 00 1e b1 11 51 86 06 01 00 01 7c 01 01 01 04 08 54 00 00 00 44 40 02 01 40 02 01 40 02 01 40 02 39 00 00 12 b2 54 d4 82 05 40 02 01 40 02 01 05 05 54 0c 0c 0d 0b 39 00 00 20 b3 02 00 00 00 00 26 26 91 a2 33 44 00 26 00 18 01 02 08 20 30 08 09 44 20 40 20 40 08 09 22 33 39 00 00 1d b4 0a 02 dc 1d 00 02 02 02 02 12 10 02 02 0e 0c 04 03 03 03 03 03 03 ff ff f3 00 00 00 39 00 00 1d b5 0b 02 dc 1d 00 02 02 02 02 13 11 02 02 0f 0d 05 03 03 03 03 03 03 ff ff f3 00 00 00 39 00 00 19 b8 00 00 00 00 00 00 00 00 00 00 00 00 00 00 00 00 00 00 00 00 00 00 00 00 39 00 00 0e bb 01 05 09 11 0d 19 1d 15 25 69 00 21 25 39 00 00 0f bc 00 00 00 00 02 20 ff 00 03 33 01 73 44 00 39 00 00 0b bd 53 12 4f cf 72 a7 08 44 ae 15 39 00 00 0b be 65 65 50 3c 0c 66 43 02 0e 0e 39 00 00 09 bf 07 25 07 25 7f 00 11 04 39 00 00 0a c0 10 ff ff ff ff ff 00 ff 00 39 00 00 14 c1 c0 20 30 7c 0a 50 a2 08 2a 40 36 00 07 cf ff ff c0 00 c0 23 00 00 02 c2 00 39 00 00 0b c3 06 00 ff 00 ff 00 00 81 01 00 23 00 00 02 c5 03 23 00 00 02 d2 42 39 00 00 17 c7 f7 b7 8e 70 42 21 f1 46 15 ef c9 9d f7 cb ad 85 6b 46 1a 7e c0 00 39 00 00 17 c8 f7 b7 8e 70 42 21 f1 46 15 ef c9 9d f7 cb ad 85 6b 46 1a 7e c0 00 39 00 00 03 f1 5a 59 39 00 00 03 f0 a5 a6 23 05 00 02 35 00 23 78 00 02 11 00 23 23 00 02 29 00 23 05 00 02 26 01];
					sprd,phy-bit-clock = <0xa8750>;
					sprd,phy-escape-clock = <0x4e20>;
					sprd,reset-off-sequence = <0x0 0x5>;
					sprd,reset-on-sequence = <0x1 0x32 0x0 0x32 0x1 0x96>;
					sprd,sleep-in-command = [23 00 00 02 26 08 23 23 00 02 28 00 23 78 00 02 10 00];
					sprd,sleep-out-command = [23 78 00 02 11 00 23 23 00 02 29 00 23 00 00 02 26 01];
					sprd,use-dcs-write;
					sprd,width-mm = <0x44>;

					display-timings {
						native-mode = <0x2>;

						timing0 {
							clock-frequency = <0x5b8d800>;
							hactive = <0x2d0>;
							hback-porch = <0x50>;
							hfront-porch = <0x6e>;
							hsync-len = <0x8>;
							phandle = <0x2>;
							vactive = <0x640>;
							vback-porch = <0x20>;
							vfront-porch = <0x64>;
							vsync-len = <0xa>;
						};
					};
				};
			};

			sprd_backlight {
				brightness-levels = <0x2 0x2 0x2 0x2 0x2 0x2 0x2 0x3 0x4 0x5 0x6 0x7 0x8 0x9 0xa 0xb 0xc 0xd 0xe 0xf 0x10 0x11 0x12 0x13 0x14 0x15 0x16 0x17 0x18 0x19 0x1a 0x1b 0x1c 0x1d 0x1e 0x1f 0x20 0x21 0x22 0x23 0x24 0x25 0x26 0x27 0x28 0x29 0x2a 0x2b 0x2c 0x2d 0x2e 0x2f 0x30 0x31 0x32 0x33 0x34 0x35 0x36 0x37 0x38 0x39 0x3a 0x3b 0x3c 0x3d 0x3e 0x3f 0x40 0x41 0x42 0x43 0x44 0x45 0x46 0x47 0x48 0x49 0x4a 0x4b 0x4c 0x4d 0x4e 0x4f 0x50 0x51 0x52 0x53 0x54 0x55 0x56 0x57 0x58 0x59 0x5a 0x5b 0x5c 0x5d 0x5e 0x5f 0x60 0x61 0x62 0x63 0x64 0x65 0x66 0x67 0x68 0x69 0x6a 0x6b 0x6c 0x6d 0x6e 0x6f 0x70 0x71 0x72 0x73 0x74 0x75 0x76 0x77 0x78 0x79 0x7a 0x7b 0x7c 0x7d 0x7e 0x7f 0x80 0x81 0x82 0x83 0x84 0x85 0x86 0x87 0x88 0x89 0x8a 0x8b 0x8c 0x8d 0x8e 0x8f 0x90 0x91 0x92 0x93 0x94 0x95 0x96 0x97 0x98 0x99 0x9a 0x9b 0x9c 0x9d 0x9e 0x9f 0xa0 0xa1 0xa2 0xa3 0xa4 0xa5 0xa6 0xa7 0xa8 0xa9 0xaa 0xab 0xac 0xad 0xae 0xaf 0xb0 0xb1 0xb2 0xb3 0xb4 0xb5 0xb6 0xb7 0xb8 0xb9 0xba 0xbb 0xbc 0xbd 0xbe 0xbf 0xc0 0xc1 0xc2 0xc3 0xc4 0xc5 0xc6 0xc7 0xc8 0xc9 0xca 0xcb 0xcc 0xcd 0xce 0xcf 0xd0 0xd1 0xd2 0xd3 0xd4 0xd5 0xd6 0xd7 0xd8 0xd9 0xda 0xdb 0xdc 0xdd 0xde 0xdf 0xe0 0xe1 0xe2 0xe3 0xe4 0xe5 0xe6 0xe7 0xe8 0xe9 0xea 0xeb 0xec 0xed 0xee 0xef 0xf0 0xf1 0xf2 0xf3 0xf4 0xf5 0xf6 0xf7 0xf8 0xf9 0xfa 0xfb>;
				compatible = "pwm-backlight";
				default-brightness-level = <0x21>;
				phandle = <0x5>;
				pwm-names = "backlight";
				pwms = <0xffffffff 0x1 0x7530>;
			};

			sunwave@0 {
				compatible = "sunwave,sunwave-fp";
				sunwave,irq-gpio = <0xffffffff 0x82 0x0>;
				sunwave,reset-gpio = <0xffffffff 0x83 0x0>;
			};

			thermal-sensor {
				#thermal-sensor-cells = <0x0>;
				compatible = "generic-adc-thermal";
				io-channel-names = "sensor-channel";
				io-channels = <0xffffffff 0x1>;
				phandle = <0xc>;
				temperature-lookup-table = <0xffff64c2 0x46b 0xffff8baf 0x456 0xffffb3e8 0x432 0xffffedb9 0x3d7 0x277e 0x346 0x60e5 0x28e 0xaf7a 0x19d 0xd677 0x13c 0xfd7f 0xee 0x12484 0xb2 0x14b93 0x85 0x172a3 0x64 0x199b0 0x4b 0x1c0c9 0x39 0x1e7c8 0x2b>;
			};
		};
	};

	fragment@0 {
		target = <0xffffffff>;

		__overlay__ {
			bootargs_ext = "androidboot.hardware=s9863a1c10 androidboot.dtbo_idx=0";
		};
	};

	fragment@1 {
		target = <0xffffffff>;

		__overlay__ {

			camera@fdd69000 {
				phandle = <0x1e>;
				reg = <0x0 0xfdd69000 0x0 0xa00000>;
			};

			framebuffer@fe769000 {
				phandle = <0x1d>;
				reg = <0x0 0xfe769000 0x0 0x1817000>;
			};

			logobuffer@fd580000 {
				phandle = <0x1f>;
				reg = <0x0 0xfd580000 0x0 0x7e9000>;
			};
		};
	};

	fragment@10 {
		target = <0xffffffff>;

		__overlay__ {
			clock-frequency = <0x186a0>;
			status = "okay";

			chipone_tddi@48 {
				TP_MAX_X = <0x2d0>;
				TP_MAX_Y = <0x5a0>;
				compatible = "chipone-tddi";
				gpios = <0xffffffff 0x91 0x0 0xffffffff 0x90 0x0>;
				reg = <0x48>;
				vdd_name = "vdd28";
				virtualkeys = <0x50 0x384 0x3c 0x28 0xf0 0x384 0x3c 0x28 0x190 0x384 0x3c 0x28>;
			};

			focaltech_ts@38 {
				TP_MAX_X = <0x2d0>;
				TP_MAX_Y = <0x5a0>;
				compatible = "focaltech,focaltech_ts";
				gpios = <0xffffffff 0x91 0x0 0xffffffff 0x90 0x0>;
				reg = <0x38>;
				vdd_name = "vdd28";
				virtualkeys = <0x50 0x384 0x3c 0x28 0xf0 0x384 0x3c 0x28 0x190 0x384 0x3c 0x28>;
			};

			goodix_ts@5d {
				TP_MAX_X = <0x2d0>;
				TP_MAX_Y = <0x5a0>;
				compatible = "Goodix,goodix_ts";
				gpios = <0xffffffff 0x91 0x0 0xffffffff 0x90 0x0>;
				reg = <0x5d>;
				vdd_name = "vdd28";
				virtualkeys = <0x28 0x546 0x3c 0x28 0x78 0x546 0x3c 0x28 0xc8 0x546 0x3c 0x28>;
			};
		};
	};

	fragment@11 {
		target = <0xffffffff>;

		__overlay__ {
			clock-frequency = <0x61a80>;
			status = "okay";

			bias_lcm@3e {
				compatible = "bias_lcm,tps65132_power";
				fv-en-gpios = <0xffffffff 0x59 0x0>;
				phandle = <0x29>;
				reg = <0x3e>;
			};

			charger@6a {
				chg-enable-gpios = <0xffffffff 0x20 0x0>;
				compatible = "eta,eta6937_chg";
				extcon = <0xffffffff>;
				monitored-battery = <0x4>;
				phandle = <0x28>;
				phys = <0xffffffff>;
				reg = <0x6a>;

				otg-vbus {
					phandle = <0x6>;
					regulator-name = "vddvbus";
				};
			};
		};
	};

	fragment@12 {
		target = <0xffffffff>;

		__overlay__ {
			clock-frequency = <0x61a80>;
			status = "okay";

			regulator@60 {
				compatible = "fcs,fan53555";
				fcs,suspend-voltage-selector = <0x1>;
				phandle = <0x2a>;
				reg = <0x60>;
				regulator-always-on;
				regulator-max-microvolt = <0x1587b8>;
				regulator-min-microvolt = <0x93378>;
				regulator-name = "fan53555";
				regulator-ramp-delay = <0xfa00>;
			};
		};
	};

	fragment@13 {
		target = <0xffffffff>;

		__overlay__ {
			cd-gpios = <0xffffffff 0x9 0x0>;
		};
	};

	fragment@14 {
		target = <0xffffffff>;

		__overlay__ {
			sprd,dcam-superzoom = <0x0>;
			status = "okay";
		};
	};

	fragment@15 {
		target = <0xffffffff>;

		__overlay__ {
			hwdvfs_dev = <0x7 0x8 0x9>;

			cluster@0 {
				dcdc-ctrl = <0xa>;
				phandle = <0x7>;
				reg = <0x0>;
			};

			cluster@1 {
				dcdc-ctrl = <0xb>;
				phandle = <0x8>;
				reg = <0x1>;
			};

			dcdc-controller@0 {
				phandle = <0xb>;
				reg = <0x0 0x0>;
				volt-hold-us = <0x32>;
				volt-max-step-microvolt = <0x61a8>;
				volt-pause-us = <0x5>;
				volt-stable-us = <0x5>;
				volt-timeout-us = <0x320>;
				volt-via-adi;
			};

			dcdc-controller@1 {
				phandle = <0xa>;
				reg = <0x1 0x2>;
				volt-hold-us = <0x19>;
				volt-max-step-microvolt = <0x124f84>;
				volt-pause-us = <0x14>;
				volt-stable-us = <0x19>;
				volt-timeout-us = <0x320>;
				volt-via-i2c;
			};

			dsu@0 {
				dcdc-ctrl = <0xb>;
				phandle = <0x9>;
				reg = <0x0>;
			};
		};
	};

	fragment@16 {
		target = <0xffffffff>;

		__overlay__ {

			board-thmzone {
				phandle = <0x2b>;
				polling-delay = <0x0>;
				polling-delay-passive = <0x0>;
				thermal-sensors = <0xc>;
			};
		};
	};

	fragment@17 {
		target = <0xffffffff>;

		__overlay__ {
			regulator-always-on;
		};
	};

	fragment@18 {
		target = <0xffffffff>;

		__overlay__ {
			regulator-always-on;
		};
	};

	fragment@19 {
		target = <0xffffffff>;

		__overlay__ {
			regulator-always-on;
		};
	};

	fragment@2 {
		target = <0xffffffff>;

		__overlay__ {
			avdd-gpio = <0xffffffff 0x59 0x0>;
			reset-gpio = <0xffffffff 0x32 0x0>;
			sprd,backlight = <0x5>;
		};
	};

	fragment@20 {
		target = <0xffffffff>;

		__overlay__ {
			regulator-always-on;
		};
	};

	fragment@21 {
		target = <0xffffffff>;

		__overlay__ {
			status = "disabled";
		};
	};

	fragment@22 {
		target = <0xffffffff>;

		__overlay__ {
			pinctrl-0 = <0xd>;
			pinctrl-1 = <0xe>;
			pinctrl-10 = <0x17 0x18 0x19 0x1a 0x1b 0x1c>;
			pinctrl-2 = <0xf>;
			pinctrl-3 = <0x10>;
			pinctrl-4 = <0x11>;
			pinctrl-5 = <0x12>;
			pinctrl-6 = <0x13>;
			pinctrl-7 = <0x14>;
			pinctrl-8 = <0x15>;
			pinctrl-9 = <0x16>;
			pinctrl-names = "gpio_121", "gpio_122", "gpio_123", "gpio_124", "gpio_125", "gpio_126", "gpio_144", "gpio_145", "gpio_146", "gpio_147", "shutdown";

			extint0 {
				function = "func4";
				phandle = <0x13>;
				pins = "SHARKL3_EXTINT0";
			};

			extint1 {
				function = "func4";
				phandle = <0x14>;
				pins = "SHARKL3_EXTINT1";
			};

			keyin0 {
				function = "func4";
				phandle = <0x10>;
				pins = "SHARKL3_KEYIN0";
			};

			keyin1 {
				function = "func4";
				phandle = <0x11>;
				pins = "SHARKL3_KEYIN1";
			};

			keyin2 {
				function = "func4";
				phandle = <0x12>;
				pins = "SHARKL3_KEYIN2";
			};

			keyout0 {
				function = "func4";
				phandle = <0xd>;
				pins = "SHARKL3_KEYOUT0";
			};

			keyout1 {
				function = "func4";
				phandle = <0xe>;
				pins = "SHARKL3_KEYOUT1";
			};

			keyout2 {
				function = "func4";
				phandle = <0xf>;
				pins = "SHARKL3_KEYOUT2";
			};

			rfsck0 {
				function = "func4";
				phandle = <0x18>;
				pins = "SHARKL3_RFSCK0";
			};

			rfsck1 {
				function = "func4";
				phandle = <0x1b>;
				pins = "SHARKL3_RFSCK1";
			};

			rfsda0 {
				function = "func4";
				phandle = <0x19>;
				pins = "SHARKL3_RFSDA0";
			};

			rfsda1 {
				function = "func4";
				phandle = <0x1c>;
				pins = "SHARKL3_RFSDA1";
			};

			rfsen0 {
				function = "func4";
				phandle = <0x17>;
				pins = "SHARKL3_RFSEN0";
			};

			rfsen1 {
				function = "func4";
				phandle = <0x1a>;
				pins = "SHARKL3_RFSEN1";
			};

			scl3 {
				function = "func4";
				phandle = <0x15>;
				pins = "SHARKL3_SCL3";
			};

			sda3 {
				function = "func4";
				phandle = <0x16>;
				pins = "SHARKL3_SDA3";
			};
		};
	};

	fragment@23 {
		target = <0xffffffff>;

		__overlay__ {
			sprd,spk-route-hp;
			status = "okay";
		};
	};

	fragment@24 {
		target = <0xffffffff>;

		__overlay__ {
			sprd,spk-ext-pa-gpio = <0xffffffff 0x9c 0x0>;
			sprd,spk-ext-pa-info = <0x0 0x0 0x4 0x0>;
			status = "okay";
		};
	};

	fragment@25 {
		target = <0xffffffff>;

		__overlay__ {

			heap@3 {
				label = "carveout_fb";
				memory-region = <0x1d>;
				reg = <0x3>;
				type = <0x2>;
			};

			heap@4 {
				label = "carveout_camera";
				memory-region = <0x1e>;
				reg = <0x4>;
				type = <0x2>;
			};
		};
	};

	fragment@26 {
		target = <0xffffffff>;

		__overlay__ {
			sprd,logo-memory = <0x1f>;
		};
	};

	fragment@3 {
		target = <0xffffffff>;

		__overlay__ {
			sprd-freq = <0x3a5 0x190 0xe9 0x190 0x26e 0x3a5>;
			sprd-scene = "boost", "lcdon", "lcdoff", "camlow", "camhigh", "camveryhigh";
		};
	};

	fragment@4 {
		target = <0xffffffff>;

		__overlay__ {
			id-gpio = <0xffffffff 0x4 0x0>;
		};
	};

	fragment@5 {
		target = <0xffffffff>;

		__overlay__ {
			extcon = <0xffffffff>;
			vbus-supply = <0x6>;
		};
	};

	fragment@6 {
		target = <0xffffffff>;

		__overlay__ {
			first-calib-capacity = <0x32>;
			first-calib-voltage = <0x36ee80>;
			monitored-battery = <0x4>;
			sprd,calib-resistance-real = <0x4e20>;
			sprd,calib-resistance-spec = <0x4e20>;
		};
	};

	fragment@7 {
		target = <0xffffffff>;

		__overlay__ {
			cd-gpios = <0xffffffff 0x9 0x1>;
		};
	};

	fragment@8 {
		target = <0xffffffff>;

		__overlay__ {
			clock-frequency = <0x61a80>;
			status = "okay";

			sensor-main@20 {
				avdd-gpios = <0xffffffff 0x3e 0x0>;
				clock-names = "clk_src", "sensor_eb", "clk_96m", "clk_76m8", "clk_48m", "clk_26m";
				clocks = <0xffffffff 0x30 0xffffffff 0xb 0xffffffff 0x4 0xffffffff 0x10 0xffffffff 0x5 0xffffffff>;
				compatible = "sprd,sensor-main";
				csi = <0xffffffff>;
				mipi-switch-en-gpios = <0xffffffff 0x1d 0x0>;
				mipi-switch-mode-gpios = <0xffffffff 0x1e 0x1>;
				phandle = <0x23>;
				power-down-gpios = <0xffffffff 0x2e 0x0>;
				reg = <0x20>;
				reset-gpios = <0xffffffff 0x2c 0x0>;
				sprd,phyid = <0x1>;
				vddcama-supply = <0xffffffff>;
				vddcamd-supply = <0xffffffff>;
				vddcammot-supply = <0xffffffff>;
				vddio-supply = <0xffffffff>;
			};

			sensor-sub2@30 {
				clock-names = "clk_src", "sensor_eb", "clk_96m", "clk_76m8", "clk_48m", "clk_26m";
				clocks = <0xffffffff 0x31 0xffffffff 0xc 0xffffffff 0x4 0xffffffff 0x10 0xffffffff 0x5 0xffffffff>;
				compatible = "sprd,sensor-sub2";
				csi = <0xffffffff>;
				dvdd-gpios = <0xffffffff 0x5 0x0>;
				iovdd-gpios = <0xffffffff 0xf 0x0>;
				phandle = <0x24>;
				power-down-gpios = <0xffffffff 0x39 0x0>;
				reg = <0x30>;
				reset-gpios = <0xffffffff 0x10 0x0>;
				sprd,phyid = <0x2>;
				vddcama-supply = <0xffffffff>;
				vddcamd-supply = <0xffffffff>;
				vddcammot-supply = <0xffffffff>;
				vddio-supply = <0xffffffff>;
			};
		};
	};

	fragment@9 {
		target = <0xffffffff>;

		__overlay__ {
			clock-frequency = <0x61a80>;
			status = "okay";

			sensor-main2@6C {
				clock-names = "clk_src", "sensor_eb", "clk_96m", "clk_76m8", "clk_48m", "clk_26m";
				clocks = <0xffffffff 0x31 0xffffffff 0xc 0xffffffff 0x4 0xffffffff 0x10 0xffffffff 0x5 0xffffffff>;
				compatible = "sprd,sensor-main2";
				csi = <0xffffffff>;
				dvdd-gpios = <0xffffffff 0x5 0x0>;
				iovdd-gpios = <0xffffffff 0xf 0x0>;
				phandle = <0x26>;
				power-down-gpios = <0xffffffff 0x3b 0x0>;
				reg = <0x6c>;
				reset-gpios = <0xffffffff 0x38 0x0>;
				sprd,phyid = <0x4>;
				vddcama-supply = <0xffffffff>;
				vddcamd-supply = <0xffffffff>;
				vddcammot-supply = <0xffffffff>;
				vddio-supply = <0xffffffff>;
			};

			sensor-main3@2a {
				clock-names = "clk_src", "sensor_eb", "clk_96m", "clk_76m8", "clk_48m", "clk_26m";
				clocks = <0xffffffff 0x31 0xffffffff 0xc 0xffffffff 0x4 0xffffffff 0x10 0xffffffff 0x5 0xffffffff>;
				compatible = "sprd,sensor-main3";
				csi = <0xffffffff>;
				dvdd-gpios = <0xffffffff 0x8e 0x0>;
				phandle = <0x27>;
				power-down-gpios = <0xffffffff 0x2f 0x0>;
				reg = <0x2a>;
				reset-gpios = <0xffffffff 0x2d 0x0>;
				sprd,phyid = <0x3>;
				vddcama-supply = <0xffffffff>;
				vddcamd-supply = <0xffffffff>;
				vddcammot-supply = <0xffffffff>;
				vddio-supply = <0xffffffff>;
			};

			sensor-sub@20 {
				avdd-gpios = <0xffffffff 0x3e 0x0>;
				clock-names = "clk_src", "sensor_eb", "clk_96m", "clk_76m8", "clk_48m", "clk_26m";
				clocks = <0xffffffff 0x30 0xffffffff 0xb 0xffffffff 0x4 0xffffffff 0x10 0xffffffff 0x5 0xffffffff>;
				compatible = "sprd,sensor-sub";
				csi = <0xffffffff>;
				mipi-switch-en-gpios = <0xffffffff 0x1d 0x0>;
				mipi-switch-mode-gpios = <0xffffffff 0x1e 0x0>;
				phandle = <0x25>;
				power-down-gpios = <0xffffffff 0x28 0x0>;
				reg = <0x20>;
				reset-gpios = <0xffffffff 0x29 0x0>;
				sprd,phyid = <0x1>;
				vddcama-supply = <0xffffffff>;
				vddcamd-supply = <0xffffffff>;
				vddcammot-supply = <0xffffffff>;
				vddio-supply = <0xffffffff>;
			};
		};
	};
};
